/*
 * Copyright (c) 2017, 2020, The Linux Foundation. All rights reserved.
 *
 * This program is free software; you can redistribute it and/or modify
 * it under the terms of the GNU General Public License version 2 and
 * only version 2 as published by the Free Software Foundation.
 *
 * This program is distributed in the hope that it will be useful,
 * but WITHOUT ANY WARRANTY; without even the implied warranty of
 * MERCHANTABILITY or FITNESS FOR A PARTICULAR PURPOSE.  See the
 * GNU General Public License for more details.
 */

&modem_adsp_mem {
	reg = <0x0 0x88000000 0x0 0x03c00000>;
};

&peripheral_mem {
	reg = <0x0 0x8bc00000 0x0 0x0300000>;
};

&venus_qseecom_mem {
	reg = <0 0 0 0x800000>;
};
