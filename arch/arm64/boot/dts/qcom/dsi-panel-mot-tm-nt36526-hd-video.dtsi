/* Copyright (c) 2018-2019, The Linux Foundation. All rights reserved.
 *
 * This program is free software; you can redistribute it and/or modify
 * it under the terms of the GNU General Public License version 2 and
 * only version 2 as published by the Free Software Foundation.
 *
 * This program is distributed in the hope that it will be useful,
 * but WITHOUT ANY WARRANTY; without even the implied warranty of
 * MERCHANTABILITY or FITNESS FOR A PARTICULAR PURPOSE.  See the
 * GNU General Public License for more details.
 */

&mdss_mdp {
	dsi_nt36526_tm_video: qcom,mdss_dsi_nt36526_tm_video {
		qcom,mdss-dsi-panel-name =
				"nt36526 tm video mode dsi panel";
		qcom,mdss-dsi-panel-type = "dsi_video_mode";

		qcom,mdss-dsi-virtual-channel-id = <0>;
		qcom,mdss-dsi-stream = <0>;
		qcom,mdss-dsi-h-left-border = <0>;
		qcom,mdss-dsi-h-right-border = <0>;
		qcom,mdss-dsi-v-top-border = <0>;
		qcom,mdss-dsi-v-bottom-border = <0>;
		qcom,mdss-dsi-bpp = <24>;
		qcom,mdss-dsi-color-order = "rgb_swap_rgb";
		qcom,mdss-dsi-underflow-color = <0xff>;
		qcom,mdss-dsi-border-color = <0>;
		qcom,mdss-dsi-h-sync-pulse = <0>;
		qcom,mdss-dsi-traffic-mode = "non_burst_sync_event";
		qcom,mdss-dsi-lane-map = "lane_map_0123";
		qcom,mdss-dsi-bllp-eof-power-mode;
		qcom,mdss-dsi-bllp-power-mode;
		qcom,mdss-dsi-tx-eot-append;
		qcom,mdss-dsi-lane-0-state;
		qcom,mdss-dsi-lane-1-state;
		qcom,mdss-dsi-lane-2-state;
		qcom,mdss-dsi-lane-3-state;
		qcom,mdss-dsi-dma-trigger = "trigger_sw";
		qcom,mdss-dsi-mdp-trigger = "none";
		qcom,mdss-dsi-lp11-init;
		qcom,mdss-dsi-bl-pmic-control-type = "bl_ctrl_dcs";
		qcom,mdss-dsi-bl-min-level = <1>;
		qcom,mdss-dsi-bl-max-level = <4095>;
		qcom,mdss-dsi-reset-always-high;
		qcom,bklt-dcs-2bytes-0x0fff-enabled;
		qcom,mdss-dsi-reset-sequence = <1 10>, <0 10>, <1 10>;
		/*
		qcom,mdss-pan-physical-width-dimension = <65>;
		qcom,mdss-pan-physical-height-dimension = <129>;
		*/
		qcom,mdss-dsi-display-timings {
			timing@0 {
				qcom,mdss-dsi-panel-width = <720>;
				qcom,mdss-dsi-panel-height = <1560>;
				qcom,mdss-dsi-h-front-porch = <152>;
				qcom,mdss-dsi-h-back-porch = <152>;
				qcom,mdss-dsi-h-pulse-width = <4>;
				qcom,mdss-dsi-h-sync-skew = <0>;
				qcom,mdss-dsi-v-back-porch = <222>;
				qcom,mdss-dsi-v-front-porch = <20>;
				qcom,mdss-dsi-v-pulse-width = <2>;
				qcom,mdss-dsi-panel-framerate = <60>;
				qcom,mdss-dsi-panel-clockrate = <668000000>;
				qcom,mdss-dsi-on-command = [
					15 01 00 00 14 00 02 FF 24
					15 00 00 00 00 00 02 FB 01
					39 00 00 00 00 00 03 5C DF 1F
					39 00 00 00 00 00 03 5D 0B 0B
					39 00 00 00 00 00 04 5E 00 00 00
					15 01 00 00 14 00 02 FF 2A
					15 00 00 00 00 00 02 FB 01
					39 00 00 00 00 00 11 B0 32 32 30 2B 26 21 1D 19 14 12 0E 0C 0A 08 04 00
					39 00 00 00 00 00 11 B1 2D 2D 2B 26 22 1E 1A 16 11 10 0D 0B 09 07 03 00
					39 00 00 00 00 00 11 B2 24 22 21 1F 1C 19 14 10 0D 0C 08 07 04 02 00 00
					39 00 00 00 00 00 11 B3 20 1F 1E 1C 19 16 11 0F 0C 0B 07 06 03 01 00 00
					39 00 00 00 00 00 11 B4 68 5C 62 78 8E AE 9C 9C C3 DF DF FF DF DF FF FF
					39 00 00 00 00 00 11 B5 70 68 70 8E 9C AE 9C C3 FF FF DF FF DF DF FF FF
					39 00 00 00 00 00 09 B6 44 44 44 44 44 44 44 44
					15 00 00 00 00 00 02 FF 23
					15 00 00 00 00 00 02 FB 01
					15 00 00 00 00 00 02 00 80
					15 00 00 00 00 00 02 07 00
					15 00 00 00 00 00 02 FF 10
					05 01 00 00 78 00 01 11
					05 01 00 00 14 00 01 29
					39 00 00 00 00 00 03 51 00 00
					15 00 00 00 00 00 02 53 2C
					15 00 00 00 00 00 02 55 01
					39 01 00 00 00 00 03 68 04 01
				];
				qcom,mdss-dsi-off-command = [
					05 01 00 00 14 00 01 28
					05 01 00 00 14 00 01 10
				];
				qcom,mdss-dsi-on-command-state = "dsi_lp_mode";
				qcom,mdss-dsi-off-command-state = "dsi_hs_mode";
				qcom,mdss-dsi-cabc-mv-command = [15 01 00 00 00 00 02 55 03];
				qcom,mdss-dsi-cabc-mv-command-state =  "dsi_hs_mode";
				qcom,mdss-dsi-cabc-ui-command = [15 01 00 00 00 00 02 55 01];
				qcom,mdss-dsi-cabc-ui-command-state =  "dsi_hs_mode";
				qcom,mdss-dsi-cabc-dis-command = [15 01 00 00 00 00 02 55 00];
				qcom,mdss-dsi-cabc-dis-command-state =  "dsi_hs_mode";
				//acturlly hbm is impliemented by controlling gpio. add this commond just enable HBM feature.
				qcom,mdss-dsi-hbm-on-command = [01];
				qcom,mdss-dsi-hbm-on-command-state =  "dsi_lp_mode";
				qcom,mdss-dsi-hbm-off-command = [00];
				qcom,mdss-dsi-hbm-off-command-state =  "dsi_lp_mode";
			};
		};
	};
};
