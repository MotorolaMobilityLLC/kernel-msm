/* Copyright (c) 2018-2019, The Linux Foundation. All rights reserved.
 *
 * This program is free software; you can redistribute it and/or modify
 * it under the terms of the GNU General Public License version 2 and
 * only version 2 as published by the Free Software Foundation.
 *
 * This program is distributed in the hope that it will be useful,
 * but WITHOUT ANY WARRANTY; without even the implied warranty of
 * MERCHANTABILITY or FITNESS FOR A PARTICULAR PURPOSE.  See the
 * GNU General Public License for more details.
 */

&mdss_mdp {
	dsi_hx83104a_inxr_video: qcom,mdss_dsi_hx83104a_inxr_video {
		qcom,mdss-dsi-panel-name =
		"hx83104a inxr video mode dsi panel";
		qcom,mdss-dsi-panel-type = "dsi_video_mode";
		qcom,mdss-dsi-virtual-channel-id = <0>;
		qcom,mdss-dsi-stream = <0>;
		qcom,mdss-dsi-h-left-border = <0>;
		qcom,mdss-dsi-h-right-border = <0>;
		qcom,mdss-dsi-v-top-border = <0>;
		qcom,mdss-dsi-v-bottom-border = <0>;
		qcom,mdss-dsi-bpp = <24>;
		qcom,mdss-dsi-color-order = "rgb_swap_rgb";
		qcom,mdss-dsi-underflow-color = <0xff>;
		qcom,mdss-dsi-border-color = <0>;
		qcom,mdss-dsi-h-sync-pulse = <0>;
		qcom,mdss-dsi-traffic-mode = "non_burst_sync_event";
		qcom,mdss-dsi-lane-map = "lane_map_0123";
		qcom,mdss-dsi-bllp-eof-power-mode;
		qcom,mdss-dsi-bllp-power-mode;
		qcom,mdss-dsi-tx-eot-append;
		qcom,mdss-dsi-lane-0-state;
		qcom,mdss-dsi-lane-1-state;
		qcom,mdss-dsi-lane-2-state;
		qcom,mdss-dsi-lane-3-state;
		qcom,mdss-dsi-dma-trigger = "trigger_sw";
		qcom,mdss-dsi-mdp-trigger = "none";
		qcom,mdss-dsi-lp11-init;
		qcom,mdss-dsi-bl-pmic-control-type = "bl_ctrl_dcs";
		qcom,mdss-dsi-bl-min-level = <1>;
		qcom,mdss-dsi-bl-max-level = <4095>;
		qcom,bklt-dcs-2bytes-0x0fff-enabled;
		qcom,mdss-dsi-reset-sequence = <1 10>, <0 10>, <1 50>;
		qcom,mdss-dsi-panel-clockrate = <668000000>;
		qcom,mdss-dsi-display-timings {
			timing@0 {
				qcom,mdss-dsi-panel-width = <720>;
				qcom,mdss-dsi-panel-height = <1560>;
				qcom,mdss-dsi-h-front-porch = <272>;
				qcom,mdss-dsi-h-back-porch = <112>;
				qcom,mdss-dsi-h-pulse-width = <40>;
				qcom,mdss-dsi-h-sync-skew = <0>;
				qcom,mdss-dsi-v-back-porch = <5>;
				qcom,mdss-dsi-v-front-porch = <52>;
				qcom,mdss-dsi-v-pulse-width = <5>;
				qcom,mdss-dsi-panel-framerate = <60>;
				qcom,mdss-dsi-on-command = [
					39 00 00 00 00 00 04 B9 83 11 2A
					05 01 00 00 64 00 01 11
					39 01 00 00 01 00 03 5E 00 04
					39 01 00 00 01 00 03 51 00 00
					15 01 00 00 01 00 02 BC 03
					39 01 00 00 01 00 14 BA 73 03 64 33 11 33 33 11 10 00 00 10 08 3D 02 76 04 00 5B
					39 01 00 00 01 00 09 C7 00 00 04 E0 33 00 20 40
					39 01 00 00 01 00 05 C9 04 08 B9 01
					15 01 00 00 01 00 02 BD 02
					39 01 00 00 01 00 0A B4 00 12 12 22 88 12 12 00 70
					15 01 00 00 01 00 02 BD 00
					15 01 00 00 05 00 02 55 01
					15 01 00 00 01 00 02 53 2C
					05 01 00 00 14 00 01 29
				];
				qcom,mdss-dsi-off-command = [
					05 01 00 00 32 00 01 28
					05 01 00 00 78 00 01 10
				];
				qcom,mdss-dsi-on-command-state = "dsi_lp_mode";
				qcom,mdss-dsi-off-command-state = "dsi_hs_mode";
				qcom,mdss-dsi-cabc-mv-command = [15 01 00 00 00 00 02 55 03];
				qcom,mdss-dsi-cabc-mv-command-state =  "dsi_hs_mode";
				qcom,mdss-dsi-cabc-ui-command = [15 01 00 00 00 00 02 55 01];
				qcom,mdss-dsi-cabc-ui-command-state =  "dsi_hs_mode";
				qcom,mdss-dsi-cabc-dis-command = [15 01 00 00 00 00 02 55 00];
				qcom,mdss-dsi-cabc-dis-command-state =  "dsi_hs_mode";
				//acturlly hbm is impliemented by controlling gpio. add this commond just enable HBM feature.
				qcom,mdss-dsi-hbm-on-command = [01];
				qcom,mdss-dsi-hbm-on-command-state =  "dsi_lp_mode";
				qcom,mdss-dsi-hbm-off-command = [00];
				qcom,mdss-dsi-hbm-off-command-state =  "dsi_lp_mode";
			};
		};
	};
};
