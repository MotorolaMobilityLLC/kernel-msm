&qupv3_se6_spi {
	status = "ok";
	focaltech@0 {
		compatible = "focaltech,fts";
		reg = <0x0>;
		interrupt-parent = <&tlmm>;
		interrupts = <9 0x02>;
		spi-max-frequency=<20000000>;
		focaltech,reset-gpio = <&tlmm 8 0x01>;
		focaltech,irq-gpio = <&tlmm 9 0x02>;
		focaltech,max-touch-number = <10>;
		focaltech,display-coords =  <0 0 1080 2340>;
		focaltech,report_gesture_key;
		focaltech,dlfw_in_resume;
		pinctrl-names = "pmx_ts_active","pmx_ts_suspend","pmx_ts_release";
		pinctrl-0 = <&ts_active>;
		pinctrl-1 = <&ts_int_suspend &ts_reset_suspend>;
		pinctrl-2 = <&ts_release>;
		status = "/chosen", "mmi,panel_name", "dsi_ft8756_focal_1080P_vid_display";
	};
};

