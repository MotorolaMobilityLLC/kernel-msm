/* Copyright (c) 2019, The Linux Foundation. All rights reserved.
 *
 * This program is free software; you can redistribute it and/or modify
 * it under the terms of the GNU General Public License version 2 and
 * only version 2 as published by the Free Software Foundation.
 *
 * This program is distributed in the hope that it will be useful,
 * but WITHOUT ANY WARRANTY; without even the implied warranty of
 * MERCHANTABILITY or FITNESS FOR A PARTICULAR PURPOSE.  See the
 * GNU General Public License for more details.
 */

/dts-v1/;
/plugin/;

#include <dt-bindings/clock/msm-clocks-8953.h>

#include "sdm632-ginna-common-overlay.dtsi"

/ {
	model = "ginna";
	qcom,msm-id = <349 0x0>;
	qcom,board-id = <0x4D 0xA000>, <0x4E 0xA000>;
};

/*
 * Ginna HW rev EVT0 specific changes go here
 */
