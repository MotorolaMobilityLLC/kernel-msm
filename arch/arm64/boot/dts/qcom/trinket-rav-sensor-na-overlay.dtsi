/* Copyright (c) 2018, The Linux Foundation. All rights reserved.
 *
 * This program is free software; you can redistribute it and/or modify
 * it under the terms of the GNU General Public License version 2 and
 * only version 2 as published by the Free Software Foundation.
 *
 * This program is distributed in the hope that it will be useful,
 * but WITHOUT ANY WARRANTY; without even the implied warranty of
 * MERCHANTABILITY or FITNESS FOR A PARTICULAR PURPOSE.  See the
 * GNU General Public License for more details.
 */


&qupv3_se1_i2c { /* BLSP2 QUP1 (NFC) */
    a96t346@20 {
        status = "disabled";
    };
    sx9325@28 {
        status = "disabled";
    };
};

&qupv3_se1_i2c {
    status = "ok";
    sx933x@28 {
        compatible = "Semtech,sx933x";
        reg = <0x28>;
        pinctrl-names = "default","sleep";
        pinctrl-0 = <&sar_int_default>;
        pinctrl-1 = <&sar_int_sleep>;
        cap_vdd-supply = <&pm6125_l21>;
        interrupt-parent = <&tlmm>;
        interrupts = <82 0>;
        interrupt-names = "sx933x_irq";
        Semtech,nirq-gpio = <&tlmm 82 0x00>;
        Semtech,button-flag = <0x7>;
        Semtech,reg-num = <83>;
        Semtech,reg-init =<
            0x4004	0x7C
            0x4008	0x00
            0x4054	0x400
            0x42C0	0x8000000
            0x42C4	0x3F
            0x800C	0x00
            0x8010	0x00
            0x8014	0x00
            0x8018	0x00
            0x801C	0x38
            0x8020	0x1F001F
            0x8024	0x20001E8E
            0x8028	0x3FFE8266
            0x802C	0x20001E8E
            0x8030	0x3FF7825B
            0x8034	0x1000148E
            0x8038	0x3FBF8268
            0x803C	0x20001E8E
            0x8040	0x3DFF825E
            0x8044	0x1000148E
            0x8048	0x2FFF82C2
            0x804C	0x88E
            0x8050	0x80001EE6
            0x8054	0x10223806
            0x8058	0x60600031
            0x805C	0x54AC5300
            0x8060	0x00
            0x8064	0x770000
            0x8068	0x00
            0x806C	0x170017
            0x8070	0x20000
            0x8074	0x10223905
            0x8078	0x60600031
            0x807C	0x54AC5300
            0x8080	0x00
            0x8084	0x770000
            0x8088	0x00
            0x808C	0x1E001E00
            0x8090	0x10000
            0x8094	0x10223815
            0x8098	0x60600031
            0x809C	0x54AC5300
            0x80A0	0x00
            0x80A4	0x460000
            0x80A8	0x00
            0x80AC	0x25002500
            0x80B0	0x10000
            0x80B4	0x1052C800
            0x80B8	0x60600931
            0x80BC	0x54AC4300
            0x80C0	0x00
            0x80C4	0x00
            0x80C8	0x00
            0x80CC	0x00
            0x80D0	0x00
            0x80D4	0x1052C800
            0x80D8	0x60600964
            0x80DC	0x50C06000
            0x80E0	0x00
            0x80E4	0x00
            0x80E8	0x00
            0x80EC	0x00
            0x80F0	0x00
            0x80F4	0x10162800
            0x80F8	0x20400031
            0x80FC	0x54AC5300
            0x8100	0x00
            0x8104	0x00
            0x8108	0x00
            0x810C	0x00
            0x8110	0x00
            0x8124	0x4000003
            0x8128	0x4000004
            0x812C	0x00
            0x8130	0x00
            0x8134	0x00
            0x8138	0x00
            0x813C	0x00
            0x8140	0x00
            0x8144	0x00
            0x8148	0x00
            0x814C	0x00
            0x81A4	0x1D40020
            0x4280	0x0F>;
    };
};
