/* Copyright (c) 2017-2019, The Linux Foundation. All rights reserved.
 *
 * This program is free software; you can redistribute it and/or modify
 * it under the terms of the GNU General Public License version 2 and
 * only version 2 as published by the Free Software Foundation.
 *
 * This program is distributed in the hope that it will be useful,
 * but WITHOUT ANY WARRANTY; without even the implied warranty of
 * MERCHANTABILITY or FITNESS FOR A PARTICULAR PURPOSE.  See the
 * GNU General Public License for more details.
 */

&mdss_mdp {
	dsi_ili9881x_tm_hd_video: qcom,mdss_dsi_ili9881x_tm_hd_video {
		qcom,mdss-dsi-panel-name =
			"ili9881x video mode dsi tm panel ";
		qcom,mdss-dsi-panel-type = "dsi_video_mode";
		qcom,mdss-dsi-virtual-channel-id = <0>;
		qcom,mdss-dsi-stream = <0>;
		qcom,mdss-dsi-h-left-border = <0>;
		qcom,mdss-dsi-h-right-border = <0>;
		qcom,mdss-dsi-v-top-border = <0>;
		qcom,mdss-dsi-v-bottom-border = <0>;
		qcom,mdss-dsi-bpp = <24>;
		qcom,mdss-dsi-color-order = "rgb_swap_rgb";
		qcom,mdss-dsi-underflow-color = <0xff>;
		qcom,mdss-dsi-border-color = <0>;
		qcom,mdss-dsi-h-sync-pulse = <0>;
		qcom,mdss-dsi-traffic-mode = "non_burst_sync_event";
		qcom,mdss-dsi-lane-map = "lane_map_0123";
		qcom,mdss-dsi-bllp-eof-power-mode;
		qcom,mdss-dsi-bllp-power-mode;
		qcom,mdss-dsi-tx-eot-append;
		qcom,mdss-dsi-lane-0-state;
		qcom,mdss-dsi-lane-1-state;
		qcom,mdss-dsi-lane-2-state;
		qcom,mdss-dsi-lane-3-state;
		qcom,mdss-dsi-dma-trigger = "trigger_sw";
		qcom,mdss-dsi-mdp-trigger = "none";
		qcom,mdss-dsi-lp11-init;
		qcom,mdss-dsi-reset-sequence = <1 10>, <0 10>, <1 10>;
		qcom,tp-reset-enabled;
		qcom,mdss-dsi-tp-reset-sequence = <1 0>, <0 5>, <1 2>;
		qcom,mdss-pan-physical-width-dimension = <65>;
		qcom,mdss-pan-physical-height-dimension = <129>;
		qcom,esd-check-enabled;
		qcom,mdss-dsi-panel-status-check-mode = "reg_read";
		qcom,mdss-dsi-panel-status-command = [06 01 00 01 00 00 01 0a];
		qcom,mdss-dsi-panel-status-command-state = "dsi_hs_mode";
		qcom,mdss-dsi-panel-status-value = <0x9c>;
		qcom,mdss-dsi-panel-status-read-length = <1>;
		qcom,mdss-dsi-display-timings {
		timing@0 {
		        qcom,mdss-dsi-panel-width = <720>;
		        qcom,mdss-dsi-panel-height = <1600>;
		        qcom,mdss-dsi-h-front-porch = <50>;
		        qcom,mdss-dsi-h-back-porch = <50>;
		        qcom,mdss-dsi-h-pulse-width = <8>;
		        qcom,mdss-dsi-h-sync-skew = <0>;
		        qcom,mdss-dsi-v-back-porch = <16>;
		        qcom,mdss-dsi-v-front-porch = <190>;
		        qcom,mdss-dsi-v-pulse-width = <4>;
		        qcom,mdss-dsi-panel-framerate = <60>;
		        qcom,mdss-dsi-on-command = [
				  39 01 00 00 00 00 04 FF 98 81 00
				  39 01 00 00 00 00 03 51 0C C0
				  15 01 00 00 00 00 02 53 24
				  15 01 00 00 00 00 02 55 01
				  05 01 00 00 78 00 02 11 00
				  05 01 00 00 14 00 02 29 00];
		        qcom,mdss-dsi-off-command = [
			      05 01 00 00 32 00 02 28 00
			      05 01 00 00 96 00 02 10 00];
		        qcom,mdss-dsi-on-command-state = "dsi_lp_mode";
		        qcom,mdss-dsi-off-command-state = "dsi_hs_mode";
			qcom,mdss-dsi-cabc-ui-command = [15 01 00 00 00 00 02 55 01];
			qcom,mdss-dsi-cabc-ui-command-state = "dsi_hs_mode";
			qcom,mdss-dsi-cabc-mv-command = [15 01 00 00 00 00 02 55 03];
			qcom,mdss-dsi-cabc-mv-command-state = "dsi_hs_mode";
			qcom,mdss-dsi-cabc-dis-command = [15 01 00 00 00 00 02 55 00];
			qcom,mdss-dsi-cabc-dis-command-state = "dsi_hs_mode";
			qcom,mdss-dsi-hbm-on-command = [39 01 00 00 00 00 03 51 0F F0];
			qcom,mdss-dsi-hbm-on-command-state = "dsi_hs_mode";
			qcom,mdss-dsi-hbm-off-command = [39 01 00 00 00 00 03 51 0C C0];
			qcom,mdss-dsi-hbm-off-command-state = "dsi_hs_mode";
			qcom,mdss-dsi-hbm-type = "lcd-dcs-wled";
			};
		};
	};
};
