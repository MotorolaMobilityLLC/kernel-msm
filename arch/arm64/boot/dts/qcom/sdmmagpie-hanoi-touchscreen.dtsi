/* Copyright (c) 2018-2019, The Linux Foundation. All rights reserved.
 *
 * This program is free software; you can redistribute it and/or modify
 * it under the terms of the GNU General Public License version 2 and
 * only version 2 as published by the Free Software Foundation.
 *
 * This program is distributed in the hope that it will be useful,
 * but WITHOUT ANY WARRANTY; without even the implied warranty of
 * MERCHANTABILITY or FITNESS FOR A PARTICULAR PURPOSE.  See the
 * GNU General Public License for more details.
 */

&qupv3_se6_spi {
	status = "ok";
	ilitek@0{
		compatible = "tchip,ilitek";
		reg = <0x0>;
		poll_mode = <0>;
		spi-max-frequency = <12000000>;
		touch,reset-gpio = <&tlmm 8 0x00>;
		touch,irq-gpio = <&tlmm 9 0x2002>;
		ilitek,report_gesture_key;
	};
};
