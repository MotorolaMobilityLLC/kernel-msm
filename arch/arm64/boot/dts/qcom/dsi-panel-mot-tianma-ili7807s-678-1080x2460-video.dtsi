/* Copyright (c) 2018-2019, The Linux Foundation. All rights reserved.
 *
 * This program is free software; you can redistribute it and/or modify
 * it under the terms of the GNU General Public License version 2 and
 * only version 2 as published by the Free Software Foundation.
 *
 * This program is distributed in the hope that it will be useful,
 * but WITHOUT ANY WARRANTY; without even the implied warranty of
 * MERCHANTABILITY or FITNESS FOR A PARTICULAR PURPOSE.  See the
 * GNU General Public License for more details.
 */

&mdss_mdp {
	dsi_tm_ili7807s_678_fhd_video: qcom,mdss_dsi_tm_ili7807s_678_fhd_video {
		qcom,mdss-dsi-panel-name =
				"mipi_mot_vid_tm_ili7807s_fhd_678";
		qcom,mdss-dsi-panel-type = "dsi_video_mode";
		qcom,mdss-dsi-virtual-channel-id = <0>;
		qcom,mdss-dsi-stream = <0>;
		qcom,mdss-dsi-h-left-border = <0>;
		qcom,mdss-dsi-h-right-border = <0>;
		qcom,mdss-dsi-v-top-border = <0>;
		qcom,mdss-dsi-v-bottom-border = <0>;
		qcom,mdss-dsi-bpp = <24>;
		qcom,mdss-dsi-color-order = "rgb_swap_rgb";
		qcom,mdss-dsi-underflow-color = <0xfff>;
		qcom,mdss-dsi-border-color = <0>;
		qcom,mdss-dsi-h-sync-pulse = <0>;
		qcom,mdss-dsi-traffic-mode = "non_burst_sync_event";
		qcom,mdss-dsi-lane-map = "lane_map_0123";
		qcom,mdss-dsi-bllp-eof-power-mode;
		qcom,mdss-dsi-bllp-power-mode;
		qcom,mdss-dsi-tx-eot-append;
		qcom,mdss-dsi-lane-0-state;
		qcom,mdss-dsi-lane-1-state;
		qcom,mdss-dsi-lane-2-state;
		qcom,mdss-dsi-lane-3-state;
		qcom,mdss-dsi-dma-trigger = "trigger_sw";
		qcom,mdss-dsi-mdp-trigger = "none";
		qcom,mdss-dsi-lp11-init;
		qcom,mdss-dsi-reset-sequence = <1 10>, <0 50>, <1 100>;
		qcom,mdss-pan-physical-width-dimension = <69>;
		qcom,mdss-pan-physical-height-dimension = <158>;
		qcom,mdss-dsi-display-timings {
			timing@0 {
			qcom,mdss-dsi-panel-width = <1080>;
			qcom,mdss-dsi-panel-height = <2460>;
			qcom,mdss-dsi-h-front-porch = <28>;
			qcom,mdss-dsi-h-back-porch = <24>;
			qcom,mdss-dsi-h-pulse-width = <4>;
			qcom,mdss-dsi-h-sync-skew = <0>;
			qcom,mdss-dsi-v-back-porch = <12>;
			qcom,mdss-dsi-v-front-porch = <46>;
			qcom,mdss-dsi-v-pulse-width = <2>;
			qcom,mdss-dsi-panel-framerate = <120>;

			qcom,mdss-dsi-cabc-mv-command = [15 01 00 00 00 00 02 55 03];
			qcom,mdss-dsi-cabc-mv-command-state =  "dsi_hs_mode";
			qcom,mdss-dsi-cabc-ui-command = [15 01 00 00 00 00 02 55 01];
			qcom,mdss-dsi-cabc-ui-command-state =  "dsi_hs_mode";
			qcom,mdss-dsi-cabc-dis-command = [15 01 00 00 00 00 02 55 00];
			qcom,mdss-dsi-cabc-dis-command-state =  "dsi_hs_mode";
			qcom,mdss-dsi-hbm-on-command = [39 01 00 00 00 00 03 51 0F FF];
			qcom,mdss-dsi-hbm-on-command-state =  "dsi_hs_mode";
			qcom,mdss-dsi-hbm-off-command = [39 01 00 00 00 00 03 51 0F FF];
			qcom,mdss-dsi-hbm-off-command-state =  "dsi_hs_mode";

			qcom,mdss-dsi-on-command = [
				39 01 00 00 00 00 04 FF 78 07 00
				05 01 00 00 78 00 01 11
				05 01 00 00 14 00 01 29
				39 01 00 00 00 00 04 FF 78 07 06
				15 01 00 00 00 00 02 3E E3
				15 01 00 00 00 00 02 80 00
				39 01 00 00 00 00 04 FF 78 07 08
				39 01 00 00 00 00 03 FD 00 9F
				15 01 00 00 00 00 02 E1 D9
				39 01 00 00 00 00 03 FD 00 00
				39 01 00 00 00 00 04 FF 78 07 00
				39 01 00 00 00 00 03 51 0F FF
				15 01 00 00 00 00 02 53 2C
				15 01 00 00 00 00 02 55 01];
			qcom,mdss-dsi-off-command = [
				05 01 00 00 32 00 01 28
				05 01 00 00 96 00 01 10];
			qcom,mdss-dsi-on-command-state = "dsi_lp_mode";
			qcom,mdss-dsi-off-command-state = "dsi_hs_mode";

			qcom,compression-mode = "dsc";
			qcom,mdss-dsc-slice-height = <10>;
			qcom,mdss-dsc-slice-width = <540>;
			qcom,mdss-dsc-slice-per-pkt = <2>;
			qcom,mdss-dsc-bit-per-component = <8>;
			qcom,mdss-dsc-bit-per-pixel = <8>;
			qcom,mdss-dsc-block-prediction-enable;

			};
		};

	};
};
