/* Copyright (c) 2018-2019, The Linux Foundation. All rights reserved.
 *
 * This program is free software; you can redistribute it and/or modify
 * it under the terms of the GNU General Public License version 2 and
 * only version 2 as published by the Free Software Foundation.
 *
 * This program is distributed in the hope that it will be useful,
 * but WITHOUT ANY WARRANTY; without even the implied warranty of
 * MERCHANTABILITY or FITNESS FOR A PARTICULAR PURPOSE.  See the
 * GNU General Public License for more details.
 */

&mdss_mdp {
	dsi_tm_ili7807s_657_fhd_video: qcom,mdss_dsi_tm_ili7807s_657_fhd_video {
		qcom,mdss-dsi-panel-name =
				"mipi_mot_vid_tm_ili7807s_fhd_657";
		qcom,mdss-dsi-panel-type = "dsi_video_mode";
		qcom,mdss-dsi-virtual-channel-id = <0>;
		qcom,mdss-dsi-stream = <0>;
		qcom,mdss-dsi-h-left-border = <0>;
		qcom,mdss-dsi-h-right-border = <0>;
		qcom,mdss-dsi-v-top-border = <0>;
		qcom,mdss-dsi-v-bottom-border = <0>;
		qcom,mdss-dsi-bpp = <24>;
		qcom,mdss-dsi-color-order = "rgb_swap_rgb";
		qcom,mdss-dsi-underflow-color = <0xfff>;
		qcom,mdss-dsi-border-color = <0>;
		qcom,mdss-dsi-h-sync-pulse = <0>;
		qcom,mdss-dsi-traffic-mode = "non_burst_sync_event";
		qcom,mdss-dsi-lane-map = "lane_map_0123";
		qcom,mdss-dsi-bllp-eof-power-mode;
		qcom,mdss-dsi-bllp-power-mode;
		qcom,mdss-dsi-tx-eot-append;
		qcom,mdss-dsi-lane-0-state;
		qcom,mdss-dsi-lane-1-state;
		qcom,mdss-dsi-lane-2-state;
		qcom,mdss-dsi-lane-3-state;
		qcom,mdss-dsi-dma-trigger = "trigger_sw";
		qcom,mdss-dsi-mdp-trigger = "none";
		qcom,mdss-dsi-lp11-init;
		qcom,mdss-dsi-reset-sequence = <1 10>, <0 50>, <1 100>;
		qcom,mdss-pan-physical-width-dimension = <68>;
		qcom,mdss-pan-physical-height-dimension = <152>;
		qcom,mdss-dsi-display-timings {
			timing@0 {
			qcom,mdss-dsi-panel-width = <1080>;
			qcom,mdss-dsi-panel-height = <2400>;
			qcom,mdss-dsi-h-front-porch = <20>;
			qcom,mdss-dsi-h-back-porch = <16>;
			qcom,mdss-dsi-h-pulse-width = <4>;
			qcom,mdss-dsi-h-sync-skew = <0>;
			qcom,mdss-dsi-v-back-porch = <62>;
			qcom,mdss-dsi-v-front-porch = <60>;
			qcom,mdss-dsi-v-pulse-width = <4>;
			qcom,mdss-dsi-panel-framerate = <60>;
			qcom,mdss-dsi-on-command = [
				39 01 00 00 00 00 04 FF 78 07 01
				15 01 00 00 00 00 02 00 44
				15 01 00 00 00 00 02 01 01
				15 01 00 00 00 00 02 02 27
				15 01 00 00 00 00 02 03 2C
				15 01 00 00 00 00 02 04 00
				15 01 00 00 00 00 02 05 00
				15 01 00 00 00 00 02 06 00
				15 01 00 00 00 00 02 07 00
				15 01 00 00 00 00 02 08 82
				15 01 00 00 00 00 02 09 04
				15 01 00 00 00 00 02 0a 30
				15 01 00 00 00 00 02 0b 00
				15 01 00 00 00 00 02 0c 00
				15 01 00 00 00 00 02 0d 00
				15 01 00 00 00 00 02 0e 09
				15 01 00 00 00 00 02 31 07
				15 01 00 00 00 00 02 32 07
				15 01 00 00 00 00 02 33 07
				15 01 00 00 00 00 02 34 07
				15 01 00 00 00 00 02 35 07
				15 01 00 00 00 00 02 36 07
				15 01 00 00 00 00 02 37 2e
				15 01 00 00 00 00 02 38 2f
				15 01 00 00 00 00 02 39 30
				15 01 00 00 00 00 02 3a 2e
				15 01 00 00 00 00 02 3b 2f
				15 01 00 00 00 00 02 3c 30
				15 01 00 00 00 00 02 3d 40
				15 01 00 00 00 00 02 3e 08
				15 01 00 00 00 00 02 3f 13
				15 01 00 00 00 00 02 40 11
				15 01 00 00 00 00 02 41 12
				15 01 00 00 00 00 02 42 10
				15 01 00 00 00 00 02 43 00
				15 01 00 00 00 00 02 44 01
				15 01 00 00 00 00 02 45 07
				15 01 00 00 00 00 02 46 07
				15 01 00 00 00 00 02 47 28
				15 01 00 00 00 00 02 48 2c
				15 01 00 00 00 00 02 49 07
				15 01 00 00 00 00 02 4a 07
				15 01 00 00 00 00 02 4b 07
				15 01 00 00 00 00 02 4c 07
				15 01 00 00 00 00 02 4d 07
				15 01 00 00 00 00 02 4e 07
				15 01 00 00 00 00 02 4f 2e
				15 01 00 00 00 00 02 50 2f
				15 01 00 00 00 00 02 51 30
				15 01 00 00 00 00 02 52 2e
				15 01 00 00 00 00 02 53 2f
				15 01 00 00 00 00 02 54 30
				15 01 00 00 00 00 02 55 40
				15 01 00 00 00 00 02 56 08
				15 01 00 00 00 00 02 57 13
				15 01 00 00 00 00 02 58 11
				15 01 00 00 00 00 02 59 12
				15 01 00 00 00 00 02 5a 10
				15 01 00 00 00 00 02 5b 00
				15 01 00 00 00 00 02 5c 01
				15 01 00 00 00 00 02 5d 07
				15 01 00 00 00 00 02 5e 07
				15 01 00 00 00 00 02 5f 28
				15 01 00 00 00 00 02 60 2c
				15 01 00 00 00 00 02 61 07
				15 01 00 00 00 00 02 62 07
				15 01 00 00 00 00 02 63 07
				15 01 00 00 00 00 02 64 07
				15 01 00 00 00 00 02 65 07
				15 01 00 00 00 00 02 66 07
				15 01 00 00 00 00 02 67 2e
				15 01 00 00 00 00 02 68 2f
				15 01 00 00 00 00 02 69 30
				15 01 00 00 00 00 02 6a 2e
				15 01 00 00 00 00 02 6b 2f
				15 01 00 00 00 00 02 6c 30
				15 01 00 00 00 00 02 6d 40
				15 01 00 00 00 00 02 6e 08
				15 01 00 00 00 00 02 6f 12
				15 01 00 00 00 00 02 70 10
				15 01 00 00 00 00 02 71 13
				15 01 00 00 00 00 02 72 11
				15 01 00 00 00 00 02 73 00
				15 01 00 00 00 00 02 74 01
				15 01 00 00 00 00 02 75 07
				15 01 00 00 00 00 02 76 07
				15 01 00 00 00 00 02 77 28
				15 01 00 00 00 00 02 78 2c
				15 01 00 00 00 00 02 79 07
				15 01 00 00 00 00 02 7a 07
				15 01 00 00 00 00 02 7b 07
				15 01 00 00 00 00 02 7c 07
				15 01 00 00 00 00 02 7d 07
				15 01 00 00 00 00 02 7e 07
				15 01 00 00 00 00 02 7f 2e
				15 01 00 00 00 00 02 80 2f
				15 01 00 00 00 00 02 81 30
				15 01 00 00 00 00 02 82 2e
				15 01 00 00 00 00 02 83 2f
				15 01 00 00 00 00 02 84 30
				15 01 00 00 00 00 02 85 40
				15 01 00 00 00 00 02 86 08
				15 01 00 00 00 00 02 87 12
				15 01 00 00 00 00 02 88 10
				15 01 00 00 00 00 02 89 13
				15 01 00 00 00 00 02 8a 11
				15 01 00 00 00 00 02 8b 00
				15 01 00 00 00 00 02 8c 01
				15 01 00 00 00 00 02 8d 07
				15 01 00 00 00 00 02 8e 07
				15 01 00 00 00 00 02 8f 28
				15 01 00 00 00 00 02 90 2c
				15 01 00 00 00 00 02 B2 01
				15 01 00 00 00 00 02 c0 07
				15 01 00 00 00 00 02 c1 00
				15 01 00 00 00 00 02 c2 00
				15 01 00 00 00 00 02 c3 50
				15 01 00 00 00 00 02 c4 00
				15 01 00 00 00 00 02 c5 2b
				15 01 00 00 00 00 02 c6 28
				15 01 00 00 00 00 02 c7 28
				15 01 00 00 00 00 02 c8 00
				15 01 00 00 00 00 02 c9 00
				15 01 00 00 00 00 02 ca 01
				15 01 00 00 00 00 02 d0 01
				15 01 00 00 00 00 02 d1 12
				15 01 00 00 00 00 02 d2 00
				15 01 00 00 00 00 02 d3 41
				15 01 00 00 00 00 02 d4 04
				15 01 00 00 00 00 02 d5 22
				15 01 00 00 00 00 02 d6 41
				15 01 00 00 00 00 02 d7 00
				15 01 00 00 00 00 02 d8 60
				15 01 00 00 00 00 02 d9 a5
				15 01 00 00 00 00 02 da 00
				15 01 00 00 00 00 02 db 00
				15 01 00 00 00 00 02 dc 00
				15 01 00 00 00 00 02 dd 18
				15 01 00 00 00 00 02 de 01
				15 01 00 00 00 00 02 df 60
				15 01 00 00 00 00 02 e0 08
				15 01 00 00 00 00 02 e1 00
				15 01 00 00 00 00 02 e2 03
				15 01 00 00 00 00 02 e3 00
				15 01 00 00 00 00 02 e4 21
				15 01 00 00 00 00 02 e5 0f
				15 01 00 00 00 00 02 e6 22
				15 01 00 00 00 00 02 ee 01
				39 01 00 00 00 00 04 FF 78 07 11
				15 01 00 00 00 00 02 00 00
				15 01 00 00 00 00 02 01 09
				39 01 00 00 00 00 04 FF 78 07 02
				15 01 00 00 00 00 02 36 00
				15 01 00 00 00 00 02 40 00
				15 01 00 00 00 00 02 41 00
				15 01 00 00 00 00 02 42 09
				15 01 00 00 00 00 02 43 34
				15 01 00 00 00 00 02 75 00
				15 01 00 00 00 00 02 46 42
				15 01 00 00 00 00 02 47 03
				15 01 00 00 00 00 02 01 55
				15 01 00 00 00 00 02 81 33
				15 01 00 00 00 00 02 82 02
				15 01 00 00 00 00 02 1B 02
				15 01 00 00 00 00 02 06 6A
				15 01 00 00 00 00 02 0E 3E
				15 01 00 00 00 00 02 0F 3C
				39 01 00 00 00 00 04 FF 78 07 12
				15 01 00 00 00 00 02 10 01
				15 01 00 00 00 00 02 11 00
				15 01 00 00 00 00 02 12 09
				15 01 00 00 00 00 02 13 14
				15 01 00 00 00 00 02 1E 01
				15 01 00 00 00 00 02 16 0B
				15 01 00 00 00 00 02 17 00
				15 01 00 00 00 00 02 1A 13
				15 01 00 00 00 00 02 1B 22
				15 01 00 00 00 00 02 06 D6
				15 01 00 00 00 00 02 0E 1A
				15 01 00 00 00 00 02 0F 25
				39 01 00 00 00 00 04 FF 78 07 04
				15 01 00 00 00 00 02 B7 CF
				15 01 00 00 00 00 02 B8 45
				15 01 00 00 00 00 02 BA 74
				39 01 00 00 00 00 04 FF 78 07 05
				15 01 00 00 00 00 02 1B 00
				15 01 00 00 00 00 02 1C 88
				15 01 00 00 00 00 02 61 CB
				15 01 00 00 00 00 02 64 EF
				15 01 00 00 00 00 02 6E 3F
				15 01 00 00 00 00 02 69 02
				15 01 00 00 00 00 02 70 C8
				15 01 00 00 00 00 02 72 6A
				15 01 00 00 00 00 02 73 1C
				15 01 00 00 00 00 02 74 55
				15 01 00 00 00 00 02 76 79
				15 01 00 00 00 00 02 7A 42
				15 01 00 00 00 00 02 7B 6A
				15 01 00 00 00 00 02 7C 6A
				15 01 00 00 00 00 02 B5 50
				15 01 00 00 00 00 02 B7 70
				15 01 00 00 00 00 02 C9 90
				39 01 00 00 00 00 04 FF 78 07 06
				15 01 00 00 00 00 02 3E E2
				15 01 00 00 00 00 02 C0 60
				15 01 00 00 00 00 02 C1 19
				15 01 00 00 00 00 02 C3 06
				15 01 00 00 00 00 02 D6 00
				15 01 00 00 00 00 02 CD 00
				15 01 00 00 00 00 02 96 50
				39 01 00 00 00 00 04 FF 78 07 07
				15 01 00 00 00 00 02 29 CE
				39 01 00 00 00 00 04 FF 78 07 08
				39 01 00 00 00 00 03 FD 00 9F
				15 01 00 00 00 00 02 E1 D9
				39 01 00 00 00 00 03 FD 00 00
				39 01 00 00 00 00 04 FF 78 07 17
				39 01 00 00 00 00 04 FF 78 07 0B
				15 01 00 00 00 00 02 94 88
				15 01 00 00 00 00 02 95 1D
				15 01 00 00 00 00 02 96 06
				15 01 00 00 00 00 02 97 06
				15 01 00 00 00 00 02 98 CB
				15 01 00 00 00 00 02 99 CB
				15 01 00 00 00 00 02 9A 06
				15 01 00 00 00 00 02 9B C8
				15 01 00 00 00 00 02 9C 05
				15 01 00 00 00 00 02 9D 05
				15 01 00 00 00 00 02 9E A9
				15 01 00 00 00 00 02 9F A9
				15 01 00 00 00 00 02 AB E0
				39 01 00 00 00 00 04 FF 78 07 0C
				15 01 00 00 00 00 02 80 2B
				15 01 00 00 00 00 02 81 CA
				15 01 00 00 00 00 02 82 2A
				15 01 00 00 00 00 02 83 C3
				15 01 00 00 00 00 02 84 2A
				15 01 00 00 00 00 02 85 C3
				15 01 00 00 00 00 02 86 29
				15 01 00 00 00 00 02 87 BE
				15 01 00 00 00 00 02 88 29
				15 01 00 00 00 00 02 89 BF
				15 01 00 00 00 00 02 8A 2B
				15 01 00 00 00 00 02 8B CB
				15 01 00 00 00 00 02 8C 2A
				15 01 00 00 00 00 02 8D C9
				15 01 00 00 00 00 02 8E 28
				15 01 00 00 00 00 02 8F B1
				15 01 00 00 00 00 02 90 2A
				15 01 00 00 00 00 02 91 C2
				15 01 00 00 00 00 02 92 2A
				15 01 00 00 00 00 02 93 C1
				15 01 00 00 00 00 02 94 29
				15 01 00 00 00 00 02 95 BC
				15 01 00 00 00 00 02 96 2A
				15 01 00 00 00 00 02 97 C4
				15 01 00 00 00 00 02 98 2A
				15 01 00 00 00 00 02 99 C8
				15 01 00 00 00 00 02 9A 28
				15 01 00 00 00 00 02 9B B0
				15 01 00 00 00 00 02 9C 29
				15 01 00 00 00 00 02 9D B8
				15 01 00 00 00 00 02 9E 2A
				15 01 00 00 00 00 02 9F C6
				15 01 00 00 00 00 02 A0 29
				15 01 00 00 00 00 02 A1 BD
				15 01 00 00 00 00 02 A2 28
				15 01 00 00 00 00 02 A3 B2
				15 01 00 00 00 00 02 A4 28
				15 01 00 00 00 00 02 A5 AD
				15 01 00 00 00 00 02 A6 29
				15 01 00 00 00 00 02 A7 B7
				15 01 00 00 00 00 02 A8 28
				15 01 00 00 00 00 02 A9 B5
				15 01 00 00 00 00 02 AA 29
				15 01 00 00 00 00 02 AB B6
				15 01 00 00 00 00 02 AC 28
				15 01 00 00 00 00 02 AD B3
				15 01 00 00 00 00 02 AE 2A
				15 01 00 00 00 00 02 AF C0
				15 01 00 00 00 00 02 B0 29
				15 01 00 00 00 00 02 B1 B9
				15 01 00 00 00 00 02 B2 28
				15 01 00 00 00 00 02 B3 AF
				15 01 00 00 00 00 02 B4 28
				15 01 00 00 00 00 02 B5 AB
				15 01 00 00 00 00 02 B6 2A
				15 01 00 00 00 00 02 B7 C7
				15 01 00 00 00 00 02 B8 28
				15 01 00 00 00 00 02 B9 B4
				15 01 00 00 00 00 02 BA 29
				15 01 00 00 00 00 02 BB BB
				15 01 00 00 00 00 02 BC 28
				15 01 00 00 00 00 02 BD AE
				15 01 00 00 00 00 02 BE 28
				15 01 00 00 00 00 02 BF AC
				39 01 00 00 00 00 04 FF 78 07 0E
				15 01 00 00 00 00 02 00 A3
				15 01 00 00 00 00 02 02 0F
				15 01 00 00 00 00 02 04 07
				15 01 00 00 00 00 02 B9 CC
				15 01 00 00 00 00 02 40 07
				15 01 00 00 00 00 02 47 10
				15 01 00 00 00 00 02 49 2D
				15 01 00 00 00 00 02 45 0A
				15 01 00 00 00 00 02 46 EC
				15 01 00 00 00 00 02 4D C2
				15 01 00 00 00 00 02 1C 27
				15 01 00 00 00 00 02 1D F5
				15 01 00 00 00 00 02 C0 34
				15 01 00 00 00 00 02 21 85
				15 01 00 00 00 00 02 23 85
				15 01 00 00 00 00 02 2B 1F
				15 01 00 00 00 00 02 05 20
				15 01 00 00 00 00 02 B0 31
				15 01 00 00 00 00 02 41 44
				15 01 00 00 00 00 02 4B 1F
				15 01 00 00 00 00 02 C6 61
				15 01 00 00 00 00 02 C7 61
				15 01 00 00 00 00 02 C8 61
				15 01 00 00 00 00 02 C9 61
				39 01 00 00 00 00 04 FF 78 07 00
				05 01 00 00 78 00 02 11 00
				05 01 00 00 14 00 02 29 00];
			qcom,mdss-dsi-off-command = [
				05 01 00 00 32 00 02 28 00
				05 01 00 00 96 00 02 10 00];
			qcom,mdss-dsi-on-command-state = "dsi_lp_mode";
			qcom,mdss-dsi-off-command-state = "dsi_hs_mode";

			qcom,mdss-dsi-cabc-mv-command = [15 01 00 00 00 00 02 55 03];
			qcom,mdss-dsi-cabc-mv-command-state =  "dsi_hs_mode";
			qcom,mdss-dsi-cabc-ui-command = [15 01 00 00 00 00 02 55 01];
			qcom,mdss-dsi-cabc-ui-command-state =  "dsi_hs_mode";
			qcom,mdss-dsi-cabc-dis-command = [15 01 00 00 00 00 02 55 00];
			qcom,mdss-dsi-cabc-dis-command-state =  "dsi_hs_mode";
			qcom,mdss-dsi-hbm-on-command = [15 01 00 00 00 00 02 51 FF];
			qcom,mdss-dsi-hbm-on-command-state =  "dsi_hs_mode";
			qcom,mdss-dsi-hbm-off-command = [15 01 00 00 00 00 02 51 CC];
			qcom,mdss-dsi-hbm-off-command-state =  "dsi_hs_mode";
			};
		};

	};
};
