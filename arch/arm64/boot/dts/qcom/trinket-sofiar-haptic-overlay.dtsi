&qupv3_se1_i2c {
	status = "ok";
	aw8624_haptic@5A {
		compatible = "awinic,aw8624_haptic";
		reg = <0x5A>;
		reset-gpio = <&pmi632_gpios 4 0>;
		ram-update-delay;

		vib_f0_pre = < 2350 >;
		vib_f0_cali_percen = < 7 >;
		vib_cont_drv_lev = < 125 >;
		vib_cont_drv_lvl_ov = < 155 >;
		vib_cont_td = < 0xF06C >;
		vib_cont_zc_thr = < 0x08F8 >;  /*hq 0x08F8 */
		vib_cont_num_brk = < 3 >;
		vib_f0_coeff = < 260 >; /*Don't modify it*/
		vib_duration_time = < 15 60 0 0 0 >;
		vib_brake_ram_config = < 1 1 90 60 20 3 1 3    1 1 90 60 30 5 1 3    0 0 50 40 25 0 5 3 >;
		vib_brake_cont_config = < 1 1 90 42 20 5 2 2 0 0 0  0  0  0 0 0 0 0 0   0  0  0 0 0 >;
		vib_f0_trace_parameter = < 9 3 1 31 >;
		vib_bemf_config = < 0x10 0x08 0x23 0xf8 >;
		vib_sw_brake = < 0x08 >;
		vib_wavseq = < 0 1 1 2 2 3 3 4 0 0 0 0 0 0 0 0 >; /*wavseq1-seq8 0x07-0x0E*/
		vib_wavloop = < 0 6 1 15 0 0 0 0 0 0>;/*loop1-mainloog 0x0f-0x13*/
		vib_td_brake = < 42720 42720 42720 >; /*level0  level1  level2*/
		vib_tset = < 0x11 >;
		vib_func_parameter1 = < 1000 >;
		vib_ram_config = < 1 >; /* brake using the wave in the ram*/
		vib_vbat_comp = < 1 >; /* control the vbat comp*/
		status = "ok";
	};
};

&pmi632_vib {
	status = "disabled";
};
