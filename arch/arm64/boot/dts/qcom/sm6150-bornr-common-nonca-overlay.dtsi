/* Copyright (c) 2020, The Linux Foundation. All rights reserved.
 *
 * This program is free software; you can redistribute it and/or modify
 * it under the terms of the GNU General Public License version 2 and
 * only version 2 as published by the Free Software Foundation.
 *
 * This program is distributed in the hope that it will be useful,
 * but WITHOUT ANY WARRANTY; without even the implied warranty of
 * MERCHANTABILITY or FITNESS FOR A PARTICULAR PURPOSE.  See the
 * GNU General Public License for more details.
 */

#include "sm6150-bornr-common-overlay.dtsi"

/* Add differences of NON-CA overlays base on CA here */
&qupv3_se1_i2c {
	abov_sar@20 {
		cap,use_channel_ch0 = <0x00>;
		cap,use_channel_ch1 = <0x01>;
		ch0_name ="capsense_bottom";
		ch1_name ="capsense_top";
		label = "AbovCapSenseNOCA";
		cap,channel_number = <0x02>;
	};
};

