/* Copyright (c) 2018, The Linux Foundation. All rights reserved.
 *
 * This program is free software; you can redistribute it and/or modify
 * it under the terms of the GNU General Public License version 2 and
 * only version 2 as published by the Free Software Foundation.
 *
 * This program is distributed in the hope that it will be useful,
 * but WITHOUT ANY WARRANTY; without even the implied warranty of
 * MERCHANTABILITY or FITNESS FOR A PARTICULAR PURPOSE.  See the
 * GNU General Public License for more details.
 */

&mdss_mdp {
	mot_boe_269_800x600_cmd_v0: qcom,mdss_dsi_mot_boe_269_800x600_cmd_v0 {
		#include "dsi-panel-mot-boe-269-800x600-olson-cmd-common.dtsi"
	};
	mot_boe_269_800x600_cmd_v1: qcom,mdss_dsi_mot_boe_269_800x600_cmd_v1 {
		#include "dsi-panel-mot-boe-269-800x600-olson-cmd-common.dtsi"
	};
	mot_boe_269_800x600_cmd_v2: qcom,mdss_dsi_mot_boe_269_800x600_cmd_v2 {
		#include "dsi-panel-mot-boe-269-800x600-olson-cmd-common.dtsi"
	};
};
