/* Copyright (c) 2018, The Linux Foundation. All rights reserved.
 *
 * This program is free software; you can redistribute it and/or modify
 * it under the terms of the GNU General Public License version 2 and
 * only version 2 as published by the Free Software Foundation.
 *
 * This program is distributed in the hope that it will be useful,
 * but WITHOUT ANY WARRANTY; without even the implied warranty of
 * MERCHANTABILITY or FITNESS FOR A PARTICULAR PURPOSE.  See the
 * GNU General Public License for more details.
 */

&qupv3_se1_i2c {
	status = "ok";
	abov_sar@20 { /* SAR sensor */
		status =  "okay";
		compatible = "abov,abov_sar";
		reg = <0x20>;
		cap_vdd-supply = <&pm6125_l21>;
		interrupt-parent = <&tlmm>;
		interrupts = <82 0x02>;
		gpios = <&tlmm 82 0x2>;
		interrupt-names = "abov_irq";
		reg_array_len = <0x03>;
		reg_array_val = <0x07 0x00 0x08 0x1F 0xFB 0x01>;
		cap,use_channel_bottom_lmb = <0x00>;
		cap,use_channel_bottom_hb = <0x01>;
		cap,use_channel_top = <0x02>;
		label = "AbovCapSense";
	};
};
