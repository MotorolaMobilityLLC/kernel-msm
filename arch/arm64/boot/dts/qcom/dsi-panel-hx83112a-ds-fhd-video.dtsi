/* Copyright (c) 2018-2019, The Linux Foundation. All rights reserved.
 *
 * This program is free software; you can redistribute it and/or modify
 * it under the terms of the GNU General Public License version 2 and
 * only version 2 as published by the Free Software Foundation.
 *
 * This program is distributed in the hope that it will be useful,
 * but WITHOUT ANY WARRANTY; without even the implied warranty of
 * MERCHANTABILITY or FITNESS FOR A PARTICULAR PURPOSE.  See the
 * GNU General Public License for more details.
 */

&mdss_mdp {
	dsi_hx83112a_ds_video: qcom,mdss_dsi_hx83112a_ds_video {
		qcom,mdss-dsi-panel-name =
				"mipi_mot_vid_ds_1080p_630";
		qcom,mdss-dsi-panel-type = "dsi_video_mode";

		qcom,mdss-dsi-virtual-channel-id = <0>;
		qcom,mdss-dsi-stream = <0>;
		qcom,mdss-dsi-h-left-border = <0>;
		qcom,mdss-dsi-h-right-border = <0>;
		qcom,mdss-dsi-v-top-border = <0>;
		qcom,mdss-dsi-v-bottom-border = <0>;
		qcom,mdss-dsi-bpp = <24>;
		qcom,mdss-dsi-color-order = "rgb_swap_rgb";
		qcom,mdss-dsi-underflow-color = <0xff>;
		qcom,mdss-dsi-border-color = <0>;
		qcom,mdss-dsi-h-sync-pulse = <0>;
		qcom,mdss-dsi-traffic-mode = "non_burst_sync_event";
		qcom,mdss-dsi-lane-map = "lane_map_0123";
		qcom,mdss-dsi-bllp-eof-power-mode;
		qcom,mdss-dsi-bllp-power-mode;
		qcom,mdss-dsi-tx-eot-append;
		qcom,mdss-dsi-lane-0-state;
		qcom,mdss-dsi-lane-1-state;
		qcom,mdss-dsi-lane-2-state;
		qcom,mdss-dsi-lane-3-state;
		qcom,mdss-dsi-dma-trigger = "trigger_sw";
		qcom,mdss-dsi-mdp-trigger = "none";
		qcom,mdss-dsi-lp11-init;
		qcom,mdss-dsi-bl-pmic-control-type = "bl_ctrl_dcs";
		qcom,mdss-dsi-bl-min-level = <1>;
		qcom,mdss-dsi-bl-max-level = <4095>;
		qcom,mdss-dsi-reset-sequence = <1 10>, <0 10>, <1 30>;
		qcom,tp_state_check_enable;
		/*
		qcom,mdss-pan-physical-width-dimension = <65>;
		qcom,mdss-pan-physical-height-dimension = <129>;
		*/
		qcom,mdss-dsi-display-timings {
			timing@0 {
				qcom,mdss-dsi-panel-width = <1080>;
				qcom,mdss-dsi-panel-height = <2280>;
				qcom,mdss-dsi-h-front-porch = <20>;
				qcom,mdss-dsi-h-back-porch = <14>;
				qcom,mdss-dsi-h-pulse-width = <4>;
				qcom,mdss-dsi-h-sync-skew = <4>;
				qcom,mdss-dsi-v-back-porch = <5>;
				qcom,mdss-dsi-v-front-porch = <40>;
				qcom,mdss-dsi-v-pulse-width = <5>;
				qcom,mdss-dsi-panel-framerate = <60>;
				qcom,mdss-dsi-on-command =
				[
					39 01 00 00 00 00 04 B9 83 11 2A
					39 01 00 00 00 00 05 CF 00 14 00 C0
					15 01 00 00 00 00 02 BD 02
					39 01 00 00 00 00 03 B4 34 92
					15 01 00 00 00 00 02 BD 00
					15 01 00 00 00 00 02 BD 01
					39 01 00 00 00 00 2A E4 00 77 00 00 00 00 00 00 00 00
                                                             00 00 00 00 00 00 00 00 00 00 00
                                                             00 00 00 00 00 00 00 00 00 00 00
                                                             00 54 55 55 55 55 55 55 55
					15 01 00 00 00 00 02 BD 00
					15 01 00 00 28 00 02 11 00
					39 01 00 00 00 00 03 51 00 00
					15 01 00 00 00 00 02 53 2C
					15 01 00 00 00 00 02 55 01
					39 01 00 00 00 00 17 E4 2C 01 2C 00 08 00 10 08 04 04
                                                             9A 9A 9A 9A 9A BB DB FF FF FF FF EF
					15 01 00 00 3C 00 02 29 00

				];
				qcom,mdss-dsi-off-command = [
					15 01 00 00 32 00 02 28 00
					15 01 00 00 64 00 02 10 00
				];
				qcom,mdss-dsi-off-not-sleep-command = [
					39 01 00 00 00 00 04 B9 83 11 2A
					39 01 00 00 00 00 02 BD 01
					39 01 00 00 00 00 04 B2 00 00 00
					39 01 00 00 00 00 02 CF FF
				];
				qcom,mdss-dsi-t-clk-post = <0x0E>;
				qcom,mdss-dsi-t-clk-pre = <0x33>;
				qcom,mdss-dsi-on-command-state = "dsi_lp_mode";
				qcom,mdss-dsi-off-command-state = "dsi_hs_mode";
				qcom,mdss-dsi-off-not-sleep-command-state = "dsi_hs_mode";
				qcom,mdss-dsi-cabc-mv-command = [15 01 00 00 00 00 02 55 03
                                                                 39 01 00 00 00 00 17 E4 2C 01 2C 00 08 00 10 08 04 04 FF
                                                                                      FF FF FF FF 66 66 E2 FF AA FE EF];
				qcom,mdss-dsi-cabc-mv-command-state =  "dsi_hs_mode";
				qcom,mdss-dsi-cabc-ui-command = [15 01 00 00 00 00 02 55 01
                                                                 39 01 00 00 00 00 17 E4 2C 01 2C 00 08 00 10 08 04 04 9A
                                                                                      9A 9A 9A 9A BB DB FF FF FF FF EF ];
				qcom,mdss-dsi-cabc-ui-command-state =  "dsi_hs_mode";
				qcom,mdss-dsi-cabc-dis-command = [15 01 00 00 00 00 02 55 00];
				qcom,mdss-dsi-cabc-dis-command-state =  "dsi_hs_mode";
				//acturlly hbm is impliemented by controlling gpio. add this commond just enable HBM feature.
				qcom,mdss-dsi-hbm-on-command = [01];
				qcom,mdss-dsi-hbm-on-command-state =  "dsi_ls_mode";
				qcom,mdss-dsi-hbm-off-command = [00];
				qcom,mdss-dsi-hbm-off-command-state =  "dsi_ls_mode";
			};
		};
	};
};

