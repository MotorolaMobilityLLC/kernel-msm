&qupv3_se1_i2c {
	status = "ok";
	aw8695_haptic@5A {
	    compatible = "awinic,aw8695_haptic";
	    reg = <0x5A>;
	    reset-gpio = <&pmi632_gpios 4 0>;
	    irq-gpio = <&tlmm 89 0>;
	    haptic-context-gpio = <&tlmm 118 0>;
	    long-gain-normal = <0x80>;
	    long-gain-reduced = <0x80>;
	    status = "okay";
	};
};
