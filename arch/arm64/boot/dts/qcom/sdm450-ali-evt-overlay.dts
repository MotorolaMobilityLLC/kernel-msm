/* Copyright (c) 2018, The Linux Foundation. All rights reserved.
 *
 * This program is free software; you can redistribute it and/or modify
 * it under the terms of the GNU General Public License version 2 and
 * only version 2 as published by the Free Software Foundation.
 *
 * This program is distributed in the hope that it will be useful,
 * but WITHOUT ANY WARRANTY; without even the implied warranty of
 * MERCHANTABILITY or FITNESS FOR A PARTICULAR PURPOSE.  See the
 * GNU General Public License for more details.
 */

/dts-v1/;
/plugin/;

#include <dt-bindings/clock/msm-clocks-8953.h>

#include "sdm450-ali-common-overlay.dtsi"

/ {
	model = "ali";
	compatible = "ali,evt1";
	qcom,msm-id = <338 0x0>;
	qcom,board-id = <0x41 0xA100>;
};

/*
 * Ali HW rev EVT0 specific changes go here
 */
