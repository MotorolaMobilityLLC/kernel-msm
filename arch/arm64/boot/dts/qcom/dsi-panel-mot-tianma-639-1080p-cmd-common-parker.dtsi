/* Copyright (c) 2016-2018, The Linux Foundation. All rights reserved.
 *
 * This program is free software; you can redistribute it and/or modify
 * it under the terms of the GNU General Public License version 2 and
 * only version 2 as published by the Free Software Foundation.
 *
 * This program is distributed in the hope that it will be useful,
 * but WITHOUT ANY WARRANTY; without even the implied warranty of
 * MERCHANTABILITY or FITNESS FOR A PARTICULAR PURPOSE.  See the
 * GNU General Public License for more details.
 */

compatible = "qcom,mdss-dsi-panel";
qcom,mdss-dsi-panel-name = "mipi_mot_cmd_tianma_1080p_639";
qcom,mdss-dsi-panel-supplier = "smd";
qcom,mdss-dsi-panel-type = "dsi_cmd_mode";
qcom,mdss-dsi-virtual-channel-id = <0>;
qcom,mdss-dsi-stream = <0>;
qcom,mdss-pan-physical-width-dimension = <68>;
qcom,mdss-pan-physical-height-dimension = <147>;
qcom,mdss-dsi-bpp = <24>;
qcom,mdss-dsi-underflow-color = <0xff>;
qcom,mdss-dsi-border-color = <0>;

qcom,mdss-dsi-traffic-mode = "burst_mode";
qcom,mdss-dsi-bllp-eof-power-mode;
qcom,mdss-dsi-bllp-power-mode;
qcom,mdss-dsi-lane-0-state;
qcom,mdss-dsi-lane-1-state;
qcom,mdss-dsi-lane-2-state;
qcom,mdss-dsi-lane-3-state;

qcom,mdss-dsi-dma-trigger = "trigger_sw";
qcom,mdss-dsi-mdp-trigger = "none";
qcom,mdss-dsi-reset-sequence = <0 10>, <1 10>;
qcom,mdss-dsi-lp11-init;
qcom,mdss-dsi-tx-eot-append;

qcom,mdss-dsi-te-pin-select = <1>;
qcom,mdss-dsi-te-dcs-command = <1>;
qcom,mdss-dsi-te-check-enable;
qcom,mdss-dsi-te-using-te-pin;

qcom,bklt-dcs-2bytes-enabled;
qcom,mdss-dsi-bl-min-level = <2>;
qcom,mdss-dsi-bl-max-level = <2936>;
qcom,mdss-dsi-bl-pmic-control-type = "bl_ctrl_dcs";

qcom,mdss-dsi-hbm-type = "tianma_oled_lhbm_dcs_gpio";
qcom,mdss-dsi-hbm-fod-on-command = [
		29 01 00 00 00 00 02 B0 80
		29 01 00 00 00 00 02 F1 81
		29 01 00 00 00 00 27 D1 60 96 B2 C3 C9 DA D1 24 F6 68 22 7B 38 B9 3F B3 F4 1F 5A CA CE 32 6B A7 99 D8 D3 8C EC 59 E6 FE D0 D2 7F 00 C0 03];

qcom,mdss-dsi-hbm-on-command = [
		39 01 00 00 00 00 03 51 0F FF];

qcom,mdss-dsi-hbm-off-command = [
		39 01 00 00 00 00 03 51 09 D3];

qcom,mdss-dsi-acl-on-command = [
		15 01 00 00 00 00 02 55 03];
qcom,mdss-dsi-acl-off-command = [
		15 01 00 00 00 00 02 55 00];

qcom,mdss-dsi-panel-hdr-enabled;
qcom,mdss-dsi-panel-hdr-color-primaries = <14500 15500 32000
			17000 15500 30000 8000 3000>;
qcom,mdss-dsi-panel-peak-brightness = <4300000>;
qcom,mdss-dsi-panel-blackness-level = <3230>;


qcom,mdss-dsi-display-timings {
	timing@0{
		qcom,mdss-dsi-panel-width = <1080>;
		qcom,mdss-dsi-panel-height = <2340>;
		qcom,mdss-dsi-h-front-porch = <4>;
		qcom,mdss-dsi-h-back-porch = <4>;
		qcom,mdss-dsi-h-pulse-width = <4>;
		qcom,mdss-dsi-h-sync-skew = <0>;
		qcom,mdss-dsi-h-sync-pulse = <0>;
		qcom,mdss-dsi-v-back-porch = <4>;
		qcom,mdss-dsi-v-front-porch = <8>;
		qcom,mdss-dsi-v-pulse-width = <4>;
		qcom,mdss-dsi-panel-framerate = <60>;
		qcom,mdss-dsi-h-left-border = <0>;
		qcom,mdss-dsi-h-right-border = <0>;
		qcom,mdss-dsi-v-top-border = <0>;
		qcom,mdss-dsi-v-bottom-border = <0>;
		qcom,mdss-dsi-on-command = [
			15 00 00 00 00 00 02 35 00
			15 00 00 00 00 00 02 53 24
			15 00 00 00 00 00 02 55 00
			39 00 00 00 00 00 03 51 00 00
			05 01 00 00 00 00 01 29
			05 01 00 00 96 00 01 11	/* display on */
			29 01 00 00 00 00 02 B0 80
			29 01 00 00 00 00 02 F1 81
			29 01 00 00 00 00 27 D1 60 96 6D 6B 49 B8 A1 64 E7 50 C2 73 2D A9 3C B3 6C 1E 5A B6 6D 34 E1 86 9A 9D 43 0D CF 8D A6 F2 D0 B2 79 00 C0 03
			29 01 00 00 00 00 02 E6 01];
		qcom,mdss-dsi-off-command = [
			05 01 00 00 00 00 01 28		/* display_off */
			05 01 00 00 96 00 01 10];	/* enter sleep mode */

		qcom,mdss-dsi-on-command-state = "dsi_lp_mode";
		qcom,mdss-dsi-off-command-state = "dsi_lp_mode";
		qcom,mdss-dsi-force-tx-mode = "dsi_hs_mode";
	};

};
