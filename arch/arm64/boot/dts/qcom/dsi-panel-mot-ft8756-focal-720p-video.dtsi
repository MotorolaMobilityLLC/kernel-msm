/* Copyright (c) 2018-2019, The Linux Foundation. All rights reserved.
 *
 * This program is free software; you can redistribute it and/or modify
 * it under the terms of the GNU General Public License version 2 and
 * only version 2 as published by the Free Software Foundation.
 *
 * This program is distributed in the hope that it will be useful,
 * but WITHOUT ANY WARRANTY; without even the implied warranty of
 * MERCHANTABILITY or FITNESS FOR A PARTICULAR PURPOSE.  See the
 * GNU General Public License for more details.
 */

&mdss_mdp {
	dsi_ft8756_focal_video: qcom,mdss_dsi_ft8756_focal_video {
		qcom,mdss-dsi-panel-name =
				"ft8756 focal video mode dsi panel";
		qcom,mdss-dsi-panel-type = "dsi_video_mode";

		qcom,mdss-dsi-virtual-channel-id = <0>;
		qcom,mdss-dsi-stream = <0>;
		qcom,mdss-dsi-h-left-border = <0>;
		qcom,mdss-dsi-h-right-border = <0>;
		qcom,mdss-dsi-v-top-border = <0>;
		qcom,mdss-dsi-v-bottom-border = <0>;
		qcom,mdss-dsi-bpp = <24>;
		qcom,mdss-dsi-color-order = "rgb_swap_rgb";
		qcom,mdss-dsi-underflow-color = <0xff>;
		qcom,mdss-dsi-border-color = <0>;
		qcom,mdss-dsi-h-sync-pulse = <0>;
		qcom,mdss-dsi-traffic-mode = "non_burst_sync_event";
		qcom,mdss-dsi-lane-map = "lane_map_0123";
		qcom,mdss-dsi-bllp-eof-power-mode;
		qcom,mdss-dsi-bllp-power-mode;
		qcom,mdss-dsi-tx-eot-append;
		qcom,mdss-dsi-lane-0-state;
		qcom,mdss-dsi-lane-1-state;
		qcom,mdss-dsi-lane-2-state;
		qcom,mdss-dsi-lane-3-state;
		qcom,mdss-dsi-dma-trigger = "trigger_sw";
		qcom,mdss-dsi-mdp-trigger = "none";
		qcom,mdss-dsi-lp11-init;
		qcom,mdss-dsi-bl-pmic-control-type = "bl_ctrl_wled";
		qcom,mdss-dsi-bl-min-level = <1>;
		qcom,mdss-dsi-bl-max-level = <4095>;
		qcom,mdss-dsi-reset-sequence = <1 10>, <0 10>, <1 10>;
		/*
		qcom,mdss-pan-physical-width-dimension = <65>;
		qcom,mdss-pan-physical-height-dimension = <129>;
		*/
		qcom,mdss-dsi-display-timings {
			timing@0 {
				qcom,mdss-dsi-panel-width = <720>;
				qcom,mdss-dsi-panel-height = <1544>;
				qcom,mdss-dsi-h-front-porch = <32>;
				qcom,mdss-dsi-h-back-porch = <18>;
				qcom,mdss-dsi-h-pulse-width = <4>;
				qcom,mdss-dsi-h-sync-skew = <0>;
				qcom,mdss-dsi-v-back-porch = <14>;
				qcom,mdss-dsi-v-front-porch = <16>;
				qcom,mdss-dsi-v-pulse-width = <2>;
				qcom,mdss-dsi-panel-framerate = <60>;
				qcom,mdss-dsi-on-command =
				[
39 01 00 00 00 00 02 00 00
39 01 00 00 00 00 04 FF 87 56 01
39 01 00 00 00 00 02 00 80
39 01 00 00 00 00 03 FF 87 56
39 01 00 00 00 00 02 00 A1
39 01 00 00 00 00 07 B3 02 D0 06 08 20 FC
39 01 00 00 00 00 02 00 80
39 01 00 00 00 00 07 C0 00 D4 00 10 00 10
39 01 00 00 00 00 02 00 90
39 01 00 00 00 00 07 C0 00 D4 00 10 00 10
39 01 00 00 00 00 02 00 A0
39 01 00 00 00 00 07 C0 01 A6 00 10 00 10
39 01 00 00 00 00 02 00 B0
39 01 00 00 00 00 06 C0 00 D4 00 10 10
39 01 00 00 00 00 02 00 C1
39 01 00 00 00 00 09 C0 01 39 00 F6 00 D1 01 71
39 01 00 00 00 00 02 00 D7
39 01 00 00 00 00 07 C0 00 D1 00 10 00 10
39 01 00 00 00 00 02 00 A3
39 01 00 00 00 00 07 C1 00 2E 00 2E 00 02
39 01 00 00 00 00 02 00 80
39 01 00 00 00 00 11 CE 01 81 09 13 00 7E 00 90 00 54 00 60 00 46 00 4C
39 01 00 00 00 00 02 00 90
39 01 00 00 00 00 10 CE 00 8E 0E B6 00 8E 80 09 13 00 04 00 0F 0D 0A
39 01 00 00 00 00 02 00 A0
39 01 00 00 00 00 04 CE 00 00 00
39 01 00 00 00 00 02 00 B0
39 01 00 00 00 00 04 CE 22 00 00
39 01 00 00 00 00 02 00 D1
39 01 00 00 00 00 08 CE 00 00 01 00 00 00 00
39 01 00 00 00 00 02 00 E1
39 01 00 00 00 00 0C CE 08 02 4D 02 4D 02 4D 00 00 00 00
39 01 00 00 00 00 02 00 F1
39 01 00 00 00 00 0a CE 0E 07 09 01 19 01 1A 01 B8
39 01 00 00 00 00 02 00 B0
39 01 00 00 00 00 05 CF 00 00 6D 71
39 01 00 00 00 00 02 00 B5
39 01 00 00 00 00 05 CF 03 03 06 0A
39 01 00 00 00 00 02 00 C0
39 01 00 00 00 00 05 CF 05 05 CB CF
39 01 00 00 00 00 02 00 C5
39 01 00 00 00 00 05 CF 00 00 08 0C
39 01 00 00 00 00 02 00 E8
39 01 00 00 00 00 02 C0 40
39 01 00 00 00 00 02 00 80
39 01 00 00 00 00 09 c2 84 00 04 8A 83 00 04 8A
39 01 00 00 00 00 02 00 a0
39 01 00 00 00 00 10 c2 00 04 00 04 88 01 04 00 04 88 02 04 00 04 88
39 01 00 00 00 00 02 00 b0
39 01 00 00 00 00 10 c2 03 04 00 04 88 04 04 00 04 88 05 04 00 04 88
39 01 00 00 00 00 02 00 C0
39 01 00 00 00 00 0b c2 82 04 00 04 88 81 04 00 04 88
39 01 00 00 00 00 02 00 e0
39 01 00 00 00 00 05 c2 77 77 77 77
39 01 00 00 00 00 02 00 c0
39 01 00 00 00 00 05 c3 99 99 99 99
39 01 00 00 00 00 02 00 80
39 01 00 00 00 00 11 cb 00 C5 00 00 05 05 00 05 06 05 c5 00 05 05 00 c4
39 01 00 00 00 00 02 00 90
39 01 00 00 00 00 11 cb 00 00 00 00 00 00 00 00 00 00 00 00 00 00 00 00
39 01 00 00 00 00 02 00 a0
39 01 00 00 00 00 05 cb 00 00 00 00
39 01 00 00 00 00 02 00 B0
39 01 00 00 00 00 05 CB 10 51 94 50
39 01 00 00 00 00 02 00 C0
39 01 00 00 00 00 05 CB 10 51 94 50
39 01 00 00 00 00 02 00 80
39 01 00 00 00 00 11 cc 00 00 00 00 00 00 00 07 09 0B 0D 25 25 03 16 17
39 01 00 00 00 00 02 00 90
39 01 00 00 00 00 09 cc 18 22 26 29 19 1a 1b 24
39 01 00 00 00 00 02 00 80
39 01 00 00 00 00 11 cd 00 00 00 00 00 00 00 06 08 0A 0C 25 00 02 16 17
39 01 00 00 00 00 02 00 90
39 01 00 00 00 00 09 cd 18 22 26 29 19 1a 1b 24
39 01 00 00 00 00 02 00 a0
39 01 00 00 00 00 11 cc 00 00 00 00 00 00 00 0C 0A 08 06 25 25 02 16 17
39 01 00 00 00 00 02 00 b0
39 01 00 00 00 00 09 cc 18 26 23 29 19 1a 1b 24
39 01 00 00 00 00 02 00 a0
39 01 00 00 00 00 11 cd 00 00 00 00 00 00 00 0D 0B 09 07 25 00 03 16 17
39 01 00 00 00 00 02 00 b0
39 01 00 00 00 00 09 cd 18 26 23 29 19 1a 1b 24
39 01 00 00 00 00 02 00 80
39 01 00 00 00 00 02 a7 16
39 01 00 00 00 00 02 00 A0
39 01 00 00 00 00 11 C3 35 01 23 45 54 32 10 00 00 00 54 32 10 01 23 45
39 01 00 00 00 00 02 00 82
39 01 00 00 00 00 03 a7 22 02
39 01 00 00 00 00 02 00 85
39 01 00 00 00 00 02 C4 1C
39 01 00 00 00 00 02 00 A0
39 01 00 00 00 00 04 C4 8D D8 8D
39 01 00 00 00 00 02 00 93
39 01 00 00 00 00 02 C5 37
39 01 00 00 00 00 02 00 97
39 01 00 00 00 00 02 C5 37
39 01 00 00 00 00 02 00 B6
39 01 00 00 00 00 03 C5 23 23
39 01 00 00 00 00 02 00 93
39 01 00 00 00 00 03 F5 00 00
39 01 00 00 00 00 02 00 9D
39 01 00 00 00 00 02 F5 49
39 01 00 00 00 00 02 00 82
39 01 00 00 00 00 03 F5 00 00
39 01 00 00 00 00 02 00 8C
39 01 00 00 00 00 04 C3 00 00 00
39 01 00 00 00 00 02 00 84
39 01 00 00 00 00 03 C5 28 28
39 01 00 00 00 00 02 00 A4
39 01 00 00 00 00 02 D7 00
39 01 00 00 00 00 02 00 80
39 01 00 00 00 00 03 F5 59 59
39 01 00 00 00 00 02 00 84
39 01 00 00 00 00 04 F5 59 59 59
39 01 00 00 00 00 02 00 96
39 01 00 00 00 00 02 F5 59
39 01 00 00 00 00 02 00 A6
39 01 00 00 00 00 02 F5 59
39 01 00 00 00 00 02 00 CA
39 01 00 00 00 00 02 C0 80
39 01 00 00 00 00 02 00 B1
39 01 00 00 00 00 02 F5 1f
39 01 00 00 00 00 02 00 00
39 01 00 00 00 00 03 D8 31 31
39 01 00 00 00 00 02 00 00
39 01 00 00 00 00 03 D9 1E 1E
39 01 00 00 00 00 02 00 86
39 01 00 00 00 00 07 C0 01 04 01 02 1C 03
39 01 00 00 00 00 02 00 96
39 01 00 00 00 00 07 C0 01 04 01 02 1C 03
39 01 00 00 00 00 02 00 A6
39 01 00 00 00 00 07 C0 01 04 01 02 3E 03
39 01 00 00 00 00 02 00 E9
39 01 00 00 00 00 07 C0 01 04 01 02 1C 03
39 01 00 00 00 00 02 00 A3
39 01 00 00 00 00 07 CE 01 04 01 02 1C 03
39 01 00 00 00 00 02 00 b3
39 01 00 00 00 00 07 CE 01 04 01 02 1B 03
39 01 00 00 00 00 02 00 00
39 01 00 00 00 00 29 E1 00 03 08 10 17 1C 24 2A 35 19 3D 44 4A 50 FC 54 5D 64 6B 8A 72 79 80 89 5D 92 98 9E A6 DC AE B9 C7 D0 EB DB EC F8 FF D7
39 01 00 00 00 00 02 00 00
39 01 00 00 00 00 29 E2 00 03 08 10 17 1C 24 2A 35 19 3D 44 4A 50 FC 54 5D 64 6B 8A 72 79 80 89 5D 92 98 9E A6 DC AE B9 C7 D0 EB DB EC F8 FF D7
39 01 00 00 00 00 02 00 00
39 01 00 00 00 00 29 E3 00 03 08 10 17 1C 24 2A 35 19 3D 44 4A 50 FC 54 5D 64 6B 8A 72 79 80 89 5D 92 98 9E A6 DC AE B9 C7 D0 EB DB EC F8 FF D7
39 01 00 00 00 00 02 00 00
39 01 00 00 00 00 29 E4 00 03 08 10 17 1C 24 2A 35 19 3D 44 4A 50 FC 54 5D 64 6B 8A 72 79 80 89 5D 92 98 9E A6 DC AE B9 C7 D0 EB DB EC F8 FF D7
39 01 00 00 00 00 02 00 00
39 01 00 00 00 00 29 E5 00 03 08 10 17 1C 24 2A 35 19 3D 44 4A 50 FC 54 5D 64 6B 8A 72 79 80 89 5D 92 98 9E A6 DC AE B9 C7 D0 EB DB EC F8 FF D7
39 01 00 00 00 00 02 00 00
39 01 00 00 00 00 29 E6 00 03 08 10 17 1C 24 2A 35 19 3D 44 4A 50 FC 54 5D 64 6B 8A 72 79 80 89 5D 92 98 9E A6 DC AE B9 C7 D0 EB DB EC F8 FF D7
39 01 00 00 00 00 02 00 CC
39 01 00 00 00 00 02 C0 13
39 01 00 00 00 00 02 00 82
39 01 00 00 00 00 02 C5 3a
39 01 00 00 00 00 02 00 00
39 01 00 00 00 00 04 FF FF FF FF


					15 01 00 00 00 00 02 35 00
					15 01 00 00 78 00 02 11 00
					15 01 00 00 14 00 02 29 00
					15 01 00 00 00 00 03 51 FF 0F
					15 01 00 00 00 00 02 53 2c
				];
				qcom,mdss-dsi-off-command = [
					15 01 00 00 32 00 02 28 00
					15 01 00 00 78 00 02 10 00
				];
				qcom,mdss-dsi-t-clk-post = <0x0E>;
				qcom,mdss-dsi-t-clk-pre = <0x33>;
				qcom,mdss-dsi-on-command-state = "dsi_lp_mode";
				qcom,mdss-dsi-off-command-state = "dsi_hs_mode";
			};
		};
	};
};
