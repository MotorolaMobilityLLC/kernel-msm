/* Copyright (c) 2018, The Linux Foundation. All rights reserved.
 *
 * This program is free software; you can redistribute it and/or modify
 * it under the terms of the GNU General Public License version 2 and
 * only version 2 as published by the Free Software Foundation.
 *
 * This program is distributed in the hope that it will be useful,
 * but WITHOUT ANY WARRANTY; without even the implied warranty of
 * MERCHANTABILITY or FITNESS FOR A PARTICULAR PURPOSE.  See the
 * GNU General Public License for more details.
 */

#include "sdmmagpie-moto-common-overlay.dtsi"
#include "sdmmagpie-audio-overlay.dtsi"
#include "sdmmagpie-hario-fps-overlay.dtsi"
#include "hanoi-panel.dtsi"
#include "sdmmagpie-camera-sensor-mot-hanoip-overlay.dtsi"
#include "hanoi_battery_thermal_overlay.dtsi"
#include "sdmmagpie-hanoi-sensor-overlay.dtsi"
#include "sdmmagpie-hanoi-touchscreen.dtsi"

&soc {
	qcom,tz_gpio {
		compatible = "qcom,tz_gpio";
		tlmm-tz = <0>,
			<1>,
			<2>,
			<3>;
	};
};

&sde_dp {
	status = "disabled";
};


&mdss_mdp {
	connectors = <&sde_rscc &sde_wb &sde_dsi>;
};

