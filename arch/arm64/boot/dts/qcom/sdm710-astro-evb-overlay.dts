/* Copyright (c) 2019, The Linux Foundation. All rights reserved.
 *
 * This program is free software; you can redistribute it and/or modify
 * it under the terms of the GNU General Public License version 2 and
 * only version 2 as published by the Free Software Foundation.
 *
 * This program is distributed in the hope that it will be useful,
 * but WITHOUT ANY WARRANTY; without even the implied warranty of
 * MERCHANTABILITY or FITNESS FOR A PARTICULAR PURPOSE.  See the
 * GNU General Public License for more details.
 */

/dts-v1/;
/plugin/;

#include "sdm710-astro-common-overlay.dtsi"

/ {
	model = "astro";
	compatible = "qcom,sdm670-astro", "qcom,sdm670-moto", "qcom,astro";
	qcom,msm-id = <360 0x0>;
	qcom,board-id = <0x43 0xA100>;
};

/*
 * Astro HW rev EVB specific changes go here
 */

