/* Copyright (c) 2014-2020, The Linux Foundation. All rights reserved.
 *
 * This program is free software; you can redistribute it and/or modify
 * it under the terms of the GNU General Public License version 2 and
 * only version 2 as published by the Free Software Foundation.
 *
 * This program is distributed in the hope that it will be useful,
 * but WITHOUT ANY WARRANTY; without even the implied warranty of
 * MERCHANTABILITY or FITNESS FOR A PARTICULAR PURPOSE.  See the
 * GNU General Public License for more details.
 */
maxim,lk50-atl-batterydata {
	/* Required properties */
	serialnum	= "SB18C77773";

	maxim,config-data = /bits/ 16 <
		0xee56 0x1da4 0x0025 0x0000 0x0000				/* A/D measurement */
		0x0000 0x0000 0x0000 0x0000 0xa210 0x00d8 0xe000		/* Alert / Status */
		0x0000 0x0000 0x0640 0x0200 0x0000 0x965a 0x8400		/* App data */
		0x0000 0x4406 0x0000 0x0000 0x0000 0x0000 0x0000		/* Configs */
		0x0045 0x2117 0x1780 0x0b80 0x0580 0x0480 			/* Cell Data */
		0x0000 0x0000 0x0000 0x0000					/* Temp Config */
		0x9ba0 0xb730 0xb8e0 0xbab0 0xbc10 0xbcb0 0xbdd0 0xbee0		/* Model Data Begin*/
		0xc070 0xc1e0 0xc4f0 0xc750 0xcaf0 0xcda0 0xd3e0 0xda50
		0x00c0 0x1110 0x0ce0 0x1330 0x1cd0 0x1c10 0x1710 0x1000
		0x1080 0x07d0 0x09a0 0x0700 0x08b0 0x06c0 0x0620 0x0620
		0x0200 0x0200 0x0200 0x0200 0x0200 0x0200 0x0200 0x0200
		0x0200 0x0200 0x0200 0x0200 0x0200 0x0200 0x0200 0x0200 	/* Model Data End*/
	>;
};
