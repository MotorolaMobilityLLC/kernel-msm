/* Copyright (c) 2019, The Linux Foundation. All rights reserved.
 *
 * This program is free software; you can redistribute it and/or modify
 * it under the terms of the GNU General Public License version 2 and
 * only version 2 as published by the Free Software Foundation.
 *
 * This program is distributed in the hope that it will be useful,
 * but WITHOUT ANY WARRANTY; without even the implied warranty of
 * MERCHANTABILITY or FITNESS FOR A PARTICULAR PURPOSE.  See the
 * GNU General Public License for more details.
 */

#include "trinket-moto-common-overlay.dtsi"
#include "rav-panel.dtsi"
#include "trinket-rav-touch-overlay.dtsi"

#define RAV_RADIO_NA 2

&key_vol_up_default {
	pins = "gpio1";
	power-source = <0>;
};

&soc {
	gpio_keys {
		vol_up {
			gpios = <&pm6125_gpios 1 GPIO_ACTIVE_LOW>;
		};
	};
};
