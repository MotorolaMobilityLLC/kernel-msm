qcom,lge_blt19_tocad_2700mAh_2022227_PMI8994GUI2165 {
	/* #lge_blt19_tocad_2700mAh_2022227_PMI8994GUI2165*/
	qcom,max-voltage-uv = <4350000>;
	qcom,nom-batt-capacity-mah = <2620>;
	qcom,batt-id-kohm = <75>;
	qcom,battery-beta = <4150>;
	qcom,battery-type = "lge_blt19_tocad_2700mAh_2022227_PMI8994GUI2165";
	qcom,chg-rslow-comp-c1 = <3662053>;
	qcom,chg-rslow-comp-c2 = <7077799>;
	qcom,chg-rs-to-rslow = <913780>;
	qcom,chg-rslow-comp-thr = <0xBD>;
	qcom,checksum = <0x321C>;
	qcom,gui-version = "PMI8994GUI - 2.1.6.5";
	qcom,fg-profile-data = [
		 D1 83 0F 7C
		 52 80 C5 75
		 74 83 CA 7C
		 5E 90 F7 96
		 1F 82 20 99
		 11 B7 81 C2
		 52 16 D6 83
		 63 77 DB 7B
		 E6 74 76 83
		 52 7C D3 90
		 61 9C 54 82
		 49 99 5F BC
		 D4 C8 4C 11
		 90 0A 0D 60
		 CE 6E 7D FF
		 C3 27 37 47
		 27 40 00 00
		 05 47 34 30
		 6E 33 00 00
		 00 00 00 00
		 00 00 00 00
		 8D 6B 85 6B
		 BC 69 9E 82
		 6A 74 59 62
		 04 71 84 82
		 4F 74 97 61
		 5C 7F 4F AA
		 18 B6 61 D3
		 5F A0 71 0C
		 28 00 FF 36
		 F0 11 30 03
		 00 00 00 0C
	];
};
