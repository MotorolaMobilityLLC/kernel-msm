/* Copyright (c) 2015, LGE Inc. All rights reserved.
 * Copyright (c) 2014, The Linux Foundation. All rights reserved.
 *
 * This program is free software; you can redistribute it and/or modify
 * it under the terms of the GNU General Public License version 2 and
 * only version 2 as published by the Free Software Foundation.
 *
 * This program is distributed in the hope that it will be useful,
 * but WITHOUT ANY WARRANTY; without even the implied warranty of
 * MERCHANTABILITY or FITNESS FOR A PARTICULAR PURPOSE.  See the
 * GNU General Public License for more details.
 */

qcom,LGE_BL51YF_Tocad_3000mAh {
        /* #1781145_LGE_BL51YF_Tocad_3000mAh_averaged_MasterSlave_Nov12th2014*/
        qcom,max-voltage-uv = <4400000>;
        qcom,nom-batt-capacity-mah = <3000>;
        qcom,batt-id-kohm = <0>;
        qcom,battery-beta = <4150>;
        qcom,battery-type = "LGE_BL51YF_Tocad_3000mAh";
        qcom,checksum = <0x6D70>;
        qcom,gui-version = "PMI8994GUI - 2.1.4.3";
        qcom,fg-profile-data = [
                EE 83 51 7D
                63 81 B1 77
                50 83 93 5C
                82 82 AB 8D
                14 82 C3 98
                02 B6 1A C1
                58 17 15 88
                EC 7E 76 82
                CB 7C 59 83
                ED 5A FC 80
                97 8C 44 82
                10 9A 7F BD
                B3 CA 5F 0D
                9D 0B BE 5A
                14 70 71 FD
                90 38 70 3F
                8D 36 00 00
                3C 36 2A 3F
                A9 46 00 00
                00 00 00 00
                00 00 00 00
                95 70 F3 70
                3C 6E 0E 81
                7F 6F EE 58
                C7 67 E9 79
                9D 74 0E 63
                75 7C DD B0
                26 72 69 AD
                66 A0 71 0C
                28 00 FF 36
                F0 11 30 03
                00 00 00 00
        ];
};
