/* Copyright (c) 2015, The Linux Foundation. All rights reserved.
 *
 * This program is free software; you can redistribute it and/or modify
 * it under the terms of the GNU General Public License version 2 and
 * only version 2 as published by the Free Software Foundation.
 *
 * This program is distributed in the hope that it will be useful,
 * but WITHOUT ANY WARRANTY; without even the implied warranty of
 * MERCHANTABILITY or FITNESS FOR A PARTICULAR PURPOSE.  See the
 * GNU General Public License for more details.
 */

/*---------------------------------------------------------------------------
 * This file is autogenerated file using gcdb parser. Please do not edit it.
 * Update input XML file to add a new entry or update variable in this file
 * VERSION = "1.0"
 *---------------------------------------------------------------------------*/
&mdss_mdp {
	dsi_jd35695b_1080p_cmd: qcom,mdss_dsi_jd35695b_1080p_cmd {
		compatible = "qcom,mdss-dsi-panel";
		status = "ok";
		qcom,cont-splash-enabled;
		qcom,mdss-dsi-panel-name = "jd35695b 1080p cmd mode dsi panel";
		qcom,mdss-dsi-panel-controller = <&mdss_dsi0>;
		qcom,mdss-dsi-panel-type = "dsi_cmd_mode";
		qcom,mdss-dsi-panel-destination = "display_1";
		qcom,mdss-dsi-panel-framerate = <60>;
		qcom,mdss-dsi-virtual-channel-id = <0>;
		qcom,mdss-dsi-stream = <0>;
		qcom,mdss-dsi-panel-width = <1080>;
		qcom,mdss-dsi-panel-height = <1920>;
		qcom,mdss-dsi-h-front-porch = <120>;
		qcom,mdss-dsi-h-back-porch = <76>;
		qcom,mdss-dsi-h-pulse-width = <4>;
		qcom,mdss-dsi-h-sync-skew = <0>;
		qcom,mdss-dsi-v-back-porch = <7>;
		qcom,mdss-dsi-v-front-porch = <8>;
		qcom,mdss-dsi-v-pulse-width = <1>;
		qcom,mdss-dsi-h-left-border = <0>;
		qcom,mdss-dsi-h-right-border = <0>;
		qcom,mdss-dsi-v-top-border = <0>;
		qcom,mdss-dsi-v-bottom-border = <0>;
		qcom,mdss-pan-physical-width-dimension = <65>;
		qcom,mdss-pan-physical-height-dimension = <115>;
		qcom,mdss-dsi-bpp = <24>;
		qcom,mdss-dsi-color-order = "rgb_swap_rgb";
		qcom,mdss-dsi-underflow-color = <0x00>;
		qcom,mdss-dsi-init-delay-us = <20000>;
		qcom,mdss-dsi-border-color = <0>;
		qcom,ulps-enabled;
		qcom,mdss-dsi-gamma-default = [
			23 00 00 00 00 00 02 FF 20
			23 00 00 00 00 00 02 75 00
			23 00 00 00 00 00 02 76 00
			23 00 00 00 00 00 02 77 00
			23 00 00 00 00 00 02 78 29
			23 00 00 00 00 00 02 79 00
			23 00 00 00 00 00 02 7A 71
			23 00 00 00 00 00 02 7B 00
			23 00 00 00 00 00 02 7C 9F
			23 00 00 00 00 00 02 7D 00
			23 00 00 00 00 00 02 7E BE
			23 00 00 00 00 00 02 7F 00
			23 00 00 00 00 00 02 80 D9
			23 00 00 00 00 00 02 81 00
			23 00 00 00 00 00 02 82 F1
			23 00 00 00 00 00 02 83 01
			23 00 00 00 00 00 02 84 06
			23 00 00 00 00 00 02 85 01
			23 00 00 00 00 00 02 86 17
			23 00 00 00 00 00 02 87 01
			23 00 00 00 00 00 02 88 50
			23 00 00 00 00 00 02 89 01
			23 00 00 00 00 00 02 8A 7A
			23 00 00 00 00 00 02 8B 01
			23 00 00 00 00 00 02 8C B7
			23 00 00 00 00 00 02 8D 01
			23 00 00 00 00 00 02 8E E3
			23 00 00 00 00 00 02 8F 02
			23 00 00 00 00 00 02 90 25
			23 00 00 00 00 00 02 91 02
			23 00 00 00 00 00 02 92 59
			23 00 00 00 00 00 02 93 02
			23 00 00 00 00 00 02 94 5A
			23 00 00 00 00 00 02 95 02
			23 00 00 00 00 00 02 96 8A
			23 00 00 00 00 00 02 97 02
			23 00 00 00 00 00 02 98 BE
			23 00 00 00 00 00 02 99 02
			23 00 00 00 00 00 02 9A DE
			23 00 00 00 00 00 02 9B 03
			23 00 00 00 00 00 02 9C 04
			23 00 00 00 00 00 02 9D 03
			23 00 00 00 00 00 02 9E 1C
			23 00 00 00 00 00 02 9F 03
			23 00 00 00 00 00 02 A0 37
			23 00 00 00 00 00 02 A2 03
			23 00 00 00 00 00 02 A3 3F
			23 00 00 00 00 00 02 A4 03
			23 00 00 00 00 00 02 A5 47
			23 00 00 00 00 00 02 A6 03
			23 00 00 00 00 00 02 A7 4F
			23 00 00 00 00 00 02 A9 03
			23 00 00 00 00 00 02 AA 5C
			23 00 00 00 00 00 02 AB 03
			23 00 00 00 00 00 02 AC 74
			23 00 00 00 00 00 02 AD 03
			23 00 00 00 00 00 02 AE A0
			23 00 00 00 00 00 02 AF 03
			23 00 00 00 00 00 02 B0 DD
			23 00 00 00 00 00 02 B1 03
			23 00 00 00 00 00 02 B2 FF
			23 00 00 00 00 00 02 B3 00
			23 00 00 00 00 00 02 B4 00
			23 00 00 00 00 00 02 B5 00
			23 00 00 00 00 00 02 B6 29
			23 00 00 00 00 00 02 B7 00
			23 00 00 00 00 00 02 B8 71
			23 00 00 00 00 00 02 B9 00
			23 00 00 00 00 00 02 BA 9F
			23 00 00 00 00 00 02 BB 00
			23 00 00 00 00 00 02 BC BE
			23 00 00 00 00 00 02 BD 00
			23 00 00 00 00 00 02 BE D9
			23 00 00 00 00 00 02 BF 00
			23 00 00 00 00 00 02 C0 F1
			23 00 00 00 00 00 02 C1 01
			23 00 00 00 00 00 02 C2 06
			23 00 00 00 00 00 02 C3 01
			23 00 00 00 00 00 02 C4 17
			23 00 00 00 00 00 02 C5 01
			23 00 00 00 00 00 02 C6 50
			23 00 00 00 00 00 02 C7 01
			23 00 00 00 00 00 02 C8 7A
			23 00 00 00 00 00 02 C9 01
			23 00 00 00 00 00 02 CA B7
			23 00 00 00 00 00 02 CB 01
			23 00 00 00 00 00 02 CC E3
			23 00 00 00 00 00 02 CD 02
			23 00 00 00 00 00 02 CE 25
			23 00 00 00 00 00 02 CF 02
			23 00 00 00 00 00 02 D0 59
			23 00 00 00 00 00 02 D1 02
			23 00 00 00 00 00 02 D2 5A
			23 00 00 00 00 00 02 D3 02
			23 00 00 00 00 00 02 D4 8A
			23 00 00 00 00 00 02 D5 02
			23 00 00 00 00 00 02 D6 BE
			23 00 00 00 00 00 02 D7 02
			23 00 00 00 00 00 02 D8 DE
			23 00 00 00 00 00 02 D9 03
			23 00 00 00 00 00 02 DA 04
			23 00 00 00 00 00 02 DB 03
			23 00 00 00 00 00 02 DC 1C
			23 00 00 00 00 00 02 DD 03
			23 00 00 00 00 00 02 DE 37
			23 00 00 00 00 00 02 DF 03
			23 00 00 00 00 00 02 E0 3F
			23 00 00 00 00 00 02 E1 03
			23 00 00 00 00 00 02 E2 47
			23 00 00 00 00 00 02 E3 03
			23 00 00 00 00 00 02 E4 4F
			23 00 00 00 00 00 02 E5 03
			23 00 00 00 00 00 02 E6 5C
			23 00 00 00 00 00 02 E7 03
			23 00 00 00 00 00 02 E8 74
			23 00 00 00 00 00 02 E9 03
			23 00 00 00 00 00 02 EA A0
			23 00 00 00 00 00 02 EB 03
			23 00 00 00 00 00 02 EC DD
			23 00 00 00 00 00 02 ED 03
			23 00 00 00 00 00 02 EE FF
			23 00 00 00 00 00 02 EF 00
			23 00 00 00 00 00 02 F0 81
			23 00 00 00 00 00 02 F1 00
			23 00 00 00 00 00 02 F2 96
			23 00 00 00 00 00 02 F3 00
			23 00 00 00 00 00 02 F4 BD
			23 00 00 00 00 00 02 F5 00
			23 00 00 00 00 00 02 F6 DB
			23 00 00 00 00 00 02 F7 00
			23 00 00 00 00 00 02 F8 F3
			23 00 00 00 00 00 02 F9 01
			23 00 00 00 00 00 02 FA 08
			23 00 00 00 00 00 02 FB 01
			23 00 00 00 00 00 02 FF 21
			23 00 00 00 00 00 02 00 01
			23 00 00 00 00 00 02 01 1A
			23 00 00 00 00 00 02 02 01
			23 00 00 00 00 00 02 03 2B
			23 00 00 00 00 00 02 04 01
			23 00 00 00 00 00 02 05 39
			23 00 00 00 00 00 02 06 01
			23 00 00 00 00 00 02 07 6A
			23 00 00 00 00 00 02 08 01
			23 00 00 00 00 00 02 09 8E
			23 00 00 00 00 00 02 0A 01
			23 00 00 00 00 00 02 0B C5
			23 00 00 00 00 00 02 0C 01
			23 00 00 00 00 00 02 0D EF
			23 00 00 00 00 00 02 0E 02
			23 00 00 00 00 00 02 0F 2D
			23 00 00 00 00 00 02 10 02
			23 00 00 00 00 00 02 11 5F
			23 00 00 00 00 00 02 12 02
			23 00 00 00 00 00 02 13 60
			23 00 00 00 00 00 02 14 02
			23 00 00 00 00 00 02 15 8F
			23 00 00 00 00 00 02 16 02
			23 00 00 00 00 00 02 17 C2
			23 00 00 00 00 00 02 18 02
			23 00 00 00 00 00 02 19 E1
			23 00 00 00 00 00 02 1A 03
			23 00 00 00 00 00 02 1B 07
			23 00 00 00 00 00 02 1C 03
			23 00 00 00 00 00 02 1D 1E
			23 00 00 00 00 00 02 1E 03
			23 00 00 00 00 00 02 1F 39
			23 00 00 00 00 00 02 20 03
			23 00 00 00 00 00 02 21 41
			23 00 00 00 00 00 02 22 03
			23 00 00 00 00 00 02 23 48
			23 00 00 00 00 00 02 24 03
			23 00 00 00 00 00 02 25 50
			23 00 00 00 00 00 02 26 03
			23 00 00 00 00 00 02 27 5C
			23 00 00 00 00 00 02 28 03
			23 00 00 00 00 00 02 29 74
			23 00 00 00 00 00 02 2A 03
			23 00 00 00 00 00 02 2B 9F
			23 00 00 00 00 00 02 2D 03
			23 00 00 00 00 00 02 2F DD
			23 00 00 00 00 00 02 30 03
			23 00 00 00 00 00 02 31 FF
			23 00 00 00 00 00 02 32 00
			23 00 00 00 00 00 02 33 81
			23 00 00 00 00 00 02 34 00
			23 00 00 00 00 00 02 35 96
			23 00 00 00 00 00 02 36 00
			23 00 00 00 00 00 02 37 BD
			23 00 00 00 00 00 02 38 00
			23 00 00 00 00 00 02 39 DB
			23 00 00 00 00 00 02 3A 00
			23 00 00 00 00 00 02 3B F3
			23 00 00 00 00 00 02 3D 01
			23 00 00 00 00 00 02 3F 08
			23 00 00 00 00 00 02 40 01
			23 00 00 00 00 00 02 41 1A
			23 00 00 00 00 00 02 42 01
			23 00 00 00 00 00 02 43 2B
			23 00 00 00 00 00 02 44 01
			23 00 00 00 00 00 02 45 39
			23 00 00 00 00 00 02 46 01
			23 00 00 00 00 00 02 47 6A
			23 00 00 00 00 00 02 48 01
			23 00 00 00 00 00 02 49 8E
			23 00 00 00 00 00 02 4A 01
			23 00 00 00 00 00 02 4B C5
			23 00 00 00 00 00 02 4C 01
			23 00 00 00 00 00 02 4D EF
			23 00 00 00 00 00 02 4E 02
			23 00 00 00 00 00 02 4F 2D
			23 00 00 00 00 00 02 50 02
			23 00 00 00 00 00 02 51 5F
			23 00 00 00 00 00 02 52 02
			23 00 00 00 00 00 02 53 60
			23 00 00 00 00 00 02 54 02
			23 00 00 00 00 00 02 55 8F
			23 00 00 00 00 00 02 56 02
			23 00 00 00 00 00 02 58 C2
			23 00 00 00 00 00 02 59 02
			23 00 00 00 00 00 02 5A E1
			23 00 00 00 00 00 02 5B 03
			23 00 00 00 00 00 02 5C 07
			23 00 00 00 00 00 02 5D 03
			23 00 00 00 00 00 02 5E 1E
			23 00 00 00 00 00 02 5F 03
			23 00 00 00 00 00 02 60 39
			23 00 00 00 00 00 02 61 03
			23 00 00 00 00 00 02 62 41
			23 00 00 00 00 00 02 63 03
			23 00 00 00 00 00 02 64 48
			23 00 00 00 00 00 02 65 03
			23 00 00 00 00 00 02 66 50
			23 00 00 00 00 00 02 67 03
			23 00 00 00 00 00 02 68 5C
			23 00 00 00 00 00 02 69 03
			23 00 00 00 00 00 02 6A 74
			23 00 00 00 00 00 02 6B 03
			23 00 00 00 00 00 02 6C 9F
			23 00 00 00 00 00 02 6D 03
			23 00 00 00 00 00 02 6E DD
			23 00 00 00 00 00 02 6F 03
			23 00 00 00 00 00 02 70 FF
			23 00 00 00 00 00 02 71 00
			23 00 00 00 00 00 02 72 F0
			23 00 00 00 00 00 02 73 00
			23 00 00 00 00 00 02 74 FA
			23 00 00 00 00 00 02 75 01
			23 00 00 00 00 00 02 76 0E
			23 00 00 00 00 00 02 77 01
			23 00 00 00 00 00 02 78 20
			23 00 00 00 00 00 02 79 01
			23 00 00 00 00 00 02 7A 30
			23 00 00 00 00 00 02 7B 01
			23 00 00 00 00 00 02 7C 3E
			23 00 00 00 00 00 02 7D 01
			23 00 00 00 00 00 02 7E 4A
			23 00 00 00 00 00 02 7F 01
			23 00 00 00 00 00 02 80 56
			23 00 00 00 00 00 02 81 01
			23 00 00 00 00 00 02 82 61
			23 00 00 00 00 00 02 83 01
			23 00 00 00 00 00 02 84 86
			23 00 00 00 00 00 02 85 01
			23 00 00 00 00 00 02 86 A4
			23 00 00 00 00 00 02 87 01
			23 00 00 00 00 00 02 88 D3
			23 00 00 00 00 00 02 89 01
			23 00 00 00 00 00 02 8A F8
			23 00 00 00 00 00 02 8B 02
			23 00 00 00 00 00 02 8C 32
			23 00 00 00 00 00 02 8D 02
			23 00 00 00 00 00 02 8E 62
			23 00 00 00 00 00 02 8F 02
			23 00 00 00 00 00 02 90 63
			23 00 00 00 00 00 02 91 02
			23 00 00 00 00 00 02 92 90
			23 00 00 00 00 00 02 93 02
			23 00 00 00 00 00 02 94 C4
			23 00 00 00 00 00 02 95 02
			23 00 00 00 00 00 02 96 E2
			23 00 00 00 00 00 02 97 03
			23 00 00 00 00 00 02 98 08
			23 00 00 00 00 00 02 99 03
			23 00 00 00 00 00 02 9A 1F
			23 00 00 00 00 00 02 9B 03
			23 00 00 00 00 00 02 9C 37
			23 00 00 00 00 00 02 9D 03
			23 00 00 00 00 00 02 9E 3E
			23 00 00 00 00 00 02 9F 03
			23 00 00 00 00 00 02 A0 45
			23 00 00 00 00 00 02 A2 03
			23 00 00 00 00 00 02 A3 4E
			23 00 00 00 00 00 02 A4 03
			23 00 00 00 00 00 02 A5 5C
			23 00 00 00 00 00 02 A6 03
			23 00 00 00 00 00 02 A7 74
			23 00 00 00 00 00 02 A9 03
			23 00 00 00 00 00 02 AA A0
			23 00 00 00 00 00 02 AB 03
			23 00 00 00 00 00 02 AC DD
			23 00 00 00 00 00 02 AD 03
			23 00 00 00 00 00 02 AE FF
			23 00 00 00 00 00 02 AF 00
			23 00 00 00 00 00 02 B0 F0
			23 00 00 00 00 00 02 B1 00
			23 00 00 00 00 00 02 B2 FA
			23 00 00 00 00 00 02 B3 01
			23 00 00 00 00 00 02 B4 0E
			23 00 00 00 00 00 02 B5 01
			23 00 00 00 00 00 02 B6 20
			23 00 00 00 00 00 02 B7 01
			23 00 00 00 00 00 02 B8 30
			23 00 00 00 00 00 02 B9 01
			23 00 00 00 00 00 02 BA 3E
			23 00 00 00 00 00 02 BB 01
			23 00 00 00 00 00 02 BC 4A
			23 00 00 00 00 00 02 BD 01
			23 00 00 00 00 00 02 BE 56
			23 00 00 00 00 00 02 BF 01
			23 00 00 00 00 00 02 C0 61
			23 00 00 00 00 00 02 C1 01
			23 00 00 00 00 00 02 C2 86
			23 00 00 00 00 00 02 C3 01
			23 00 00 00 00 00 02 C4 A4
			23 00 00 00 00 00 02 C5 01
			23 00 00 00 00 00 02 C6 D3
			23 00 00 00 00 00 02 C7 01
			23 00 00 00 00 00 02 C8 F8
			23 00 00 00 00 00 02 C9 02
			23 00 00 00 00 00 02 CA 32
			23 00 00 00 00 00 02 CB 02
			23 00 00 00 00 00 02 CC 62
			23 00 00 00 00 00 02 CD 02
			23 00 00 00 00 00 02 CE 63
			23 00 00 00 00 00 02 CF 02
			23 00 00 00 00 00 02 D0 90
			23 00 00 00 00 00 02 D1 02
			23 00 00 00 00 00 02 D2 C4
			23 00 00 00 00 00 02 D3 02
			23 00 00 00 00 00 02 D4 E2
			23 00 00 00 00 00 02 D5 03
			23 00 00 00 00 00 02 D6 08
			23 00 00 00 00 00 02 D7 03
			23 00 00 00 00 00 02 D8 1F
			23 00 00 00 00 00 02 D9 03
			23 00 00 00 00 00 02 DA 37
			23 00 00 00 00 00 02 DB 03
			23 00 00 00 00 00 02 DC 3E
			23 00 00 00 00 00 02 DD 03
			23 00 00 00 00 00 02 DE 45
			23 00 00 00 00 00 02 DF 03
			23 00 00 00 00 00 02 E0 4E
			23 00 00 00 00 00 02 E1 03
			23 00 00 00 00 00 02 E2 5C
			23 00 00 00 00 00 02 E3 03
			23 00 00 00 00 00 02 E4 74
			23 00 00 00 00 00 02 E5 03
			23 00 00 00 00 00 02 E6 A0
			23 00 00 00 00 00 02 E7 03
			23 00 00 00 00 00 02 E8 DD
			23 00 00 00 00 00 02 E9 03
			23 00 00 00 00 00 02 EA FF
			23 00 00 00 00 00 02 FB 01
			23 01 00 00 00 00 02 FF 10];
		qcom,mdss-dsi-gamma-bluish = [
			23 00 00 00 00 00 02 FF 20
			23 00 00 00 00 00 02 75 00
			23 00 00 00 00 00 02 76 FA
			23 00 00 00 00 00 02 77 01
			23 00 00 00 00 00 02 78 03
			23 00 00 00 00 00 02 79 01
			23 00 00 00 00 00 02 7A 15
			23 00 00 00 00 00 02 7B 01
			23 00 00 00 00 00 02 7C 25
			23 00 00 00 00 00 02 7D 01
			23 00 00 00 00 00 02 7E 33
			23 00 00 00 00 00 02 7F 01
			23 00 00 00 00 00 02 80 40
			23 00 00 00 00 00 02 81 01
			23 00 00 00 00 00 02 82 4D
			23 00 00 00 00 00 02 83 01
			23 00 00 00 00 00 02 84 58
			23 00 00 00 00 00 02 85 01
			23 00 00 00 00 00 02 86 63
			23 00 00 00 00 00 02 87 01
			23 00 00 00 00 00 02 88 87
			23 00 00 00 00 00 02 89 01
			23 00 00 00 00 00 02 8A A5
			23 00 00 00 00 00 02 8B 01
			23 00 00 00 00 00 02 8C D5
			23 00 00 00 00 00 02 8D 01
			23 00 00 00 00 00 02 8E F9
			23 00 00 00 00 00 02 8F 02
			23 00 00 00 00 00 02 90 33
			23 00 00 00 00 00 02 91 02
			23 00 00 00 00 00 02 92 63
			23 00 00 00 00 00 02 93 02
			23 00 00 00 00 00 02 94 65
			23 00 00 00 00 00 02 95 02
			23 00 00 00 00 00 02 96 92
			23 00 00 00 00 00 02 97 02
			23 00 00 00 00 00 02 98 C6
			23 00 00 00 00 00 02 99 02
			23 00 00 00 00 00 02 9A E5
			23 00 00 00 00 00 02 9B 03
			23 00 00 00 00 00 02 9C 0B
			23 00 00 00 00 00 02 9D 03
			23 00 00 00 00 00 02 9E 21
			23 00 00 00 00 00 02 9F 03
			23 00 00 00 00 00 02 A0 3C
			23 00 00 00 00 00 02 A2 03
			23 00 00 00 00 00 02 A3 44
			23 00 00 00 00 00 02 A4 03
			23 00 00 00 00 00 02 A5 4B
			23 00 00 00 00 00 02 A6 03
			23 00 00 00 00 00 02 A7 53
			23 00 00 00 00 00 02 A9 03
			23 00 00 00 00 00 02 AA 60
			23 00 00 00 00 00 02 AB 03
			23 00 00 00 00 00 02 AC 78
			23 00 00 00 00 00 02 AD 03
			23 00 00 00 00 00 02 AE A2
			23 00 00 00 00 00 02 AF 03
			23 00 00 00 00 00 02 B0 DE
			23 00 00 00 00 00 02 B1 03
			23 00 00 00 00 00 02 B2 FF
			23 00 00 00 00 00 02 B3 00
			23 00 00 00 00 00 02 B4 FA
			23 00 00 00 00 00 02 B5 01
			23 00 00 00 00 00 02 B6 03
			23 00 00 00 00 00 02 B7 01
			23 00 00 00 00 00 02 B8 15
			23 00 00 00 00 00 02 B9 01
			23 00 00 00 00 00 02 BA 25
			23 00 00 00 00 00 02 BB 01
			23 00 00 00 00 00 02 BC 33
			23 00 00 00 00 00 02 BD 01
			23 00 00 00 00 00 02 BE 40
			23 00 00 00 00 00 02 BF 01
			23 00 00 00 00 00 02 C0 4D
			23 00 00 00 00 00 02 C1 01
			23 00 00 00 00 00 02 C2 58
			23 00 00 00 00 00 02 C3 01
			23 00 00 00 00 00 02 C4 63
			23 00 00 00 00 00 02 C5 01
			23 00 00 00 00 00 02 C6 87
			23 00 00 00 00 00 02 C7 01
			23 00 00 00 00 00 02 C8 A5
			23 00 00 00 00 00 02 C9 01
			23 00 00 00 00 00 02 CA D5
			23 00 00 00 00 00 02 CB 01
			23 00 00 00 00 00 02 CC F9
			23 00 00 00 00 00 02 CD 02
			23 00 00 00 00 00 02 CE 33
			23 00 00 00 00 00 02 CF 02
			23 00 00 00 00 00 02 D0 63
			23 00 00 00 00 00 02 D1 02
			23 00 00 00 00 00 02 D2 65
			23 00 00 00 00 00 02 D3 02
			23 00 00 00 00 00 02 D4 92
			23 00 00 00 00 00 02 D5 02
			23 00 00 00 00 00 02 D6 C6
			23 00 00 00 00 00 02 D7 02
			23 00 00 00 00 00 02 D8 E5
			23 00 00 00 00 00 02 D9 03
			23 00 00 00 00 00 02 DA 0B
			23 00 00 00 00 00 02 DB 03
			23 00 00 00 00 00 02 DC 21
			23 00 00 00 00 00 02 DD 03
			23 00 00 00 00 00 02 DE 3C
			23 00 00 00 00 00 02 DF 03
			23 00 00 00 00 00 02 E0 44
			23 00 00 00 00 00 02 E1 03
			23 00 00 00 00 00 02 E2 4B
			23 00 00 00 00 00 02 E3 03
			23 00 00 00 00 00 02 E4 53
			23 00 00 00 00 00 02 E5 03
			23 00 00 00 00 00 02 E6 60
			23 00 00 00 00 00 02 E7 03
			23 00 00 00 00 00 02 E8 78
			23 00 00 00 00 00 02 E9 03
			23 00 00 00 00 00 02 EA A2
			23 00 00 00 00 00 02 EB 03
			23 00 00 00 00 00 02 EC DE
			23 00 00 00 00 00 02 ED 03
			23 00 00 00 00 00 02 EE FF
			23 00 00 00 00 00 02 EF 00
			23 00 00 00 00 00 02 F0 B4
			23 00 00 00 00 00 02 F1 00
			23 00 00 00 00 00 02 F2 C3
			23 00 00 00 00 00 02 F3 00
			23 00 00 00 00 00 02 F4 DF
			23 00 00 00 00 00 02 F5 00
			23 00 00 00 00 00 02 F6 F7
			23 00 00 00 00 00 02 F7 01
			23 00 00 00 00 00 02 F8 0C
			23 00 00 00 00 00 02 F9 01
			23 00 00 00 00 00 02 FA 1F
			23 00 00 00 00 00 02 FB 01
			23 00 00 00 00 00 02 FF 21
			23 00 00 00 00 00 02 00 01
			23 00 00 00 00 00 02 01 2F
			23 00 00 00 00 00 02 02 01
			23 00 00 00 00 00 02 03 3D
			23 00 00 00 00 00 02 04 01
			23 00 00 00 00 00 02 05 4A
			23 00 00 00 00 00 02 06 01
			23 00 00 00 00 00 02 07 76
			23 00 00 00 00 00 02 08 01
			23 00 00 00 00 00 02 09 97
			23 00 00 00 00 00 02 0A 01
			23 00 00 00 00 00 02 0B CC
			23 00 00 00 00 00 02 0C 01
			23 00 00 00 00 00 02 0D F3
			23 00 00 00 00 00 02 0E 02
			23 00 00 00 00 00 02 0F 2F
			23 00 00 00 00 00 02 10 02
			23 00 00 00 00 00 02 11 61
			23 00 00 00 00 00 02 12 02
			23 00 00 00 00 00 02 13 62
			23 00 00 00 00 00 02 14 02
			23 00 00 00 00 00 02 15 91
			23 00 00 00 00 00 02 16 02
			23 00 00 00 00 00 02 17 C4
			23 00 00 00 00 00 02 18 02
			23 00 00 00 00 00 02 19 E3
			23 00 00 00 00 00 02 1A 03
			23 00 00 00 00 00 02 1B 09
			23 00 00 00 00 00 02 1C 03
			23 00 00 00 00 00 02 1D 20
			23 00 00 00 00 00 02 1E 03
			23 00 00 00 00 00 02 1F 3A
			23 00 00 00 00 00 02 20 03
			23 00 00 00 00 00 02 21 41
			23 00 00 00 00 00 02 22 03
			23 00 00 00 00 00 02 23 48
			23 00 00 00 00 00 02 24 03
			23 00 00 00 00 00 02 25 50
			23 00 00 00 00 00 02 26 03
			23 00 00 00 00 00 02 27 5D
			23 00 00 00 00 00 02 28 03
			23 00 00 00 00 00 02 29 74
			23 00 00 00 00 00 02 2A 03
			23 00 00 00 00 00 02 2B A0
			23 00 00 00 00 00 02 2D 03
			23 00 00 00 00 00 02 2F DD
			23 00 00 00 00 00 02 30 03
			23 00 00 00 00 00 02 31 FF
			23 00 00 00 00 00 02 32 00
			23 00 00 00 00 00 02 33 B4
			23 00 00 00 00 00 02 34 00
			23 00 00 00 00 00 02 35 C3
			23 00 00 00 00 00 02 36 00
			23 00 00 00 00 00 02 37 DF
			23 00 00 00 00 00 02 38 00
			23 00 00 00 00 00 02 39 F7
			23 00 00 00 00 00 02 3A 01
			23 00 00 00 00 00 02 3B 0C
			23 00 00 00 00 00 02 3D 01
			23 00 00 00 00 00 02 3F 1F
			23 00 00 00 00 00 02 40 01
			23 00 00 00 00 00 02 41 2F
			23 00 00 00 00 00 02 42 01
			23 00 00 00 00 00 02 43 3D
			23 00 00 00 00 00 02 44 01
			23 00 00 00 00 00 02 45 4A
			23 00 00 00 00 00 02 46 01
			23 00 00 00 00 00 02 47 76
			23 00 00 00 00 00 02 48 01
			23 00 00 00 00 00 02 49 97
			23 00 00 00 00 00 02 4A 01
			23 00 00 00 00 00 02 4B CC
			23 00 00 00 00 00 02 4C 01
			23 00 00 00 00 00 02 4D F3
			23 00 00 00 00 00 02 4E 02
			23 00 00 00 00 00 02 4F 2F
			23 00 00 00 00 00 02 50 02
			23 00 00 00 00 00 02 51 61
			23 00 00 00 00 00 02 52 02
			23 00 00 00 00 00 02 53 62
			23 00 00 00 00 00 02 54 02
			23 00 00 00 00 00 02 55 91
			23 00 00 00 00 00 02 56 02
			23 00 00 00 00 00 02 58 C4
			23 00 00 00 00 00 02 59 02
			23 00 00 00 00 00 02 5A E3
			23 00 00 00 00 00 02 5B 03
			23 00 00 00 00 00 02 5C 09
			23 00 00 00 00 00 02 5D 03
			23 00 00 00 00 00 02 5E 20
			23 00 00 00 00 00 02 5F 03
			23 00 00 00 00 00 02 60 3A
			23 00 00 00 00 00 02 61 03
			23 00 00 00 00 00 02 62 41
			23 00 00 00 00 00 02 63 03
			23 00 00 00 00 00 02 64 48
			23 00 00 00 00 00 02 65 03
			23 00 00 00 00 00 02 66 50
			23 00 00 00 00 00 02 67 03
			23 00 00 00 00 00 02 68 5D
			23 00 00 00 00 00 02 69 03
			23 00 00 00 00 00 02 6A 74
			23 00 00 00 00 00 02 6B 03
			23 00 00 00 00 00 02 6C A0
			23 00 00 00 00 00 02 6D 03
			23 00 00 00 00 00 02 6E DD
			23 00 00 00 00 00 02 6F 03
			23 00 00 00 00 00 02 70 FF
			23 00 00 00 00 00 02 71 00
			23 00 00 00 00 00 02 72 00
			23 00 00 00 00 00 02 73 00
			23 00 00 00 00 00 02 74 31
			23 00 00 00 00 00 02 75 00
			23 00 00 00 00 00 02 76 86
			23 00 00 00 00 00 02 77 00
			23 00 00 00 00 00 02 78 BC
			23 00 00 00 00 00 02 79 00
			23 00 00 00 00 00 02 7A DC
			23 00 00 00 00 00 02 7B 00
			23 00 00 00 00 00 02 7C F7
			23 00 00 00 00 00 02 7D 01
			23 00 00 00 00 00 02 7E 0D
			23 00 00 00 00 00 02 7F 01
			23 00 00 00 00 00 02 80 1F
			23 00 00 00 00 00 02 81 01
			23 00 00 00 00 00 02 82 2E
			23 00 00 00 00 00 02 83 01
			23 00 00 00 00 00 02 84 62
			23 00 00 00 00 00 02 85 01
			23 00 00 00 00 00 02 86 88
			23 00 00 00 00 00 02 87 01
			23 00 00 00 00 00 02 88 C0
			23 00 00 00 00 00 02 89 01
			23 00 00 00 00 00 02 8A EB
			23 00 00 00 00 00 02 8B 02
			23 00 00 00 00 00 02 8C 2A
			23 00 00 00 00 00 02 8D 02
			23 00 00 00 00 00 02 8E 5C
			23 00 00 00 00 00 02 8F 02
			23 00 00 00 00 00 02 90 5E
			23 00 00 00 00 00 02 91 02
			23 00 00 00 00 00 02 92 8D
			23 00 00 00 00 00 02 93 02
			23 00 00 00 00 00 02 94 C2
			23 00 00 00 00 00 02 95 02
			23 00 00 00 00 00 02 96 E0
			23 00 00 00 00 00 02 97 03
			23 00 00 00 00 00 02 98 06
			23 00 00 00 00 00 02 99 03
			23 00 00 00 00 00 02 9A 1C
			23 00 00 00 00 00 02 9B 03
			23 00 00 00 00 00 02 9C 37
			23 00 00 00 00 00 02 9D 03
			23 00 00 00 00 00 02 9E 3D
			23 00 00 00 00 00 02 9F 03
			23 00 00 00 00 00 02 A0 48
			23 00 00 00 00 00 02 A2 03
			23 00 00 00 00 00 02 A3 51
			23 00 00 00 00 00 02 A4 03
			23 00 00 00 00 00 02 A5 5D
			23 00 00 00 00 00 02 A6 03
			23 00 00 00 00 00 02 A7 76
			23 00 00 00 00 00 02 A9 03
			23 00 00 00 00 00 02 AA A2
			23 00 00 00 00 00 02 AB 03
			23 00 00 00 00 00 02 AC DE
			23 00 00 00 00 00 02 AD 03
			23 00 00 00 00 00 02 AE FF
			23 00 00 00 00 00 02 AF 00
			23 00 00 00 00 00 02 B0 00
			23 00 00 00 00 00 02 B1 00
			23 00 00 00 00 00 02 B2 31
			23 00 00 00 00 00 02 B3 00
			23 00 00 00 00 00 02 B4 86
			23 00 00 00 00 00 02 B5 00
			23 00 00 00 00 00 02 B6 BC
			23 00 00 00 00 00 02 B7 00
			23 00 00 00 00 00 02 B8 DC
			23 00 00 00 00 00 02 B9 00
			23 00 00 00 00 00 02 BA F7
			23 00 00 00 00 00 02 BB 01
			23 00 00 00 00 00 02 BC 0D
			23 00 00 00 00 00 02 BD 01
			23 00 00 00 00 00 02 BE 1F
			23 00 00 00 00 00 02 BF 01
			23 00 00 00 00 00 02 C0 2E
			23 00 00 00 00 00 02 C1 01
			23 00 00 00 00 00 02 C2 62
			23 00 00 00 00 00 02 C3 01
			23 00 00 00 00 00 02 C4 88
			23 00 00 00 00 00 02 C5 01
			23 00 00 00 00 00 02 C6 C0
			23 00 00 00 00 00 02 C7 01
			23 00 00 00 00 00 02 C8 EB
			23 00 00 00 00 00 02 C9 02
			23 00 00 00 00 00 02 CA 2A
			23 00 00 00 00 00 02 CB 02
			23 00 00 00 00 00 02 CC 5C
			23 00 00 00 00 00 02 CD 02
			23 00 00 00 00 00 02 CE 5E
			23 00 00 00 00 00 02 CF 02
			23 00 00 00 00 00 02 D0 8D
			23 00 00 00 00 00 02 D1 02
			23 00 00 00 00 00 02 D2 C2
			23 00 00 00 00 00 02 D3 02
			23 00 00 00 00 00 02 D4 E0
			23 00 00 00 00 00 02 D5 03
			23 00 00 00 00 00 02 D6 06
			23 00 00 00 00 00 02 D7 03
			23 00 00 00 00 00 02 D8 1C
			23 00 00 00 00 00 02 D9 03
			23 00 00 00 00 00 02 DA 37
			23 00 00 00 00 00 02 DB 03
			23 00 00 00 00 00 02 DC 3D
			23 00 00 00 00 00 02 DD 03
			23 00 00 00 00 00 02 DE 48
			23 00 00 00 00 00 02 DF 03
			23 00 00 00 00 00 02 E0 51
			23 00 00 00 00 00 02 E1 03
			23 00 00 00 00 00 02 E2 5D
			23 00 00 00 00 00 02 E3 03
			23 00 00 00 00 00 02 E4 76
			23 00 00 00 00 00 02 E5 03
			23 00 00 00 00 00 02 E6 A2
			23 00 00 00 00 00 02 E7 03
			23 00 00 00 00 00 02 E8 DE
			23 00 00 00 00 00 02 E9 03
			23 00 00 00 00 00 02 EA FF
			23 00 00 00 00 00 02 FB 01
			23 01 00 00 00 00 02 FF 10];
		qcom,mdss-dsi-on-command = [
			15 01 00 00 00 00 02 35 00
			39 01 00 00 00 00 03 44 07 78
			39 01 00 00 00 00 0C C9 49 02 05 00 0F 06 67 03 2E 10 F0
			39 01 00 00 00 00 05 2A 00 00 04 37
			39 01 00 00 00 00 05 2B 00 00 07 7F
			23 01 00 00 00 00 02 FB 01
			05 01 00 00 65 00 02 11 00
			05 01 00 00 29 00 02 29 00];
		qcom,mdss-dsi-off-command = [
	        05 01 00 00 00 00 02 28 00
	        05 01 00 00 3d 00 02 10 00];

		qcom,mdss-dsi-on-command-state = "dsi_lp_mode";
		qcom,mdss-dsi-off-command-state = "dsi_hs_mode";
		qcom,mdss-dsi-h-sync-pulse = <0>;
		qcom,mdss-dsi-traffic-mode = "burst_mode";
		qcom,mdss-dsi-lane-map = "lane_map_0123";
		qcom,mdss-dsi-bllp-eof-power-mode;
		qcom,mdss-dsi-bllp-power-mode;

		qcom,mdss-dsi-lane-0-state;
		qcom,mdss-dsi-lane-1-state;
		qcom,mdss-dsi-lane-2-state;
		qcom,mdss-dsi-lane-3-state;

		qcom,mdss-dsi-panel-timings = [e6 38 26 00 68 6c 2a 3a 2c 03 04 00];
		qcom,mdss-dsi-t-clk-post = <0x03>;
		qcom,mdss-dsi-t-clk-pre = <0x29>;
		qcom,mdss-dsi-dma-trigger = "trigger_sw";
		qcom,mdss-dsi-mdp-trigger = "none";

		qcom,mdss-dsi-te-pin-select = <1>;
		qcom,mdss-dsi-wr-mem-start = <0x2c>;
		qcom,mdss-dsi-wr-mem-continue = <0x3c>;
		qcom,mdss-dsi-te-dcs-command = <1>;
		qcom,mdss-dsi-te-check-enable;
		qcom,mdss-dsi-te-using-te-pin;

		qcom,mdss-dsi-bl-pmic-control-type = "bl_ctrl_wled";
		qcom,mdss-dsi-bl-min-level = <1>;
		qcom,mdss-dsi-bl-max-level = <4095>;
		qcom,mdss-dsi-reset-sequence = <0 10>, <1 10>, <0 1>, <1 0>;

		qcom,bl-default-lvl = <1800>;

		qcom,partial-update-enabled;
		qcom,panel-roi-alignment = <0 0 16 16 1080 0>;
	};

	dsi_jd35695b_1080p_cmd_type00: qcom,mdss_dsi_jd35695b_1080p_cmd_type00 {
		compatible = "qcom,mdss-dsi-panel";
		status = "ok";
		qcom,cont-splash-enabled;
		qcom,mdss-dsi-panel-name = "jd35695b 1080p cmd mode dsi panel";
		qcom,mdss-dsi-panel-controller = <&mdss_dsi0>;
		qcom,mdss-dsi-panel-type = "dsi_cmd_mode";
		qcom,mdss-dsi-panel-destination = "display_1";
		qcom,mdss-dsi-panel-framerate = <60>;
		qcom,mdss-dsi-virtual-channel-id = <0>;
		qcom,mdss-dsi-stream = <0>;
		qcom,mdss-dsi-panel-width = <1080>;
		qcom,mdss-dsi-panel-height = <1920>;
		qcom,mdss-dsi-h-front-porch = <120>;
		qcom,mdss-dsi-h-back-porch = <76>;
		qcom,mdss-dsi-h-pulse-width = <4>;
		qcom,mdss-dsi-h-sync-skew = <0>;
		qcom,mdss-dsi-v-back-porch = <7>;
		qcom,mdss-dsi-v-front-porch = <8>;
		qcom,mdss-dsi-v-pulse-width = <1>;
		qcom,mdss-dsi-h-left-border = <0>;
		qcom,mdss-dsi-h-right-border = <0>;
		qcom,mdss-dsi-v-top-border = <0>;
		qcom,mdss-dsi-v-bottom-border = <0>;
		qcom,mdss-pan-physical-width-dimension = <65>;
		qcom,mdss-pan-physical-height-dimension = <115>;
		qcom,mdss-dsi-bpp = <24>;
		qcom,mdss-dsi-color-order = "rgb_swap_rgb";
		qcom,mdss-dsi-underflow-color = <0x00>;
		qcom,mdss-dsi-init-delay-us = <20000>;
		qcom,mdss-dsi-border-color = <0>;
		qcom,ulps-enabled;
		qcom,mdss-dsi-gamma-default = [
			23 00 00 00 00 00 02 FF 20
			23 00 00 00 00 00 02 75 00
			23 00 00 00 00 00 02 76 00
			23 00 00 00 00 00 02 77 00
			23 00 00 00 00 00 02 78 2A
			23 00 00 00 00 00 02 79 00
			23 00 00 00 00 00 02 7A 72
			23 00 00 00 00 00 02 7B 00
			23 00 00 00 00 00 02 7C A1
			23 00 00 00 00 00 02 7D 00
			23 00 00 00 00 00 02 7E C0
			23 00 00 00 00 00 02 7F 00
			23 00 00 00 00 00 02 80 DA
			23 00 00 00 00 00 02 81 00
			23 00 00 00 00 00 02 82 F3
			23 00 00 00 00 00 02 83 01
			23 00 00 00 00 00 02 84 07
			23 00 00 00 00 00 02 85 01
			23 00 00 00 00 00 02 86 19
			23 00 00 00 00 00 02 87 01
			23 00 00 00 00 00 02 88 52
			23 00 00 00 00 00 02 89 01
			23 00 00 00 00 00 02 8A 7B
			23 00 00 00 00 00 02 8B 01
			23 00 00 00 00 00 02 8C B8
			23 00 00 00 00 00 02 8D 01
			23 00 00 00 00 00 02 8E E5
			23 00 00 00 00 00 02 8F 02
			23 00 00 00 00 00 02 90 27
			23 00 00 00 00 00 02 91 02
			23 00 00 00 00 00 02 92 5A
			23 00 00 00 00 00 02 93 02
			23 00 00 00 00 00 02 94 5C
			23 00 00 00 00 00 02 95 02
			23 00 00 00 00 00 02 96 8B
			23 00 00 00 00 00 02 97 02
			23 00 00 00 00 00 02 98 BF
			23 00 00 00 00 00 02 99 02
			23 00 00 00 00 00 02 9A DE
			23 00 00 00 00 00 02 9B 03
			23 00 00 00 00 00 02 9C 04
			23 00 00 00 00 00 02 9D 03
			23 00 00 00 00 00 02 9E 1A
			23 00 00 00 00 00 02 9F 03
			23 00 00 00 00 00 02 A0 36
			23 00 00 00 00 00 02 A2 03
			23 00 00 00 00 00 02 A3 3D
			23 00 00 00 00 00 02 A4 03
			23 00 00 00 00 00 02 A5 44
			23 00 00 00 00 00 02 A6 03
			23 00 00 00 00 00 02 A7 4C
			23 00 00 00 00 00 02 A9 03
			23 00 00 00 00 00 02 AA 58
			23 00 00 00 00 00 02 AB 03
			23 00 00 00 00 00 02 AC 70
			23 00 00 00 00 00 02 AD 03
			23 00 00 00 00 00 02 AE 9C
			23 00 00 00 00 00 02 AF 03
			23 00 00 00 00 00 02 B0 DC
			23 00 00 00 00 00 02 B1 03
			23 00 00 00 00 00 02 B2 FF
			23 00 00 00 00 00 02 B3 00
			23 00 00 00 00 00 02 B4 00
			23 00 00 00 00 00 02 B5 00
			23 00 00 00 00 00 02 B6 2A
			23 00 00 00 00 00 02 B7 00
			23 00 00 00 00 00 02 B8 72
			23 00 00 00 00 00 02 B9 00
			23 00 00 00 00 00 02 BA A1
			23 00 00 00 00 00 02 BB 00
			23 00 00 00 00 00 02 BC C0
			23 00 00 00 00 00 02 BD 00
			23 00 00 00 00 00 02 BE DA
			23 00 00 00 00 00 02 BF 00
			23 00 00 00 00 00 02 C0 F3
			23 00 00 00 00 00 02 C1 01
			23 00 00 00 00 00 02 C2 07
			23 00 00 00 00 00 02 C3 01
			23 00 00 00 00 00 02 C4 19
			23 00 00 00 00 00 02 C5 01
			23 00 00 00 00 00 02 C6 52
			23 00 00 00 00 00 02 C7 01
			23 00 00 00 00 00 02 C8 7B
			23 00 00 00 00 00 02 C9 01
			23 00 00 00 00 00 02 CA B8
			23 00 00 00 00 00 02 CB 01
			23 00 00 00 00 00 02 CC E5
			23 00 00 00 00 00 02 CD 02
			23 00 00 00 00 00 02 CE 27
			23 00 00 00 00 00 02 CF 02
			23 00 00 00 00 00 02 D0 5A
			23 00 00 00 00 00 02 D1 02
			23 00 00 00 00 00 02 D2 5C
			23 00 00 00 00 00 02 D3 02
			23 00 00 00 00 00 02 D4 8B
			23 00 00 00 00 00 02 D5 02
			23 00 00 00 00 00 02 D6 BF
			23 00 00 00 00 00 02 D7 02
			23 00 00 00 00 00 02 D8 DE
			23 00 00 00 00 00 02 D9 03
			23 00 00 00 00 00 02 DA 04
			23 00 00 00 00 00 02 DB 03
			23 00 00 00 00 00 02 DC 1A
			23 00 00 00 00 00 02 DD 03
			23 00 00 00 00 00 02 DE 36
			23 00 00 00 00 00 02 DF 03
			23 00 00 00 00 00 02 E0 3D
			23 00 00 00 00 00 02 E1 03
			23 00 00 00 00 00 02 E2 44
			23 00 00 00 00 00 02 E3 03
			23 00 00 00 00 00 02 E4 4C
			23 00 00 00 00 00 02 E5 03
			23 00 00 00 00 00 02 E6 58
			23 00 00 00 00 00 02 E7 03
			23 00 00 00 00 00 02 E8 70
			23 00 00 00 00 00 02 E9 03
			23 00 00 00 00 00 02 EA 9C
			23 00 00 00 00 00 02 EB 03
			23 00 00 00 00 00 02 EC DC
			23 00 00 00 00 00 02 ED 03
			23 00 00 00 00 00 02 EE FF
			23 00 00 00 00 00 02 EF 00
			23 00 00 00 00 00 02 F0 00
			23 00 00 00 00 00 02 F1 00
			23 00 00 00 00 00 02 F2 2F
			23 00 00 00 00 00 02 F3 00
			23 00 00 00 00 00 02 F4 81
			23 00 00 00 00 00 02 F5 00
			23 00 00 00 00 00 02 F6 B2
			23 00 00 00 00 00 02 F7 00
			23 00 00 00 00 00 02 F8 CF
			23 00 00 00 00 00 02 F9 00
			23 00 00 00 00 00 02 FA E8
			23 00 00 00 00 00 02 FB 01
			23 00 00 00 00 00 02 FF 21
			23 00 00 00 00 00 02 00 01
			23 00 00 00 00 00 02 01 00
			23 00 00 00 00 00 02 02 01
			23 00 00 00 00 00 02 03 14
			23 00 00 00 00 00 02 04 01
			23 00 00 00 00 00 02 05 25
			23 00 00 00 00 00 02 06 01
			23 00 00 00 00 00 02 07 5C
			23 00 00 00 00 00 02 08 01
			23 00 00 00 00 00 02 09 84
			23 00 00 00 00 00 02 0A 01
			23 00 00 00 00 00 02 0B BF
			23 00 00 00 00 00 02 0C 01
			23 00 00 00 00 00 02 0D EB
			23 00 00 00 00 00 02 0E 02
			23 00 00 00 00 00 02 0F 2B
			23 00 00 00 00 00 02 10 02
			23 00 00 00 00 00 02 11 5E
			23 00 00 00 00 00 02 12 02
			23 00 00 00 00 00 02 13 5F
			23 00 00 00 00 00 02 14 02
			23 00 00 00 00 00 02 15 8E
			23 00 00 00 00 00 02 16 02
			23 00 00 00 00 00 02 17 C2
			23 00 00 00 00 00 02 18 02
			23 00 00 00 00 00 02 19 E1
			23 00 00 00 00 00 02 1A 03
			23 00 00 00 00 00 02 1B 07
			23 00 00 00 00 00 02 1C 03
			23 00 00 00 00 00 02 1D 1E
			23 00 00 00 00 00 02 1E 03
			23 00 00 00 00 00 02 1F 39
			23 00 00 00 00 00 02 20 03
			23 00 00 00 00 00 02 21 41
			23 00 00 00 00 00 02 22 03
			23 00 00 00 00 00 02 23 48
			23 00 00 00 00 00 02 24 03
			23 00 00 00 00 00 02 25 50
			23 00 00 00 00 00 02 26 03
			23 00 00 00 00 00 02 27 5C
			23 00 00 00 00 00 02 28 03
			23 00 00 00 00 00 02 29 74
			23 00 00 00 00 00 02 2A 03
			23 00 00 00 00 00 02 2B 9F
			23 00 00 00 00 00 02 2D 03
			23 00 00 00 00 00 02 2F DD
			23 00 00 00 00 00 02 30 03
			23 00 00 00 00 00 02 31 FF
			23 00 00 00 00 00 02 32 00
			23 00 00 00 00 00 02 33 00
			23 00 00 00 00 00 02 34 00
			23 00 00 00 00 00 02 35 2F
			23 00 00 00 00 00 02 36 00
			23 00 00 00 00 00 02 37 81
			23 00 00 00 00 00 02 38 00
			23 00 00 00 00 00 02 39 B2
			23 00 00 00 00 00 02 3A 00
			23 00 00 00 00 00 02 3B CF
			23 00 00 00 00 00 02 3D 00
			23 00 00 00 00 00 02 3F E8
			23 00 00 00 00 00 02 40 01
			23 00 00 00 00 00 02 41 00
			23 00 00 00 00 00 02 42 01
			23 00 00 00 00 00 02 43 14
			23 00 00 00 00 00 02 44 01
			23 00 00 00 00 00 02 45 25
			23 00 00 00 00 00 02 46 01
			23 00 00 00 00 00 02 47 5C
			23 00 00 00 00 00 02 48 01
			23 00 00 00 00 00 02 49 84
			23 00 00 00 00 00 02 4A 01
			23 00 00 00 00 00 02 4B BF
			23 00 00 00 00 00 02 4C 01
			23 00 00 00 00 00 02 4D EB
			23 00 00 00 00 00 02 4E 02
			23 00 00 00 00 00 02 4F 2B
			23 00 00 00 00 00 02 50 02
			23 00 00 00 00 00 02 51 5E
			23 00 00 00 00 00 02 52 02
			23 00 00 00 00 00 02 53 5F
			23 00 00 00 00 00 02 54 02
			23 00 00 00 00 00 02 55 8E
			23 00 00 00 00 00 02 56 02
			23 00 00 00 00 00 02 58 C2
			23 00 00 00 00 00 02 59 02
			23 00 00 00 00 00 02 5A E1
			23 00 00 00 00 00 02 5B 03
			23 00 00 00 00 00 02 5C 07
			23 00 00 00 00 00 02 5D 03
			23 00 00 00 00 00 02 5E 1E
			23 00 00 00 00 00 02 5F 03
			23 00 00 00 00 00 02 60 39
			23 00 00 00 00 00 02 61 03
			23 00 00 00 00 00 02 62 41
			23 00 00 00 00 00 02 63 03
			23 00 00 00 00 00 02 64 48
			23 00 00 00 00 00 02 65 03
			23 00 00 00 00 00 02 66 50
			23 00 00 00 00 00 02 67 03
			23 00 00 00 00 00 02 68 5C
			23 00 00 00 00 00 02 69 03
			23 00 00 00 00 00 02 6A 74
			23 00 00 00 00 00 02 6B 03
			23 00 00 00 00 00 02 6C 9F
			23 00 00 00 00 00 02 6D 03
			23 00 00 00 00 00 02 6E DD
			23 00 00 00 00 00 02 6F 03
			23 00 00 00 00 00 02 70 FF
			23 00 00 00 00 00 02 71 00
			23 00 00 00 00 00 02 72 00
			23 00 00 00 00 00 02 73 00
			23 00 00 00 00 00 02 74 31
			23 00 00 00 00 00 02 75 00
			23 00 00 00 00 00 02 76 84
			23 00 00 00 00 00 02 77 00
			23 00 00 00 00 00 02 78 B6
			23 00 00 00 00 00 02 79 00
			23 00 00 00 00 00 02 7A D4
			23 00 00 00 00 00 02 7B 00
			23 00 00 00 00 00 02 7C EE
			23 00 00 00 00 00 02 7D 01
			23 00 00 00 00 00 02 7E 05
			23 00 00 00 00 00 02 7F 01
			23 00 00 00 00 00 02 80 19
			23 00 00 00 00 00 02 81 01
			23 00 00 00 00 00 02 82 29
			23 00 00 00 00 00 02 83 01
			23 00 00 00 00 00 02 84 5F
			23 00 00 00 00 00 02 85 01
			23 00 00 00 00 00 02 86 86
			23 00 00 00 00 00 02 87 01
			23 00 00 00 00 00 02 88 BF
			23 00 00 00 00 00 02 89 01
			23 00 00 00 00 00 02 8A EA
			23 00 00 00 00 00 02 8B 02
			23 00 00 00 00 00 02 8C 29
			23 00 00 00 00 00 02 8D 02
			23 00 00 00 00 00 02 8E 5C
			23 00 00 00 00 00 02 8F 02
			23 00 00 00 00 00 02 90 5D
			23 00 00 00 00 00 02 91 02
			23 00 00 00 00 00 02 92 8C
			23 00 00 00 00 00 02 93 02
			23 00 00 00 00 00 02 94 C0
			23 00 00 00 00 00 02 95 02
			23 00 00 00 00 00 02 96 DF
			23 00 00 00 00 00 02 97 03
			23 00 00 00 00 00 02 98 06
			23 00 00 00 00 00 02 99 03
			23 00 00 00 00 00 02 9A 1B
			23 00 00 00 00 00 02 9B 03
			23 00 00 00 00 00 02 9C 39
			23 00 00 00 00 00 02 9D 03
			23 00 00 00 00 00 02 9E 40
			23 00 00 00 00 00 02 9F 03
			23 00 00 00 00 00 02 A0 49
			23 00 00 00 00 00 02 A2 03
			23 00 00 00 00 00 02 A3 55
			23 00 00 00 00 00 02 A4 03
			23 00 00 00 00 00 02 A5 66
			23 00 00 00 00 00 02 A6 03
			23 00 00 00 00 00 02 A7 7F
			23 00 00 00 00 00 02 A9 03
			23 00 00 00 00 00 02 AA A9
			23 00 00 00 00 00 02 AB 03
			23 00 00 00 00 00 02 AC E1
			23 00 00 00 00 00 02 AD 03
			23 00 00 00 00 00 02 AE FF
			23 00 00 00 00 00 02 AF 00
			23 00 00 00 00 00 02 B0 00
			23 00 00 00 00 00 02 B1 00
			23 00 00 00 00 00 02 B2 31
			23 00 00 00 00 00 02 B3 00
			23 00 00 00 00 00 02 B4 84
			23 00 00 00 00 00 02 B5 00
			23 00 00 00 00 00 02 B6 B6
			23 00 00 00 00 00 02 B7 00
			23 00 00 00 00 00 02 B8 D4
			23 00 00 00 00 00 02 B9 00
			23 00 00 00 00 00 02 BA EE
			23 00 00 00 00 00 02 BB 01
			23 00 00 00 00 00 02 BC 05
			23 00 00 00 00 00 02 BD 01
			23 00 00 00 00 00 02 BE 19
			23 00 00 00 00 00 02 BF 01
			23 00 00 00 00 00 02 C0 29
			23 00 00 00 00 00 02 C1 01
			23 00 00 00 00 00 02 C2 5F
			23 00 00 00 00 00 02 C3 01
			23 00 00 00 00 00 02 C4 86
			23 00 00 00 00 00 02 C5 01
			23 00 00 00 00 00 02 C6 BF
			23 00 00 00 00 00 02 C7 01
			23 00 00 00 00 00 02 C8 EA
			23 00 00 00 00 00 02 C9 02
			23 00 00 00 00 00 02 CA 29
			23 00 00 00 00 00 02 CB 02
			23 00 00 00 00 00 02 CC 5C
			23 00 00 00 00 00 02 CD 02
			23 00 00 00 00 00 02 CE 5D
			23 00 00 00 00 00 02 CF 02
			23 00 00 00 00 00 02 D0 8C
			23 00 00 00 00 00 02 D1 02
			23 00 00 00 00 00 02 D2 C0
			23 00 00 00 00 00 02 D3 02
			23 00 00 00 00 00 02 D4 DF
			23 00 00 00 00 00 02 D5 03
			23 00 00 00 00 00 02 D6 06
			23 00 00 00 00 00 02 D7 03
			23 00 00 00 00 00 02 D8 1B
			23 00 00 00 00 00 02 D9 03
			23 00 00 00 00 00 02 DA 39
			23 00 00 00 00 00 02 DB 03
			23 00 00 00 00 00 02 DC 40
			23 00 00 00 00 00 02 DD 03
			23 00 00 00 00 00 02 DE 49
			23 00 00 00 00 00 02 DF 03
			23 00 00 00 00 00 02 E0 55
			23 00 00 00 00 00 02 E1 03
			23 00 00 00 00 00 02 E2 66
			23 00 00 00 00 00 02 E3 03
			23 00 00 00 00 00 02 E4 7F
			23 00 00 00 00 00 02 E5 03
			23 00 00 00 00 00 02 E6 A9
			23 00 00 00 00 00 02 E7 03
			23 00 00 00 00 00 02 E8 E1
			23 00 00 00 00 00 02 E9 03
			23 00 00 00 00 00 02 EA FF
			23 00 00 00 00 00 02 FB 01
			23 01 00 00 00 00 02 FF 10];
		qcom,mdss-dsi-gamma-bluish = [
			23 00 00 00 00 00 02 FF 20
			23 00 00 00 00 00 02 75 01
			23 00 00 00 00 00 02 76 3B
			23 00 00 00 00 00 02 77 01
			23 00 00 00 00 00 02 78 41
			23 00 00 00 00 00 02 79 01
			23 00 00 00 00 00 02 7A 4D
			23 00 00 00 00 00 02 7B 01
			23 00 00 00 00 00 02 7C 58
			23 00 00 00 00 00 02 7D 01
			23 00 00 00 00 00 02 7E 62
			23 00 00 00 00 00 02 7F 01
			23 00 00 00 00 00 02 80 6C
			23 00 00 00 00 00 02 81 01
			23 00 00 00 00 00 02 82 75
			23 00 00 00 00 00 02 83 01
			23 00 00 00 00 00 02 84 7E
			23 00 00 00 00 00 02 85 01
			23 00 00 00 00 00 02 86 86
			23 00 00 00 00 00 02 87 01
			23 00 00 00 00 00 02 88 A3
			23 00 00 00 00 00 02 89 01
			23 00 00 00 00 00 02 8A BC
			23 00 00 00 00 00 02 8B 01
			23 00 00 00 00 00 02 8C E5
			23 00 00 00 00 00 02 8D 02
			23 00 00 00 00 00 02 8E 06
			23 00 00 00 00 00 02 8F 02
			23 00 00 00 00 00 02 90 3C
			23 00 00 00 00 00 02 91 02
			23 00 00 00 00 00 02 92 6A
			23 00 00 00 00 00 02 93 02
			23 00 00 00 00 00 02 94 6B
			23 00 00 00 00 00 02 95 02
			23 00 00 00 00 00 02 96 98
			23 00 00 00 00 00 02 97 02
			23 00 00 00 00 00 02 98 CA
			23 00 00 00 00 00 02 99 02
			23 00 00 00 00 00 02 9A E8
			23 00 00 00 00 00 02 9B 03
			23 00 00 00 00 00 02 9C 0E
			23 00 00 00 00 00 02 9D 03
			23 00 00 00 00 00 02 9E 24
			23 00 00 00 00 00 02 9F 03
			23 00 00 00 00 00 02 A0 3F
			23 00 00 00 00 00 02 A2 03
			23 00 00 00 00 00 02 A3 47
			23 00 00 00 00 00 02 A4 03
			23 00 00 00 00 00 02 A5 4D
			23 00 00 00 00 00 02 A6 03
			23 00 00 00 00 00 02 A7 55
			23 00 00 00 00 00 02 A9 03
			23 00 00 00 00 00 02 AA 60
			23 00 00 00 00 00 02 AB 03
			23 00 00 00 00 00 02 AC 77
			23 00 00 00 00 00 02 AD 03
			23 00 00 00 00 00 02 AE A1
			23 00 00 00 00 00 02 AF 03
			23 00 00 00 00 00 02 B0 DE
			23 00 00 00 00 00 02 B1 03
			23 00 00 00 00 00 02 B2 FF
			23 00 00 00 00 00 02 B3 01
			23 00 00 00 00 00 02 B4 3B
			23 00 00 00 00 00 02 B5 01
			23 00 00 00 00 00 02 B6 41
			23 00 00 00 00 00 02 B7 01
			23 00 00 00 00 00 02 B8 4D
			23 00 00 00 00 00 02 B9 01
			23 00 00 00 00 00 02 BA 58
			23 00 00 00 00 00 02 BB 01
			23 00 00 00 00 00 02 BC 62
			23 00 00 00 00 00 02 BD 01
			23 00 00 00 00 00 02 BE 6C
			23 00 00 00 00 00 02 BF 01
			23 00 00 00 00 00 02 C0 75
			23 00 00 00 00 00 02 C1 01
			23 00 00 00 00 00 02 C2 7E
			23 00 00 00 00 00 02 C3 01
			23 00 00 00 00 00 02 C4 86
			23 00 00 00 00 00 02 C5 01
			23 00 00 00 00 00 02 C6 A3
			23 00 00 00 00 00 02 C7 01
			23 00 00 00 00 00 02 C8 BC
			23 00 00 00 00 00 02 C9 01
			23 00 00 00 00 00 02 CA E5
			23 00 00 00 00 00 02 CB 02
			23 00 00 00 00 00 02 CC 06
			23 00 00 00 00 00 02 CD 02
			23 00 00 00 00 00 02 CE 3C
			23 00 00 00 00 00 02 CF 02
			23 00 00 00 00 00 02 D0 6A
			23 00 00 00 00 00 02 D1 02
			23 00 00 00 00 00 02 D2 6B
			23 00 00 00 00 00 02 D3 02
			23 00 00 00 00 00 02 D4 98
			23 00 00 00 00 00 02 D5 02
			23 00 00 00 00 00 02 D6 CA
			23 00 00 00 00 00 02 D7 02
			23 00 00 00 00 00 02 D8 E8
			23 00 00 00 00 00 02 D9 03
			23 00 00 00 00 00 02 DA 0E
			23 00 00 00 00 00 02 DB 03
			23 00 00 00 00 00 02 DC 24
			23 00 00 00 00 00 02 DD 03
			23 00 00 00 00 00 02 DE 3F
			23 00 00 00 00 00 02 DF 03
			23 00 00 00 00 00 02 E0 47
			23 00 00 00 00 00 02 E1 03
			23 00 00 00 00 00 02 E2 4D
			23 00 00 00 00 00 02 E3 03
			23 00 00 00 00 00 02 E4 55
			23 00 00 00 00 00 02 E5 03
			23 00 00 00 00 00 02 E6 60
			23 00 00 00 00 00 02 E7 03
			23 00 00 00 00 00 02 E8 77
			23 00 00 00 00 00 02 E9 03
			23 00 00 00 00 00 02 EA A1
			23 00 00 00 00 00 02 EB 03
			23 00 00 00 00 00 02 EC DE
			23 00 00 00 00 00 02 ED 03
			23 00 00 00 00 00 02 EE FF
			23 00 00 00 00 00 02 EF 00
			23 00 00 00 00 00 02 F0 F5
			23 00 00 00 00 00 02 F1 00
			23 00 00 00 00 00 02 F2 FF
			23 00 00 00 00 00 02 F3 01
			23 00 00 00 00 00 02 F4 12
			23 00 00 00 00 00 02 F5 01
			23 00 00 00 00 00 02 F6 23
			23 00 00 00 00 00 02 F7 01
			23 00 00 00 00 00 02 F8 32
			23 00 00 00 00 00 02 F9 01
			23 00 00 00 00 00 02 FA 40
			23 00 00 00 00 00 02 FB 01
			23 00 00 00 00 00 02 FF 21
			23 00 00 00 00 00 02 00 01
			23 00 00 00 00 00 02 01 4D
			23 00 00 00 00 00 02 02 01
			23 00 00 00 00 00 02 03 59
			23 00 00 00 00 00 02 04 01
			23 00 00 00 00 00 02 05 64
			23 00 00 00 00 00 02 06 01
			23 00 00 00 00 00 02 07 89
			23 00 00 00 00 00 02 08 01
			23 00 00 00 00 00 02 09 A7
			23 00 00 00 00 00 02 0A 01
			23 00 00 00 00 00 02 0B D7
			23 00 00 00 00 00 02 0C 01
			23 00 00 00 00 00 02 0D FC
			23 00 00 00 00 00 02 0E 02
			23 00 00 00 00 00 02 0F 36
			23 00 00 00 00 00 02 10 02
			23 00 00 00 00 00 02 11 65
			23 00 00 00 00 00 02 12 02
			23 00 00 00 00 00 02 13 67
			23 00 00 00 00 00 02 14 02
			23 00 00 00 00 00 02 15 94
			23 00 00 00 00 00 02 16 02
			23 00 00 00 00 00 02 17 C7
			23 00 00 00 00 00 02 18 02
			23 00 00 00 00 00 02 19 E6
			23 00 00 00 00 00 02 1A 03
			23 00 00 00 00 00 02 1B 0B
			23 00 00 00 00 00 02 1C 03
			23 00 00 00 00 00 02 1D 22
			23 00 00 00 00 00 02 1E 03
			23 00 00 00 00 00 02 1F 3C
			23 00 00 00 00 00 02 20 03
			23 00 00 00 00 00 02 21 44
			23 00 00 00 00 00 02 22 03
			23 00 00 00 00 00 02 23 4B
			23 00 00 00 00 00 02 24 03
			23 00 00 00 00 00 02 25 52
			23 00 00 00 00 00 02 26 03
			23 00 00 00 00 00 02 27 5E
			23 00 00 00 00 00 02 28 03
			23 00 00 00 00 00 02 29 75
			23 00 00 00 00 00 02 2A 03
			23 00 00 00 00 00 02 2B A0
			23 00 00 00 00 00 02 2D 03
			23 00 00 00 00 00 02 2F DD
			23 00 00 00 00 00 02 30 03
			23 00 00 00 00 00 02 31 FF
			23 00 00 00 00 00 02 32 00
			23 00 00 00 00 00 02 33 F5
			23 00 00 00 00 00 02 34 00
			23 00 00 00 00 00 02 35 FF
			23 00 00 00 00 00 02 36 01
			23 00 00 00 00 00 02 37 12
			23 00 00 00 00 00 02 38 01
			23 00 00 00 00 00 02 39 23
			23 00 00 00 00 00 02 3A 01
			23 00 00 00 00 00 02 3B 32
			23 00 00 00 00 00 02 3D 01
			23 00 00 00 00 00 02 3F 40
			23 00 00 00 00 00 02 40 01
			23 00 00 00 00 00 02 41 4D
			23 00 00 00 00 00 02 42 01
			23 00 00 00 00 00 02 43 59
			23 00 00 00 00 00 02 44 01
			23 00 00 00 00 00 02 45 64
			23 00 00 00 00 00 02 46 01
			23 00 00 00 00 00 02 47 89
			23 00 00 00 00 00 02 48 01
			23 00 00 00 00 00 02 49 A7
			23 00 00 00 00 00 02 4A 01
			23 00 00 00 00 00 02 4B D7
			23 00 00 00 00 00 02 4C 01
			23 00 00 00 00 00 02 4D FC
			23 00 00 00 00 00 02 4E 02
			23 00 00 00 00 00 02 4F 36
			23 00 00 00 00 00 02 50 02
			23 00 00 00 00 00 02 51 65
			23 00 00 00 00 00 02 52 02
			23 00 00 00 00 00 02 53 67
			23 00 00 00 00 00 02 54 02
			23 00 00 00 00 00 02 55 94
			23 00 00 00 00 00 02 56 02
			23 00 00 00 00 00 02 58 C7
			23 00 00 00 00 00 02 59 02
			23 00 00 00 00 00 02 5A E6
			23 00 00 00 00 00 02 5B 03
			23 00 00 00 00 00 02 5C 0B
			23 00 00 00 00 00 02 5D 03
			23 00 00 00 00 00 02 5E 22
			23 00 00 00 00 00 02 5F 03
			23 00 00 00 00 00 02 60 3C
			23 00 00 00 00 00 02 61 03
			23 00 00 00 00 00 02 62 44
			23 00 00 00 00 00 02 63 03
			23 00 00 00 00 00 02 64 4B
			23 00 00 00 00 00 02 65 03
			23 00 00 00 00 00 02 66 52
			23 00 00 00 00 00 02 67 03
			23 00 00 00 00 00 02 68 5E
			23 00 00 00 00 00 02 69 03
			23 00 00 00 00 00 02 6A 75
			23 00 00 00 00 00 02 6B 03
			23 00 00 00 00 00 02 6C A0
			23 00 00 00 00 00 02 6D 03
			23 00 00 00 00 00 02 6E DD
			23 00 00 00 00 00 02 6F 03
			23 00 00 00 00 00 02 70 FF
			23 00 00 00 00 00 02 71 00
			23 00 00 00 00 00 02 72 00
			23 00 00 00 00 00 02 73 00
			23 00 00 00 00 00 02 74 33
			23 00 00 00 00 00 02 75 00
			23 00 00 00 00 00 02 76 8A
			23 00 00 00 00 00 02 77 00
			23 00 00 00 00 00 02 78 BA
			23 00 00 00 00 00 02 79 00
			23 00 00 00 00 00 02 7A D4
			23 00 00 00 00 00 02 7B 00
			23 00 00 00 00 00 02 7C EC
			23 00 00 00 00 00 02 7D 01
			23 00 00 00 00 00 02 7E 04
			23 00 00 00 00 00 02 7F 01
			23 00 00 00 00 00 02 80 18
			23 00 00 00 00 00 02 81 01
			23 00 00 00 00 00 02 82 29
			23 00 00 00 00 00 02 83 01
			23 00 00 00 00 00 02 84 5E
			23 00 00 00 00 00 02 85 01
			23 00 00 00 00 00 02 86 85
			23 00 00 00 00 00 02 87 01
			23 00 00 00 00 00 02 88 BF
			23 00 00 00 00 00 02 89 01
			23 00 00 00 00 00 02 8A E9
			23 00 00 00 00 00 02 8B 02
			23 00 00 00 00 00 02 8C 29
			23 00 00 00 00 00 02 8D 02
			23 00 00 00 00 00 02 8E 5C
			23 00 00 00 00 00 02 8F 02
			23 00 00 00 00 00 02 90 5D
			23 00 00 00 00 00 02 91 02
			23 00 00 00 00 00 02 92 8C
			23 00 00 00 00 00 02 93 02
			23 00 00 00 00 00 02 94 C1
			23 00 00 00 00 00 02 95 02
			23 00 00 00 00 00 02 96 DF
			23 00 00 00 00 00 02 97 03
			23 00 00 00 00 00 02 98 07
			23 00 00 00 00 00 02 99 03
			23 00 00 00 00 00 02 9A 1D
			23 00 00 00 00 00 02 9B 03
			23 00 00 00 00 00 02 9C 37
			23 00 00 00 00 00 02 9D 03
			23 00 00 00 00 00 02 9E 3F
			23 00 00 00 00 00 02 9F 03
			23 00 00 00 00 00 02 A0 45
			23 00 00 00 00 00 02 A2 03
			23 00 00 00 00 00 02 A3 4A
			23 00 00 00 00 00 02 A4 03
			23 00 00 00 00 00 02 A5 54
			23 00 00 00 00 00 02 A6 03
			23 00 00 00 00 00 02 A7 6B
			23 00 00 00 00 00 02 A9 03
			23 00 00 00 00 00 02 AA 99
			23 00 00 00 00 00 02 AB 03
			23 00 00 00 00 00 02 AC DB
			23 00 00 00 00 00 02 AD 03
			23 00 00 00 00 00 02 AE FF
			23 00 00 00 00 00 02 AF 00
			23 00 00 00 00 00 02 B0 00
			23 00 00 00 00 00 02 B1 00
			23 00 00 00 00 00 02 B2 33
			23 00 00 00 00 00 02 B3 00
			23 00 00 00 00 00 02 B4 8A
			23 00 00 00 00 00 02 B5 00
			23 00 00 00 00 00 02 B6 BA
			23 00 00 00 00 00 02 B7 00
			23 00 00 00 00 00 02 B8 D4
			23 00 00 00 00 00 02 B9 00
			23 00 00 00 00 00 02 BA EC
			23 00 00 00 00 00 02 BB 01
			23 00 00 00 00 00 02 BC 04
			23 00 00 00 00 00 02 BD 01
			23 00 00 00 00 00 02 BE 18
			23 00 00 00 00 00 02 BF 01
			23 00 00 00 00 00 02 C0 29
			23 00 00 00 00 00 02 C1 01
			23 00 00 00 00 00 02 C2 5E
			23 00 00 00 00 00 02 C3 01
			23 00 00 00 00 00 02 C4 85
			23 00 00 00 00 00 02 C5 01
			23 00 00 00 00 00 02 C6 BF
			23 00 00 00 00 00 02 C7 01
			23 00 00 00 00 00 02 C8 E9
			23 00 00 00 00 00 02 C9 02
			23 00 00 00 00 00 02 CA 29
			23 00 00 00 00 00 02 CB 02
			23 00 00 00 00 00 02 CC 5C
			23 00 00 00 00 00 02 CD 02
			23 00 00 00 00 00 02 CE 5D
			23 00 00 00 00 00 02 CF 02
			23 00 00 00 00 00 02 D0 8C
			23 00 00 00 00 00 02 D1 02
			23 00 00 00 00 00 02 D2 C1
			23 00 00 00 00 00 02 D3 02
			23 00 00 00 00 00 02 D4 DF
			23 00 00 00 00 00 02 D5 03
			23 00 00 00 00 00 02 D6 07
			23 00 00 00 00 00 02 D7 03
			23 00 00 00 00 00 02 D8 1D
			23 00 00 00 00 00 02 D9 03
			23 00 00 00 00 00 02 DA 37
			23 00 00 00 00 00 02 DB 03
			23 00 00 00 00 00 02 DC 3F
			23 00 00 00 00 00 02 DD 03
			23 00 00 00 00 00 02 DE 45
			23 00 00 00 00 00 02 DF 03
			23 00 00 00 00 00 02 E0 4A
			23 00 00 00 00 00 02 E1 03
			23 00 00 00 00 00 02 E2 54
			23 00 00 00 00 00 02 E3 03
			23 00 00 00 00 00 02 E4 6B
			23 00 00 00 00 00 02 E5 03
			23 00 00 00 00 00 02 E6 99
			23 00 00 00 00 00 02 E7 03
			23 00 00 00 00 00 02 E8 DB
			23 00 00 00 00 00 02 E9 03
			23 00 00 00 00 00 02 EA FF
			23 00 00 00 00 00 02 FB 01
			23 01 00 00 00 00 02 FF 10];
		qcom,mdss-dsi-on-command = [
			15 01 00 00 00 00 02 35 00
			39 01 00 00 00 00 03 44 07 78
			39 01 00 00 00 00 0C C9 49 02 05 00 0F 06 67 03 2E 10 F0
			39 01 00 00 00 00 05 2A 00 00 04 37
			39 01 00 00 00 00 05 2B 00 00 07 7F
			23 01 00 00 00 00 02 FB 01
			05 01 00 00 65 00 02 11 00
			05 01 00 00 29 00 02 29 00];
		qcom,mdss-dsi-off-command = [
	        05 01 00 00 00 00 02 28 00
	        05 01 00 00 3d 00 02 10 00];

		qcom,mdss-dsi-on-command-state = "dsi_lp_mode";
		qcom,mdss-dsi-off-command-state = "dsi_hs_mode";
		qcom,mdss-dsi-h-sync-pulse = <0>;
		qcom,mdss-dsi-traffic-mode = "burst_mode";
		qcom,mdss-dsi-lane-map = "lane_map_0123";
		qcom,mdss-dsi-bllp-eof-power-mode;
		qcom,mdss-dsi-bllp-power-mode;

		qcom,mdss-dsi-lane-0-state;
		qcom,mdss-dsi-lane-1-state;
		qcom,mdss-dsi-lane-2-state;
		qcom,mdss-dsi-lane-3-state;

		qcom,mdss-dsi-panel-timings = [e6 38 26 00 68 6c 2a 3a 2c 03 04 00];
		qcom,mdss-dsi-t-clk-post = <0x03>;
		qcom,mdss-dsi-t-clk-pre = <0x29>;
		qcom,mdss-dsi-dma-trigger = "trigger_sw";
		qcom,mdss-dsi-mdp-trigger = "none";

		qcom,mdss-dsi-te-pin-select = <1>;
		qcom,mdss-dsi-wr-mem-start = <0x2c>;
		qcom,mdss-dsi-wr-mem-continue = <0x3c>;
		qcom,mdss-dsi-te-dcs-command = <1>;
		qcom,mdss-dsi-te-check-enable;
		qcom,mdss-dsi-te-using-te-pin;

		qcom,mdss-dsi-bl-pmic-control-type = "bl_ctrl_wled";
		qcom,mdss-dsi-bl-min-level = <1>;
		qcom,mdss-dsi-bl-max-level = <4095>;
		qcom,mdss-dsi-reset-sequence = <0 10>, <1 10>, <0 1>, <1 0>;

		qcom,bl-default-lvl = <1800>;

		qcom,partial-update-enabled;
		qcom,panel-roi-alignment = <0 0 16 16 1080 0>;
	};

	dsi_jd35695b_1080p_cmd_type10: qcom,mdss_dsi_jd35695b_1080p_cmd_type10 {
		compatible = "qcom,mdss-dsi-panel";
		status = "ok";
		qcom,cont-splash-enabled;
		qcom,mdss-dsi-panel-name = "jd35695b 1080p cmd mode dsi panel";
		qcom,mdss-dsi-panel-controller = <&mdss_dsi0>;
		qcom,mdss-dsi-panel-type = "dsi_cmd_mode";
		qcom,mdss-dsi-panel-destination = "display_1";
		qcom,mdss-dsi-panel-framerate = <60>;
		qcom,mdss-dsi-virtual-channel-id = <0>;
		qcom,mdss-dsi-stream = <0>;
		qcom,mdss-dsi-panel-width = <1080>;
		qcom,mdss-dsi-panel-height = <1920>;
		qcom,mdss-dsi-h-front-porch = <120>;
		qcom,mdss-dsi-h-back-porch = <76>;
		qcom,mdss-dsi-h-pulse-width = <4>;
		qcom,mdss-dsi-h-sync-skew = <0>;
		qcom,mdss-dsi-v-back-porch = <7>;
		qcom,mdss-dsi-v-front-porch = <8>;
		qcom,mdss-dsi-v-pulse-width = <1>;
		qcom,mdss-dsi-h-left-border = <0>;
		qcom,mdss-dsi-h-right-border = <0>;
		qcom,mdss-dsi-v-top-border = <0>;
		qcom,mdss-dsi-v-bottom-border = <0>;
		qcom,mdss-pan-physical-width-dimension = <65>;
		qcom,mdss-pan-physical-height-dimension = <115>;
		qcom,mdss-dsi-bpp = <24>;
		qcom,mdss-dsi-color-order = "rgb_swap_rgb";
		qcom,mdss-dsi-underflow-color = <0x00>;
		qcom,mdss-dsi-init-delay-us = <20000>;
		qcom,mdss-dsi-border-color = <0>;
		qcom,ulps-enabled;
		qcom,mdss-dsi-gamma-default = [
			23 00 00 00 00 00 02 FF 20
			23 00 00 00 00 00 02 75 00
			23 00 00 00 00 00 02 76 9F
			23 00 00 00 00 00 02 77 00
			23 00 00 00 00 00 02 78 B0
			23 00 00 00 00 00 02 79 00
			23 00 00 00 00 00 02 7A CF
			23 00 00 00 00 00 02 7B 00
			23 00 00 00 00 00 02 7C E8
			23 00 00 00 00 00 02 7D 00
			23 00 00 00 00 00 02 7E FB
			23 00 00 00 00 00 02 7F 01
			23 00 00 00 00 00 02 80 0E
			23 00 00 00 00 00 02 81 01
			23 00 00 00 00 00 02 82 1F
			23 00 00 00 00 00 02 83 01
			23 00 00 00 00 00 02 84 2D
			23 00 00 00 00 00 02 85 01
			23 00 00 00 00 00 02 86 3A
			23 00 00 00 00 00 02 87 01
			23 00 00 00 00 00 02 88 68
			23 00 00 00 00 00 02 89 01
			23 00 00 00 00 00 02 8A 8C
			23 00 00 00 00 00 02 8B 01
			23 00 00 00 00 00 02 8C C4
			23 00 00 00 00 00 02 8D 01
			23 00 00 00 00 00 02 8E EC
			23 00 00 00 00 00 02 8F 02
			23 00 00 00 00 00 02 90 2A
			23 00 00 00 00 00 02 91 02
			23 00 00 00 00 00 02 92 5C
			23 00 00 00 00 00 02 93 02
			23 00 00 00 00 00 02 94 5E
			23 00 00 00 00 00 02 95 02
			23 00 00 00 00 00 02 96 8E
			23 00 00 00 00 00 02 97 02
			23 00 00 00 00 00 02 98 C1
			23 00 00 00 00 00 02 99 02
			23 00 00 00 00 00 02 9A E0
			23 00 00 00 00 00 02 9B 03
			23 00 00 00 00 00 02 9C 06
			23 00 00 00 00 00 02 9D 03
			23 00 00 00 00 00 02 9E 20
			23 00 00 00 00 00 02 9F 03
			23 00 00 00 00 00 02 A0 38
			23 00 00 00 00 00 02 A2 03
			23 00 00 00 00 00 02 A3 40
			23 00 00 00 00 00 02 A4 03
			23 00 00 00 00 00 02 A5 47
			23 00 00 00 00 00 02 A6 03
			23 00 00 00 00 00 02 A7 4F
			23 00 00 00 00 00 02 A9 03
			23 00 00 00 00 00 02 AA 5B
			23 00 00 00 00 00 02 AB 03
			23 00 00 00 00 00 02 AC 74
			23 00 00 00 00 00 02 AD 03
			23 00 00 00 00 00 02 AE 9F
			23 00 00 00 00 00 02 AF 03
			23 00 00 00 00 00 02 B0 DD
			23 00 00 00 00 00 02 B1 03
			23 00 00 00 00 00 02 B2 FF
			23 00 00 00 00 00 02 B3 00
			23 00 00 00 00 00 02 B4 9F
			23 00 00 00 00 00 02 B5 00
			23 00 00 00 00 00 02 B6 B0
			23 00 00 00 00 00 02 B7 00
			23 00 00 00 00 00 02 B8 CF
			23 00 00 00 00 00 02 B9 00
			23 00 00 00 00 00 02 BA E8
			23 00 00 00 00 00 02 BB 00
			23 00 00 00 00 00 02 BC FB
			23 00 00 00 00 00 02 BD 01
			23 00 00 00 00 00 02 BE 0E
			23 00 00 00 00 00 02 BF 01
			23 00 00 00 00 00 02 C0 1F
			23 00 00 00 00 00 02 C1 01
			23 00 00 00 00 00 02 C2 2D
			23 00 00 00 00 00 02 C3 01
			23 00 00 00 00 00 02 C4 3A
			23 00 00 00 00 00 02 C5 01
			23 00 00 00 00 00 02 C6 68
			23 00 00 00 00 00 02 C7 01
			23 00 00 00 00 00 02 C8 8C
			23 00 00 00 00 00 02 C9 01
			23 00 00 00 00 00 02 CA C4
			23 00 00 00 00 00 02 CB 01
			23 00 00 00 00 00 02 CC EC
			23 00 00 00 00 00 02 CD 02
			23 00 00 00 00 00 02 CE 2A
			23 00 00 00 00 00 02 CF 02
			23 00 00 00 00 00 02 D0 5C
			23 00 00 00 00 00 02 D1 02
			23 00 00 00 00 00 02 D2 5E
			23 00 00 00 00 00 02 D3 02
			23 00 00 00 00 00 02 D4 8E
			23 00 00 00 00 00 02 D5 02
			23 00 00 00 00 00 02 D6 C1
			23 00 00 00 00 00 02 D7 02
			23 00 00 00 00 00 02 D8 E0
			23 00 00 00 00 00 02 D9 03
			23 00 00 00 00 00 02 DA 06
			23 00 00 00 00 00 02 DB 03
			23 00 00 00 00 00 02 DC 20
			23 00 00 00 00 00 02 DD 03
			23 00 00 00 00 00 02 DE 38
			23 00 00 00 00 00 02 DF 03
			23 00 00 00 00 00 02 E0 40
			23 00 00 00 00 00 02 E1 03
			23 00 00 00 00 00 02 E2 47
			23 00 00 00 00 00 02 E3 03
			23 00 00 00 00 00 02 E4 4F
			23 00 00 00 00 00 02 E5 03
			23 00 00 00 00 00 02 E6 5B
			23 00 00 00 00 00 02 E7 03
			23 00 00 00 00 00 02 E8 74
			23 00 00 00 00 00 02 E9 03
			23 00 00 00 00 00 02 EA 9F
			23 00 00 00 00 00 02 EB 03
			23 00 00 00 00 00 02 EC DD
			23 00 00 00 00 00 02 ED 03
			23 00 00 00 00 00 02 EE FF
			23 00 00 00 00 00 02 EF 00
			23 00 00 00 00 00 02 F0 B4
			23 00 00 00 00 00 02 F1 00
			23 00 00 00 00 00 02 F2 C3
			23 00 00 00 00 00 02 F3 00
			23 00 00 00 00 00 02 F4 DF
			23 00 00 00 00 00 02 F5 00
			23 00 00 00 00 00 02 F6 F7
			23 00 00 00 00 00 02 F7 01
			23 00 00 00 00 00 02 F8 0C
			23 00 00 00 00 00 02 F9 01
			23 00 00 00 00 00 02 FA 1F
			23 00 00 00 00 00 02 FB 01
			23 00 00 00 00 00 02 FF 21
			23 00 00 00 00 00 02 00 01
			23 00 00 00 00 00 02 01 2F
			23 00 00 00 00 00 02 02 01
			23 00 00 00 00 00 02 03 3D
			23 00 00 00 00 00 02 04 01
			23 00 00 00 00 00 02 05 4A
			23 00 00 00 00 00 02 06 01
			23 00 00 00 00 00 02 07 76
			23 00 00 00 00 00 02 08 01
			23 00 00 00 00 00 02 09 97
			23 00 00 00 00 00 02 0A 01
			23 00 00 00 00 00 02 0B CC
			23 00 00 00 00 00 02 0C 01
			23 00 00 00 00 00 02 0D F3
			23 00 00 00 00 00 02 0E 02
			23 00 00 00 00 00 02 0F 2F
			23 00 00 00 00 00 02 10 02
			23 00 00 00 00 00 02 11 61
			23 00 00 00 00 00 02 12 02
			23 00 00 00 00 00 02 13 62
			23 00 00 00 00 00 02 14 02
			23 00 00 00 00 00 02 15 91
			23 00 00 00 00 00 02 16 02
			23 00 00 00 00 00 02 17 C4
			23 00 00 00 00 00 02 18 02
			23 00 00 00 00 00 02 19 E3
			23 00 00 00 00 00 02 1A 03
			23 00 00 00 00 00 02 1B 09
			23 00 00 00 00 00 02 1C 03
			23 00 00 00 00 00 02 1D 20
			23 00 00 00 00 00 02 1E 03
			23 00 00 00 00 00 02 1F 3A
			23 00 00 00 00 00 02 20 03
			23 00 00 00 00 00 02 21 41
			23 00 00 00 00 00 02 22 03
			23 00 00 00 00 00 02 23 48
			23 00 00 00 00 00 02 24 03
			23 00 00 00 00 00 02 25 50
			23 00 00 00 00 00 02 26 03
			23 00 00 00 00 00 02 27 5D
			23 00 00 00 00 00 02 28 03
			23 00 00 00 00 00 02 29 74
			23 00 00 00 00 00 02 2A 03
			23 00 00 00 00 00 02 2B A0
			23 00 00 00 00 00 02 2D 03
			23 00 00 00 00 00 02 2F DD
			23 00 00 00 00 00 02 30 03
			23 00 00 00 00 00 02 31 FF
			23 00 00 00 00 00 02 32 00
			23 00 00 00 00 00 02 33 B4
			23 00 00 00 00 00 02 34 00
			23 00 00 00 00 00 02 35 C3
			23 00 00 00 00 00 02 36 00
			23 00 00 00 00 00 02 37 DF
			23 00 00 00 00 00 02 38 00
			23 00 00 00 00 00 02 39 F7
			23 00 00 00 00 00 02 3A 01
			23 00 00 00 00 00 02 3B 0C
			23 00 00 00 00 00 02 3D 01
			23 00 00 00 00 00 02 3F 1F
			23 00 00 00 00 00 02 40 01
			23 00 00 00 00 00 02 41 2F
			23 00 00 00 00 00 02 42 01
			23 00 00 00 00 00 02 43 3D
			23 00 00 00 00 00 02 44 01
			23 00 00 00 00 00 02 45 4A
			23 00 00 00 00 00 02 46 01
			23 00 00 00 00 00 02 47 76
			23 00 00 00 00 00 02 48 01
			23 00 00 00 00 00 02 49 97
			23 00 00 00 00 00 02 4A 01
			23 00 00 00 00 00 02 4B CC
			23 00 00 00 00 00 02 4C 01
			23 00 00 00 00 00 02 4D F3
			23 00 00 00 00 00 02 4E 02
			23 00 00 00 00 00 02 4F 2F
			23 00 00 00 00 00 02 50 02
			23 00 00 00 00 00 02 51 61
			23 00 00 00 00 00 02 52 02
			23 00 00 00 00 00 02 53 62
			23 00 00 00 00 00 02 54 02
			23 00 00 00 00 00 02 55 91
			23 00 00 00 00 00 02 56 02
			23 00 00 00 00 00 02 58 C4
			23 00 00 00 00 00 02 59 02
			23 00 00 00 00 00 02 5A E3
			23 00 00 00 00 00 02 5B 03
			23 00 00 00 00 00 02 5C 09
			23 00 00 00 00 00 02 5D 03
			23 00 00 00 00 00 02 5E 20
			23 00 00 00 00 00 02 5F 03
			23 00 00 00 00 00 02 60 3A
			23 00 00 00 00 00 02 61 03
			23 00 00 00 00 00 02 62 41
			23 00 00 00 00 00 02 63 03
			23 00 00 00 00 00 02 64 48
			23 00 00 00 00 00 02 65 03
			23 00 00 00 00 00 02 66 50
			23 00 00 00 00 00 02 67 03
			23 00 00 00 00 00 02 68 5D
			23 00 00 00 00 00 02 69 03
			23 00 00 00 00 00 02 6A 74
			23 00 00 00 00 00 02 6B 03
			23 00 00 00 00 00 02 6C A0
			23 00 00 00 00 00 02 6D 03
			23 00 00 00 00 00 02 6E DD
			23 00 00 00 00 00 02 6F 03
			23 00 00 00 00 00 02 70 FF
			23 00 00 00 00 00 02 71 00
			23 00 00 00 00 00 02 72 00
			23 00 00 00 00 00 02 73 00
			23 00 00 00 00 00 02 74 31
			23 00 00 00 00 00 02 75 00
			23 00 00 00 00 00 02 76 86
			23 00 00 00 00 00 02 77 00
			23 00 00 00 00 00 02 78 BC
			23 00 00 00 00 00 02 79 00
			23 00 00 00 00 00 02 7A DC
			23 00 00 00 00 00 02 7B 00
			23 00 00 00 00 00 02 7C F7
			23 00 00 00 00 00 02 7D 01
			23 00 00 00 00 00 02 7E 0D
			23 00 00 00 00 00 02 7F 01
			23 00 00 00 00 00 02 80 1F
			23 00 00 00 00 00 02 81 01
			23 00 00 00 00 00 02 82 2E
			23 00 00 00 00 00 02 83 01
			23 00 00 00 00 00 02 84 62
			23 00 00 00 00 00 02 85 01
			23 00 00 00 00 00 02 86 88
			23 00 00 00 00 00 02 87 01
			23 00 00 00 00 00 02 88 C0
			23 00 00 00 00 00 02 89 01
			23 00 00 00 00 00 02 8A EB
			23 00 00 00 00 00 02 8B 02
			23 00 00 00 00 00 02 8C 2A
			23 00 00 00 00 00 02 8D 02
			23 00 00 00 00 00 02 8E 5C
			23 00 00 00 00 00 02 8F 02
			23 00 00 00 00 00 02 90 5E
			23 00 00 00 00 00 02 91 02
			23 00 00 00 00 00 02 92 8D
			23 00 00 00 00 00 02 93 02
			23 00 00 00 00 00 02 94 C0
			23 00 00 00 00 00 02 95 02
			23 00 00 00 00 00 02 96 DE
			23 00 00 00 00 00 02 97 03
			23 00 00 00 00 00 02 98 04
			23 00 00 00 00 00 02 99 03
			23 00 00 00 00 00 02 9A 1C
			23 00 00 00 00 00 02 9B 03
			23 00 00 00 00 00 02 9C 35
			23 00 00 00 00 00 02 9D 03
			23 00 00 00 00 00 02 9E 3B
			23 00 00 00 00 00 02 9F 03
			23 00 00 00 00 00 02 A0 42
			23 00 00 00 00 00 02 A2 03
			23 00 00 00 00 00 02 A3 4D
			23 00 00 00 00 00 02 A4 03
			23 00 00 00 00 00 02 A5 5D
			23 00 00 00 00 00 02 A6 03
			23 00 00 00 00 00 02 A7 76
			23 00 00 00 00 00 02 A9 03
			23 00 00 00 00 00 02 AA A2
			23 00 00 00 00 00 02 AB 03
			23 00 00 00 00 00 02 AC DE
			23 00 00 00 00 00 02 AD 03
			23 00 00 00 00 00 02 AE FF
			23 00 00 00 00 00 02 AF 00
			23 00 00 00 00 00 02 B0 00
			23 00 00 00 00 00 02 B1 00
			23 00 00 00 00 00 02 B2 31
			23 00 00 00 00 00 02 B3 00
			23 00 00 00 00 00 02 B4 86
			23 00 00 00 00 00 02 B5 00
			23 00 00 00 00 00 02 B6 BC
			23 00 00 00 00 00 02 B7 00
			23 00 00 00 00 00 02 B8 DC
			23 00 00 00 00 00 02 B9 00
			23 00 00 00 00 00 02 BA F7
			23 00 00 00 00 00 02 BB 01
			23 00 00 00 00 00 02 BC 0D
			23 00 00 00 00 00 02 BD 01
			23 00 00 00 00 00 02 BE 1F
			23 00 00 00 00 00 02 BF 01
			23 00 00 00 00 00 02 C0 2E
			23 00 00 00 00 00 02 C1 01
			23 00 00 00 00 00 02 C2 62
			23 00 00 00 00 00 02 C3 01
			23 00 00 00 00 00 02 C4 88
			23 00 00 00 00 00 02 C5 01
			23 00 00 00 00 00 02 C6 C0
			23 00 00 00 00 00 02 C7 01
			23 00 00 00 00 00 02 C8 EB
			23 00 00 00 00 00 02 C9 02
			23 00 00 00 00 00 02 CA 2A
			23 00 00 00 00 00 02 CB 02
			23 00 00 00 00 00 02 CC 5C
			23 00 00 00 00 00 02 CD 02
			23 00 00 00 00 00 02 CE 5E
			23 00 00 00 00 00 02 CF 02
			23 00 00 00 00 00 02 D0 8D
			23 00 00 00 00 00 02 D1 02
			23 00 00 00 00 00 02 D2 C0
			23 00 00 00 00 00 02 D3 02
			23 00 00 00 00 00 02 D4 DE
			23 00 00 00 00 00 02 D5 03
			23 00 00 00 00 00 02 D6 04
			23 00 00 00 00 00 02 D7 03
			23 00 00 00 00 00 02 D8 1C
			23 00 00 00 00 00 02 D9 03
			23 00 00 00 00 00 02 DA 35
			23 00 00 00 00 00 02 DB 03
			23 00 00 00 00 00 02 DC 3B
			23 00 00 00 00 00 02 DD 03
			23 00 00 00 00 00 02 DE 42
			23 00 00 00 00 00 02 DF 03
			23 00 00 00 00 00 02 E0 4D
			23 00 00 00 00 00 02 E1 03
			23 00 00 00 00 00 02 E2 5D
			23 00 00 00 00 00 02 E3 03
			23 00 00 00 00 00 02 E4 76
			23 00 00 00 00 00 02 E5 03
			23 00 00 00 00 00 02 E6 A2
			23 00 00 00 00 00 02 E7 03
			23 00 00 00 00 00 02 E8 DE
			23 00 00 00 00 00 02 E9 03
			23 00 00 00 00 00 02 EA FF
			23 00 00 00 00 00 02 FB 01
			23 01 00 00 00 00 02 FF 10];
		qcom,mdss-dsi-gamma-bluish = [
			23 00 00 00 00 00 02 FF 20
			23 00 00 00 00 00 02 75 01
			23 00 00 00 00 00 02 76 4F
			23 00 00 00 00 00 02 77 01
			23 00 00 00 00 00 02 78 54
			23 00 00 00 00 00 02 79 01
			23 00 00 00 00 00 02 7A 5F
			23 00 00 00 00 00 02 7B 01
			23 00 00 00 00 00 02 7C 69
			23 00 00 00 00 00 02 7D 01
			23 00 00 00 00 00 02 7E 72
			23 00 00 00 00 00 02 7F 01
			23 00 00 00 00 00 02 80 7A
			23 00 00 00 00 00 02 81 01
			23 00 00 00 00 00 02 82 82
			23 00 00 00 00 00 02 83 01
			23 00 00 00 00 00 02 84 8A
			23 00 00 00 00 00 02 85 01
			23 00 00 00 00 00 02 86 92
			23 00 00 00 00 00 02 87 01
			23 00 00 00 00 00 02 88 AD
			23 00 00 00 00 00 02 89 01
			23 00 00 00 00 00 02 8A C5
			23 00 00 00 00 00 02 8B 01
			23 00 00 00 00 00 02 8C EB
			23 00 00 00 00 00 02 8D 02
			23 00 00 00 00 00 02 8E 0B
			23 00 00 00 00 00 02 8F 02
			23 00 00 00 00 00 02 90 3F
			23 00 00 00 00 00 02 91 02
			23 00 00 00 00 00 02 92 6C
			23 00 00 00 00 00 02 93 02
			23 00 00 00 00 00 02 94 6E
			23 00 00 00 00 00 02 95 02
			23 00 00 00 00 00 02 96 9A
			23 00 00 00 00 00 02 97 02
			23 00 00 00 00 00 02 98 CC
			23 00 00 00 00 00 02 99 02
			23 00 00 00 00 00 02 9A EA
			23 00 00 00 00 00 02 9B 03
			23 00 00 00 00 00 02 9C 10
			23 00 00 00 00 00 02 9D 03
			23 00 00 00 00 00 02 9E 26
			23 00 00 00 00 00 02 9F 03
			23 00 00 00 00 00 02 A0 41
			23 00 00 00 00 00 02 A2 03
			23 00 00 00 00 00 02 A3 48
			23 00 00 00 00 00 02 A4 03
			23 00 00 00 00 00 02 A5 4F
			23 00 00 00 00 00 02 A6 03
			23 00 00 00 00 00 02 A7 56
			23 00 00 00 00 00 02 A9 03
			23 00 00 00 00 00 02 AA 62
			23 00 00 00 00 00 02 AB 03
			23 00 00 00 00 00 02 AC 79
			23 00 00 00 00 00 02 AD 03
			23 00 00 00 00 00 02 AE A2
			23 00 00 00 00 00 02 AF 03
			23 00 00 00 00 00 02 B0 DE
			23 00 00 00 00 00 02 B1 03
			23 00 00 00 00 00 02 B2 FF
			23 00 00 00 00 00 02 B3 01
			23 00 00 00 00 00 02 B4 4F
			23 00 00 00 00 00 02 B5 01
			23 00 00 00 00 00 02 B6 54
			23 00 00 00 00 00 02 B7 01
			23 00 00 00 00 00 02 B8 5F
			23 00 00 00 00 00 02 B9 01
			23 00 00 00 00 00 02 BA 69
			23 00 00 00 00 00 02 BB 01
			23 00 00 00 00 00 02 BC 72
			23 00 00 00 00 00 02 BD 01
			23 00 00 00 00 00 02 BE 7A
			23 00 00 00 00 00 02 BF 01
			23 00 00 00 00 00 02 C0 82
			23 00 00 00 00 00 02 C1 01
			23 00 00 00 00 00 02 C2 8A
			23 00 00 00 00 00 02 C3 01
			23 00 00 00 00 00 02 C4 92
			23 00 00 00 00 00 02 C5 01
			23 00 00 00 00 00 02 C6 AD
			23 00 00 00 00 00 02 C7 01
			23 00 00 00 00 00 02 C8 C5
			23 00 00 00 00 00 02 C9 01
			23 00 00 00 00 00 02 CA EB
			23 00 00 00 00 00 02 CB 02
			23 00 00 00 00 00 02 CC 0B
			23 00 00 00 00 00 02 CD 02
			23 00 00 00 00 00 02 CE 3F
			23 00 00 00 00 00 02 CF 02
			23 00 00 00 00 00 02 D0 6C
			23 00 00 00 00 00 02 D1 02
			23 00 00 00 00 00 02 D2 6E
			23 00 00 00 00 00 02 D3 02
			23 00 00 00 00 00 02 D4 9A
			23 00 00 00 00 00 02 D5 02
			23 00 00 00 00 00 02 D6 CC
			23 00 00 00 00 00 02 D7 02
			23 00 00 00 00 00 02 D8 EA
			23 00 00 00 00 00 02 D9 03
			23 00 00 00 00 00 02 DA 10
			23 00 00 00 00 00 02 DB 03
			23 00 00 00 00 00 02 DC 26
			23 00 00 00 00 00 02 DD 03
			23 00 00 00 00 00 02 DE 41
			23 00 00 00 00 00 02 DF 03
			23 00 00 00 00 00 02 E0 48
			23 00 00 00 00 00 02 E1 03
			23 00 00 00 00 00 02 E2 4F
			23 00 00 00 00 00 02 E3 03
			23 00 00 00 00 00 02 E4 56
			23 00 00 00 00 00 02 E5 03
			23 00 00 00 00 00 02 E6 62
			23 00 00 00 00 00 02 E7 03
			23 00 00 00 00 00 02 E8 79
			23 00 00 00 00 00 02 E9 03
			23 00 00 00 00 00 02 EA A2
			23 00 00 00 00 00 02 EB 03
			23 00 00 00 00 00 02 EC DE
			23 00 00 00 00 00 02 ED 03
			23 00 00 00 00 00 02 EE FF
			23 00 00 00 00 00 02 EF 01
			23 00 00 00 00 00 02 F0 28
			23 00 00 00 00 00 02 F1 01
			23 00 00 00 00 00 02 F2 2B
			23 00 00 00 00 00 02 F3 01
			23 00 00 00 00 00 02 F4 39
			23 00 00 00 00 00 02 F5 01
			23 00 00 00 00 00 02 F6 46
			23 00 00 00 00 00 02 F7 01
			23 00 00 00 00 00 02 F8 52
			23 00 00 00 00 00 02 F9 01
			23 00 00 00 00 00 02 FA 5C
			23 00 00 00 00 00 02 FB 01
			23 00 00 00 00 00 02 FF 21
			23 00 00 00 00 00 02 00 01
			23 00 00 00 00 00 02 01 67
			23 00 00 00 00 00 02 02 01
			23 00 00 00 00 00 02 03 70
			23 00 00 00 00 00 02 04 01
			23 00 00 00 00 00 02 05 79
			23 00 00 00 00 00 02 06 01
			23 00 00 00 00 00 02 07 9B
			23 00 00 00 00 00 02 08 01
			23 00 00 00 00 00 02 09 B5
			23 00 00 00 00 00 02 0A 01
			23 00 00 00 00 00 02 0B E2
			23 00 00 00 00 00 02 0C 02
			23 00 00 00 00 00 02 0D 05
			23 00 00 00 00 00 02 0E 02
			23 00 00 00 00 00 02 0F 3B
			23 00 00 00 00 00 02 10 02
			23 00 00 00 00 00 02 11 69
			23 00 00 00 00 00 02 12 02
			23 00 00 00 00 00 02 13 6B
			23 00 00 00 00 00 02 14 02
			23 00 00 00 00 00 02 15 98
			23 00 00 00 00 00 02 16 02
			23 00 00 00 00 00 02 17 CA
			23 00 00 00 00 00 02 18 02
			23 00 00 00 00 00 02 19 E9
			23 00 00 00 00 00 02 1A 03
			23 00 00 00 00 00 02 1B 0E
			23 00 00 00 00 00 02 1C 03
			23 00 00 00 00 00 02 1D 24
			23 00 00 00 00 00 02 1E 03
			23 00 00 00 00 00 02 1F 3F
			23 00 00 00 00 00 02 20 03
			23 00 00 00 00 00 02 21 46
			23 00 00 00 00 00 02 22 03
			23 00 00 00 00 00 02 23 4D
			23 00 00 00 00 00 02 24 03
			23 00 00 00 00 00 02 25 54
			23 00 00 00 00 00 02 26 03
			23 00 00 00 00 00 02 27 60
			23 00 00 00 00 00 02 28 03
			23 00 00 00 00 00 02 29 77
			23 00 00 00 00 00 02 2A 03
			23 00 00 00 00 00 02 2B A1
			23 00 00 00 00 00 02 2D 03
			23 00 00 00 00 00 02 2F DE
			23 00 00 00 00 00 02 30 03
			23 00 00 00 00 00 02 31 FF
			23 00 00 00 00 00 02 32 01
			23 00 00 00 00 00 02 33 28
			23 00 00 00 00 00 02 34 01
			23 00 00 00 00 00 02 35 2B
			23 00 00 00 00 00 02 36 01
			23 00 00 00 00 00 02 37 39
			23 00 00 00 00 00 02 38 01
			23 00 00 00 00 00 02 39 46
			23 00 00 00 00 00 02 3A 01
			23 00 00 00 00 00 02 3B 52
			23 00 00 00 00 00 02 3D 01
			23 00 00 00 00 00 02 3F 5C
			23 00 00 00 00 00 02 40 01
			23 00 00 00 00 00 02 41 67
			23 00 00 00 00 00 02 42 01
			23 00 00 00 00 00 02 43 70
			23 00 00 00 00 00 02 44 01
			23 00 00 00 00 00 02 45 79
			23 00 00 00 00 00 02 46 01
			23 00 00 00 00 00 02 47 9B
			23 00 00 00 00 00 02 48 01
			23 00 00 00 00 00 02 49 B5
			23 00 00 00 00 00 02 4A 01
			23 00 00 00 00 00 02 4B E2
			23 00 00 00 00 00 02 4C 02
			23 00 00 00 00 00 02 4D 05
			23 00 00 00 00 00 02 4E 02
			23 00 00 00 00 00 02 4F 3B
			23 00 00 00 00 00 02 50 02
			23 00 00 00 00 00 02 51 69
			23 00 00 00 00 00 02 52 02
			23 00 00 00 00 00 02 53 6B
			23 00 00 00 00 00 02 54 02
			23 00 00 00 00 00 02 55 98
			23 00 00 00 00 00 02 56 02
			23 00 00 00 00 00 02 58 CA
			23 00 00 00 00 00 02 59 02
			23 00 00 00 00 00 02 5A E9
			23 00 00 00 00 00 02 5B 03
			23 00 00 00 00 00 02 5C 0E
			23 00 00 00 00 00 02 5D 03
			23 00 00 00 00 00 02 5E 24
			23 00 00 00 00 00 02 5F 03
			23 00 00 00 00 00 02 60 3F
			23 00 00 00 00 00 02 61 03
			23 00 00 00 00 00 02 62 46
			23 00 00 00 00 00 02 63 03
			23 00 00 00 00 00 02 64 4D
			23 00 00 00 00 00 02 65 03
			23 00 00 00 00 00 02 66 54
			23 00 00 00 00 00 02 67 03
			23 00 00 00 00 00 02 68 60
			23 00 00 00 00 00 02 69 03
			23 00 00 00 00 00 02 6A 77
			23 00 00 00 00 00 02 6B 03
			23 00 00 00 00 00 02 6C A1
			23 00 00 00 00 00 02 6D 03
			23 00 00 00 00 00 02 6E DE
			23 00 00 00 00 00 02 6F 03
			23 00 00 00 00 00 02 70 FF
			23 00 00 00 00 00 02 71 00
			23 00 00 00 00 00 02 72 00
			23 00 00 00 00 00 02 73 00
			23 00 00 00 00 00 02 74 3C
			23 00 00 00 00 00 02 75 00
			23 00 00 00 00 00 02 76 94
			23 00 00 00 00 00 02 77 00
			23 00 00 00 00 00 02 78 C4
			23 00 00 00 00 00 02 79 00
			23 00 00 00 00 00 02 7A DD
			23 00 00 00 00 00 02 7B 00
			23 00 00 00 00 00 02 7C F6
			23 00 00 00 00 00 02 7D 01
			23 00 00 00 00 00 02 7E 0D
			23 00 00 00 00 00 02 7F 01
			23 00 00 00 00 00 02 80 21
			23 00 00 00 00 00 02 81 01
			23 00 00 00 00 00 02 82 31
			23 00 00 00 00 00 02 83 01
			23 00 00 00 00 00 02 84 66
			23 00 00 00 00 00 02 85 01
			23 00 00 00 00 00 02 86 8D
			23 00 00 00 00 00 02 87 01
			23 00 00 00 00 00 02 88 C7
			23 00 00 00 00 00 02 89 01
			23 00 00 00 00 00 02 8A F1
			23 00 00 00 00 00 02 8B 02
			23 00 00 00 00 00 02 8C 2E
			23 00 00 00 00 00 02 8D 02
			23 00 00 00 00 00 02 8E 60
			23 00 00 00 00 00 02 8F 02
			23 00 00 00 00 00 02 90 62
			23 00 00 00 00 00 02 91 02
			23 00 00 00 00 00 02 92 90
			23 00 00 00 00 00 02 93 02
			23 00 00 00 00 00 02 94 C3
			23 00 00 00 00 00 02 95 02
			23 00 00 00 00 00 02 96 E2
			23 00 00 00 00 00 02 97 03
			23 00 00 00 00 00 02 98 08
			23 00 00 00 00 00 02 99 03
			23 00 00 00 00 00 02 9A 1A
			23 00 00 00 00 00 02 9B 03
			23 00 00 00 00 00 02 9C 32
			23 00 00 00 00 00 02 9D 03
			23 00 00 00 00 00 02 9E 39
			23 00 00 00 00 00 02 9F 03
			23 00 00 00 00 00 02 A0 40
			23 00 00 00 00 00 02 A2 03
			23 00 00 00 00 00 02 A3 48
			23 00 00 00 00 00 02 A4 03
			23 00 00 00 00 00 02 A5 56
			23 00 00 00 00 00 02 A6 03
			23 00 00 00 00 00 02 A7 6E
			23 00 00 00 00 00 02 A9 03
			23 00 00 00 00 00 02 AA 9C
			23 00 00 00 00 00 02 AB 03
			23 00 00 00 00 00 02 AC DC
			23 00 00 00 00 00 02 AD 03
			23 00 00 00 00 00 02 AE FF
			23 00 00 00 00 00 02 AF 00
			23 00 00 00 00 00 02 B0 00
			23 00 00 00 00 00 02 B1 00
			23 00 00 00 00 00 02 B2 3C
			23 00 00 00 00 00 02 B3 00
			23 00 00 00 00 00 02 B4 94
			23 00 00 00 00 00 02 B5 00
			23 00 00 00 00 00 02 B6 C4
			23 00 00 00 00 00 02 B7 00
			23 00 00 00 00 00 02 B8 DD
			23 00 00 00 00 00 02 B9 00
			23 00 00 00 00 00 02 BA F6
			23 00 00 00 00 00 02 BB 01
			23 00 00 00 00 00 02 BC 0D
			23 00 00 00 00 00 02 BD 01
			23 00 00 00 00 00 02 BE 21
			23 00 00 00 00 00 02 BF 01
			23 00 00 00 00 00 02 C0 31
			23 00 00 00 00 00 02 C1 01
			23 00 00 00 00 00 02 C2 66
			23 00 00 00 00 00 02 C3 01
			23 00 00 00 00 00 02 C4 8D
			23 00 00 00 00 00 02 C5 01
			23 00 00 00 00 00 02 C6 C7
			23 00 00 00 00 00 02 C7 01
			23 00 00 00 00 00 02 C8 F1
			23 00 00 00 00 00 02 C9 02
			23 00 00 00 00 00 02 CA 2E
			23 00 00 00 00 00 02 CB 02
			23 00 00 00 00 00 02 CC 60
			23 00 00 00 00 00 02 CD 02
			23 00 00 00 00 00 02 CE 62
			23 00 00 00 00 00 02 CF 02
			23 00 00 00 00 00 02 D0 90
			23 00 00 00 00 00 02 D1 02
			23 00 00 00 00 00 02 D2 C3
			23 00 00 00 00 00 02 D3 02
			23 00 00 00 00 00 02 D4 E2
			23 00 00 00 00 00 02 D5 03
			23 00 00 00 00 00 02 D6 08
			23 00 00 00 00 00 02 D7 03
			23 00 00 00 00 00 02 D8 1A
			23 00 00 00 00 00 02 D9 03
			23 00 00 00 00 00 02 DA 32
			23 00 00 00 00 00 02 DB 03
			23 00 00 00 00 00 02 DC 39
			23 00 00 00 00 00 02 DD 03
			23 00 00 00 00 00 02 DE 40
			23 00 00 00 00 00 02 DF 03
			23 00 00 00 00 00 02 E0 48
			23 00 00 00 00 00 02 E1 03
			23 00 00 00 00 00 02 E2 56
			23 00 00 00 00 00 02 E3 03
			23 00 00 00 00 00 02 E4 6E
			23 00 00 00 00 00 02 E5 03
			23 00 00 00 00 00 02 E6 9C
			23 00 00 00 00 00 02 E7 03
			23 00 00 00 00 00 02 E8 DC
			23 00 00 00 00 00 02 E9 03
			23 00 00 00 00 00 02 EA FF
			23 00 00 00 00 00 02 FB 01
			23 01 00 00 00 00 02 FF 10];
		qcom,mdss-dsi-on-command = [
			15 01 00 00 00 00 02 35 00
			39 01 00 00 00 00 03 44 07 78
			39 01 00 00 00 00 0C C9 49 02 05 00 0F 06 67 03 2E 10 F0
			39 01 00 00 00 00 05 2A 00 00 04 37
			39 01 00 00 00 00 05 2B 00 00 07 7F
			23 01 00 00 00 00 02 FB 01
			05 01 00 00 65 00 02 11 00
			05 01 00 00 29 00 02 29 00];
		qcom,mdss-dsi-off-command = [
	        05 01 00 00 00 00 02 28 00
	        05 01 00 00 3d 00 02 10 00];

		qcom,mdss-dsi-on-command-state = "dsi_lp_mode";
		qcom,mdss-dsi-off-command-state = "dsi_hs_mode";
		qcom,mdss-dsi-h-sync-pulse = <0>;
		qcom,mdss-dsi-traffic-mode = "burst_mode";
		qcom,mdss-dsi-lane-map = "lane_map_0123";
		qcom,mdss-dsi-bllp-eof-power-mode;
		qcom,mdss-dsi-bllp-power-mode;

		qcom,mdss-dsi-lane-0-state;
		qcom,mdss-dsi-lane-1-state;
		qcom,mdss-dsi-lane-2-state;
		qcom,mdss-dsi-lane-3-state;

		qcom,mdss-dsi-panel-timings = [e6 38 26 00 68 6c 2a 3a 2c 03 04 00];
		qcom,mdss-dsi-t-clk-post = <0x03>;
		qcom,mdss-dsi-t-clk-pre = <0x29>;
		qcom,mdss-dsi-dma-trigger = "trigger_sw";
		qcom,mdss-dsi-mdp-trigger = "none";

		qcom,mdss-dsi-te-pin-select = <1>;
		qcom,mdss-dsi-wr-mem-start = <0x2c>;
		qcom,mdss-dsi-wr-mem-continue = <0x3c>;
		qcom,mdss-dsi-te-dcs-command = <1>;
		qcom,mdss-dsi-te-check-enable;
		qcom,mdss-dsi-te-using-te-pin;

		qcom,mdss-dsi-bl-pmic-control-type = "bl_ctrl_wled";
		qcom,mdss-dsi-bl-min-level = <1>;
		qcom,mdss-dsi-bl-max-level = <4095>;
		qcom,mdss-dsi-reset-sequence = <0 10>, <1 10>, <0 1>, <1 0>;

		qcom,bl-default-lvl = <1800>;

		qcom,partial-update-enabled;
		qcom,panel-roi-alignment = <0 0 16 16 1080 0>;
	};
};
