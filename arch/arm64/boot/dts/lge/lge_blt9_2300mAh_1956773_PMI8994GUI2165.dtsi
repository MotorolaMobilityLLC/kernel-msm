qcom,lge_blt9_2300mAh_1956773_PMI8994GUI2165 {
	/* #lge_blt9_2300mAh_1956773_PMI8994GUI2165*/
	qcom,max-voltage-uv = <4350000>;
	qcom,nom-batt-capacity-mah = <2300>;
	qcom,batt-id-kohm = <0>;
	qcom,battery-beta = <4150>;
	qcom,battery-type = "lge_blt9_2300mAh_1956773_PMI8994GUI2165";
	qcom,chg-rslow-comp-c1 = <2539897>;
	qcom,chg-rslow-comp-c2 = <2740054>;
	qcom,chg-rs-to-rslow = <1365421>;
	qcom,chg-rslow-comp-thr = <0x99>;
	qcom,checksum = <0x39D4>;
	qcom,gui-version = "PMI8994GUI - 2.1.6.5";
	qcom,fg-profile-data = [
		 D0 83 10 7C
		 62 80 25 76
		 71 83 C9 7C
		 62 90 ED 96
		 08 82 35 99
		 DF B6 10 C2
		 56 16 D5 83
		 99 77 1D 80
		 92 75 83 83
		 F2 7D 43 91
		 40 9C 3A 82
		 BA 98 62 B6
		 C0 C1 52 17
		 8B 08 FF 5B
		 CE 6E 71 FD
		 97 36 70 46
		 97 40 00 00
		 44 4C D4 10
		 DE 2B 00 00
		 00 00 00 00
		 00 00 00 00
		 DD 72 E7 70
		 88 7C D9 81
		 07 7C 3C 70
		 AC 61 52 82
		 7A 75 4F 63
		 60 39 23 9A
		 47 27 62 00
		 5D A0 71 0C
		 28 00 FF 36
		 F0 11 30 03
		 00 00 00 0C
	];
};
