&spi_7 {
	sensorhub@0 {
		compatible = "contexthub,spich";
		reg = <0>;
		spi-max-frequency = <25000000>;
		spi-cpol;
		spi-cpha;

		contexthub,ap2sh = <&msm_gpio 65 0x00>;
		contexthub,sh2ap = <&msm_gpio 66 0x00>;
		contexthub,nrst = <&msm_gpio 59 0x00>;
		contexthub,boot0 = <&msm_gpio 60 0x00>;

		interrupt-parent = <&msm_gpio>;
		interrupts = <66 0x2>;
		interrupt-names = "contexthub_wake_irq";

		pinctrl-names = "default";
		pinctrl-0 = <&sensorhub_ctrl_active
				&sensorhub_int1_active
				&sensorhub_int2_active>;
	};
};
