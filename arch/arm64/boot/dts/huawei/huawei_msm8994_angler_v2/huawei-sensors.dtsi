/* Copyright (c) 2014-2015, The Linux Foundation. All rights reserved.
 *
 * This program is free software; you can redistribute it and/or modify
 * it under the terms of the GNU General Public License version 2 and
 * only version 2 as published by the Free Software Foundation.
 *
 * This program is distributed in the hope that it will be useful,
 * but WITHOUT ANY WARRANTY; without even the implied warranty of
 * MERCHANTABILITY or FITNESS FOR A PARTICULAR PURPOSE.  See the
 * GNU General Public License for more details.
 */

/* BLSP1 QUP6 */
&i2c_6 {
	status = "ok";
	adux1050@2c {
		compatible = "adi,adux1050";
		reg = <0x2c>;
		interrupt-parent = <&msm_gpio>;
		interrupts = <14 0x2>;
		interrupts-name = "adux1050_2c";
		interrupt-gpio = <&msm_gpio 14 0>;
		vdd-supply = <&pm8994_l18>;
		vio-supply = <&pm8994_lvs2>;
		vdd_int-supply = <&pm8994_s4>;
		/* Specifies the initial configuration registers */
		adi,adux1050_reg = [ 00010303 00028530 000301EE 00050f51 00061902 00070270
			00080200 00092500 000a0000 000b9999 000c03e8 000d0200 000e0000 000f000c
			00109999 001105e8 00120200 00130000 0014000c 00159999 001607e8 00170200
			00180000 0019000c 00797d00 007a8000 007b8000 007c8000 ];
		/*Signifies the required Baseline for the device*/
		adi,adux1050_stg0_base = [ 00007D00 ];
		adi,adux1050_stg1_base = [ 00004e20 ];
		adi,adux1050_stg2_base = [ 00007530 ];
		adi,adux1050_stg3_base = [ 00009c40 ];
		/*Signifies the required Baseline for the device*/
		adi,adux1050_irq_flags = [ 00000002 ];  /* Signifies the irq Flag, If not set it will be set to IRQF_TRIGGER_FALLING*/
	};
};
