/* Copyright (c) 2015, The Linux Foundation. All rights reserved.
 *
 * This program is free software; you can redistribute it and/or modify
 * it under the terms of the GNU General Public License version 2 and
 * only version 2 as published by the Free Software Foundation.
 *
 * This program is distributed in the hope that it will be useful,
 * but WITHOUT ANY WARRANTY; without even the implied warranty of
 * MERCHANTABILITY or FITNESS FOR A PARTICULAR PURPOSE.  See the
 * GNU General Public License for more details.
 */

qcom,sunwoda_atl_3450mah {
	qcom,max-voltage-uv = <4400000>;
	qcom,nom-batt-capacity-mah = <3450>;
	qcom,batt-id-kohm = <22>;
	qcom,battery-beta = <3435>;
	qcom,battery-type = "sunwoda_atl_3450mah";
	qcom,chg-rslow-comp-c1 = <2327362>;
	qcom,chg-rslow-comp-c2 = <2499303>;
	qcom,chg-rs-to-rslow = <813004>;
	qcom,chg-rslow-comp-thr = <0x99>;
	qcom,checksum = <0x3C6A>;
	qcom,gui-version = "PMI8994GUI - 2.1.6.8";
	qcom,fg-profile-data = [
		 02 88 3D 7E
		 45 82 C7 7C
		 62 83 A2 6E
		 56 88 9F 8E
		 26 82 A0 99
		 63 BC A1 C8
		 5C 10 0D 88
		 8A 7E 67 82
		 DE 7C 58 83
		 07 68 6C 7B
		 01 8C 56 82
		 69 99 A8 BC
		 76 C9 5B 0E
		 57 0E 34 5A
		 14 70 35 FE
		 5E 3D 3A 44
		 07 39 00 00
		 10 4C D1 38
		 FE 12 00 00
		 00 00 00 00
		 00 00 00 00
		 95 6B 45 6A
		 FB 60 7F 88
		 D6 74 6F 63
		 11 62 2C 81
		 AF 6F 9C 61
		 44 7E 38 AA
		 18 9E 62 DD
		 65 A0 71 0C
		 28 00 FF 36
		 F0 11 30 03
		 00 00 00 0C
	];
};
