/* Copyright (c) 2014-2015, The Linux Foundation. All rights reserved.
 *
 * This program is free software; you can redistribute it and/or modify
 * it under the terms of the GNU General Public License version 2 and
 * only version 2 as published by the Free Software Foundation.
 *
 * This program is distributed in the hope that it will be useful,
 * but WITHOUT ANY WARRANTY; without even the implied warranty of
 * MERCHANTABILITY or FITNESS FOR A PARTICULAR PURPOSE.  See the
 * GNU General Public License for more details.
 */

/*---------------------------------------------------------------------------
 * This file is autogenerated file using gcdb parser. Please do not edit it.
 * Update input XML file to add a new entry or update variable in this file
 * VERSION = "1.0"
 *---------------------------------------------------------------------------*/
&mdss_mdp {
	dsi_samsung_s6e3ha3x01_5p7_1440p_cmd_0: qcom,mdss_dsi_dualmipi0_cmd {
		qcom,mdss-dsi-panel-name = "SAMSUNG_S6E3HA3X01_5P7_1440P_CMD_DUAL0";
		qcom,cont-splash-enabled;
		qcom,mdss-dsi-panel-controller = <&mdss_dsi0>;
		qcom,mdss-dsi-panel-type = "dsi_cmd_mode";
		qcom,mdss-dsi-panel-destination = "display_1";
		/*qcom,mdss-dsi-panel-clockrate = <760000000>;*/
		qcom,mdss-dsi-panel-framerate = <60>;
		qcom,mdss-dsi-virtual-channel-id = <0>;
		qcom,mdss-dsi-stream = <0>;
		qcom,mdss-dsi-panel-width = <720>;
		qcom,mdss-dsi-panel-height = <2560>;
		qcom,mdss-dsi-h-front-porch = <100>;
		qcom,mdss-dsi-h-back-porch = <100>;
		qcom,mdss-dsi-h-pulse-width = <40>;
		qcom,mdss-dsi-h-sync-skew = <0>;
		qcom,mdss-dsi-v-back-porch = <31>;
		qcom,mdss-dsi-v-front-porch = <30>;
		qcom,mdss-dsi-v-pulse-width = <8>;
		qcom,mdss-dsi-h-left-border = <0>;
		qcom,mdss-dsi-h-right-border = <0>;
		qcom,mdss-dsi-v-top-border = <0>;
		qcom,mdss-dsi-v-bottom-border = <0>;
		qcom,mdss-dsi-bpp = <24>;
		qcom,mdss-dsi-underflow-color = <0xff>;
		qcom,mdss-dsi-border-color = <0>;
		qcom,mdss-dsi-color-order = "rgb_swap_rgb";
		qcom,mdss-dsi-on-command = [05 01 00 00 05 00 02 11 00
					39 01 00 00 00 00 05 2A 00 00 05 9f
					39 01 00 00 00 00 05 2B 00 00 09 ff
					29 01 00 00 00 00 03 F0 5A 5A
					29 01 00 00 00 00 02 B0 10
					29 01 00 00 00 00 02 B5 A0
					29 01 00 00 00 00 02 C4 03
					29 01 00 00 00 00 0A F6 42 57 37 00 AA CC D0 00 00
					29 01 00 00 00 00 02 F9 03
					29 01 00 00 00 00 14 C2 00 00 D8 D8 00 80 2B 05 08 0E 07 0B 05 0D 0A 15 13 20 1E
					29 01 00 00 50 00 03 F0 A5 A5
					29 01 00 00 00 00 02 35 00
					29 01 00 00 00 00 02 36 08
					/*05 01 00 00 0A 00 02 2c 00*/
					29 01 00 00 00 00 02 53 20
					05 01 00 00 05 00 02 29 00];
		qcom,mdss-dsi-off-command = [05 01 00 00 3C 00 02 28 00
					05 01 00 00 B4 00 02 10 00];
		qcom,mdss-dsi-on-command-state = "dsi_lp_mode";
		qcom,mdss-dsi-off-command-state = "dsi_hs_mode";
		qcom,esd-check-enabled;
		qcom,mdss-dsi-panel-status-command = [06 01 00 01 05 00 02 0A 00
							06 01 00 01 05 00 02 0E 00];
		qcom,mdss-dsi-panel-status-command-state = "dsi_hs_mode";
		qcom,mdss-dsi-panel-status-check-mode = "reg_read";
		qcom,mdss-dsi-panel-status-value = <0x9c 0x80>;
		qcom,mdss-dsi-panel-status-read-length = <2>;
		qcom,mdss-dsi-panel-max-error-count = <5>;
		qcom,mdss-dsi-h-sync-pulse = <0>;
		qcom,mdss-dsi-traffic-mode = "non_burst_sync_event";
		qcom,mdss-dsi-lane-map = "lane_map_0123";
		qcom,mdss-dsi-bllp-eof-power-mode;
		qcom,mdss-dsi-bllp-power-mode;
		qcom,mdss-dsi-tx-eot-append;
		qcom,ulps-enabled;
		qcom,dcs-cmd-by-left;
		qcom,mdss-dsi-hor-line-idle = 	<0 40 256>,
						<40 120 128>,
						<120 240 64>;
		qcom,mdss-dsi-lane-0-state;
		qcom,mdss-dsi-lane-1-state;
		qcom,mdss-dsi-lane-2-state;
		qcom,mdss-dsi-lane-3-state;
		qcom,mdss-dsi-wr-mem-start = <0x2c>;
		qcom,mdss-dsi-wr-mem-continue = <0x3c>;
		qcom,mdss-dsi-te-pin-select = <1>;
		//qcom,mdss-dsi-te-v-sync-rd-ptr-irq-line = <0x2c>;
		qcom,mdss-dsi-te-dcs-command = <1>;
		qcom,mdss-dsi-te-check-enable;
		qcom,mdss-dsi-te-using-te-pin;
		qcom,mdss-dsi-panel-timings = [eb 38 26 00 6a 66 32 3c 2f 03 04 00]; //720*2560

		qcom,mdss-dsi-t-clk-post = <0x2c>;
		qcom,mdss-dsi-t-clk-pre = <0x1c>;
		qcom,dynamic-dsi-timing-enable;
		qcom,mdss-dsi-bl-min-level = <1>;
		qcom,mdss-dsi-bl-max-level = <255>;
		qcom,mdss-dsi-dma-trigger = "trigger_sw";
		qcom,mdss-dsi-mdp-trigger = "none";
		qcom,mdss-dsi-bl-pmic-control-type = "bl_ctrl_dcs";
		qcom,mdss-dsi-lp11-init;
		qcom,mdss-pan-physical-width-dimension = <71>;
		qcom,mdss-pan-physical-height-dimension = <126>;
		qcom,mdss-dsi-reset-sequence = <0 1>, <1 10>;
		qcom,panel-roi-alignment = <8 8 1 1 1 1>;
		qcom,partial-update-enabled;
		qcom,partial-update-roi-merge;
		qcom,mdss-dsi-lp-mode-on = [39 01 00 00 05 00 03 F0 5A 5A
									39 01 00 00 05 00 03 F1 5A 5A
									39 01 00 00 05 00 03 FC 5A 5A
									39 01 00 00 05 00 02 B0 17
									39 01 00 00 05 00 02 CB 10
									39 01 00 00 05 00 02 B0 2D
									39 01 00 00 05 00 02 CB CD
									39 01 00 00 05 00 02 B0 0E
									39 01 00 00 05 00 02 CB 02
									39 01 00 00 05 00 02 B0 0F
									39 01 00 00 05 00 02 CB 09
									39 01 00 00 05 00 02 B0 02
									39 01 00 00 05 00 02 F2 C9
									39 01 00 00 05 00 02 B0 03
									39 01 00 00 05 00 02 F2 C0
									39 01 00 00 05 00 02 B0 03
									39 01 00 00 05 00 02 F4 AA
									39 01 00 00 05 00 02 B0 08
									39 01 00 00 05 00 02 B1 30
									39 01 00 00 05 00 02 B0 09
									39 01 00 00 05 00 02 B1 0A
									39 01 00 00 05 00 02 B0 0D
									39 01 00 00 05 00 02 B1 10
									39 01 00 00 05 00 02 B0 00
									39 01 00 00 05 00 02 51 80
									39 01 00 00 05 00 02 F7 03
									39 01 00 00 05 00 02 FE 30
									39 01 00 00 05 00 02 FE B0
];
		qcom,mdss-dsi-lp-mode-off = [39 01 00 00 05 00 03 F0 5A 5A
										39 01 00 00 05 00 03 F1 5A 5A
									39 01 00 00 05 00 03 FC 5A 5A
									39 01 00 00 05 00 02 B0 2D
									39 01 00 00 05 00 02 CB 4D
									39 01 00 00 05 00 02 B0 17
									39 01 00 00 05 00 02 CB 04
									39 01 00 00 05 00 02 B0 0E
									39 01 00 00 05 00 02 CB 06
									39 01 00 00 05 00 02 B0 0F
									39 01 00 00 05 00 02 CB 05
									39 01 00 00 05 00 02 B0 02
									39 01 00 00 05 00 02 F2 B8
									39 01 00 00 05 00 02 B0 03
									39 01 00 00 05 00 02 F2 80
									39 01 00 00 05 00 02 B0 03
									39 01 00 00 05 00 02 F4 8A
									39 01 00 00 05 00 02 B0 08
									39 01 00 00 05 00 02 B1 10
									39 01 00 00 05 00 02 B0 09
									39 01 00 00 05 00 02 B1 0A
									39 01 00 00 05 00 02 B0 0D
									39 01 00 00 05 00 02 B1 80
									39 01 00 00 05 00 02 B0 00
									39 01 00 00 05 00 02 51 FF
									39 01 00 00 05 00 02 F7 03
									39 01 00 00 05 00 02 FE 30
									39 01 00 00 05 00 02 FE B0
];
	};
};
