/*---------------------------------------------------------------------------
 * This file is autogenerated file using huawei LCD parser. Please do not edit it.
 * Update input XML file to add a new entry or update variable in this file
 * Parser location: device/qcom/common/display/tools/huawei_lcd_panel 
 *---------------------------------------------------------------------------*/


#include "hw-panel-cmi-otm1282a-6p1-720p-cmd.dtsi"

&mdss_fb0 {
	huawei,set-brightness-enabled;
};

&mdss_dsi0 {
	/delete-property/ qcom,platform-enable-gpio;
};

