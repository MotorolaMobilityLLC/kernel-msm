/* Copyright (c) 2015, The Linux Foundation. All rights reserved.
 *
 * This program is free software; you can redistribute it and/or modify
 * it under the terms of the GNU General Public License version 2 and
 * only version 2 as published by the Free Software Foundation.
 *
 * This program is distributed in the hope that it will be useful,
 * but WITHOUT ANY WARRANTY; without even the implied warranty of
 * MERCHANTABILITY or FITNESS FOR A PARTICULAR PURPOSE.  See the
 * GNU General Public License for more details.
 */

qcom,scud_sony_3450mah {
	qcom,max-voltage-uv = <4400000>;
	qcom,nom-batt-capacity-mah = <3450>;
	qcom,batt-id-kohm = <68>;
	qcom,battery-beta = <3435>;
	qcom,battery-type = "scud_sony_3450mah";
	qcom,chg-rslow-comp-c1 = <3466762>;
	qcom,chg-rslow-comp-c2 = <4990103>;
	qcom,chg-rs-to-rslow = <996154>;
	qcom,chg-rslow-comp-thr = <0xA6>;
	qcom,checksum = <0x8D36>;
	qcom,gui-version = "PMI8994GUI - 2.1.6.8";
	qcom,fg-profile-data = [
		 F4 83 9D 7D
		 BC 81 3E 7C
		 3B 83 E8 6B
		 B4 6B 10 7D
		 EB 81 1D 9A
		 96 BC C7 C8
		 50 0F 0A 83
		 2F 71 E2 4B
		 5D 62 2D 83
		 42 79 9D 85
		 49 81 18 82
		 FF 99 04 BD
		 FA C9 7D 0E
		 2B 0E 46 5A
		 14 70 71 FD
		 1E 1D B7 47
		 8E 42 00 00
		 C0 47 2C 40
		 3F 21 00 00
		 00 00 00 00
		 00 00 00 00
		 45 70 9E 6A
		 60 75 FC 80
		 62 7C 81 70
		 D8 6D 34 80
		 09 7C 52 6B
		 8B 6D 4A A8
		 20 AE 61 5B
		 55 A0 71 0C
		 28 00 FF 36
		 F0 11 30 03
		 00 00 00 0C
	];
};
