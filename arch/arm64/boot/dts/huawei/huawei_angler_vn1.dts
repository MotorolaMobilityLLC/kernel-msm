/* Copyright (c) 2014-2015, The Linux Foundation. All rights reserved.
 *
 * This program is free software; you can redistribute it and/or modify
 * it under the terms of the GNU General Public License version 2 and
 * only version 2 as published by the Free Software Foundation.
 *
 * This program is distributed in the hope that it will be useful,
 * but WITHOUT ANY WARRANTY; without even the implied warranty of
 * MERCHANTABILITY or FITNESS FOR A PARTICULAR PURPOSE.  See the
 * GNU General Public License for more details.
 */

/dts-v1/;

#include "../qcom/msm8994-v2.0.dtsi"
#include "../qcom/msm8994-pinctrl.dtsi"
#include "../qcom/msm8994-mtp.dtsi"
#include "huawei-common.dtsi"
#include "huawei_msm8994_angler_vn1/huawei.dtsi"

/ {
	model = "Huawei Technologies, Inc. MSM8994 Angler VN1";
	compatible = "qcom,msm8994-mtp", "qcom,msm8994", "qcom,mtp";
	qcom,board-id= <8022 0>;
	huawei,modem_id = <0xFD000100 0x0>;
};
