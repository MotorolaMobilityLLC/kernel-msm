/* Copyright (c) 2015, The Linux Foundation. All rights reserved.
 *
 * This program is free software; you can redistribute it and/or modify
 * it under the terms of the GNU General Public License version 2 and
 * only version 2 as published by the Free Software Foundation.
 *
 * This program is distributed in the hope that it will be useful,
 * but WITHOUT ANY WARRANTY; without even the implied warranty of
 * MERCHANTABILITY or FITNESS FOR A PARTICULAR PURPOSE.  See the
 * GNU General Public License for more details.
 */

/{
	bcmdhd {
		compatible = "android,bcmdhd_wlan";
		wlpower_on = <&msm_gpio 113 0>;         /* wifi reg_on pin */
		wlreg_on-supply = <&pm8994_l28>;        /* wifi vddio pin */
		gpios = <&msm_gpio 37 0>;               /* wifi oob pin */
	};
};

