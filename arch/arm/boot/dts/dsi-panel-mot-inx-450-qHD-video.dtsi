/* Copyright (c) 2014, The Linux Foundation. All rights reserved.
 *
 * This program is free software; you can redistribute it and/or modify
 * it under the terms of the GNU General Public License version 2 and
 * only version 2 as published by the Free Software Foundation.
 *
 * This program is distributed in the hope that it will be useful,
 * but WITHOUT ANY WARRANTY; without even the implied warranty of
 * MERCHANTABILITY or FITNESS FOR A PARTICULAR PURPOSE.  See the
 * GNU General Public License for more details.
 */

/*---------------------------------------------------------------------------
 * This file is autogenerated file using gcdb parser. Please do not edit it.
 * Update input XML file to add a new entry or update variable in this file
 * VERSION = "1.0"
 *---------------------------------------------------------------------------*/
&mdss_mdp {
	mot_inx_450_qhd_vid_v0: qcom,mdss_dsi_mot_inx_450_qhd_video_v0 {
		qcom,mdss-dsi-panel-name = "mipi_mot_video_inx_qhd_450_v0";
		qcom,mdss-dsi-panel-supplier = "inx";
		qcom,mdss-dsi-panel-controller = <&mdss_dsi0>;
		qcom,mdss-dsi-panel-type = "dsi_video_mode";
		qcom,mdss-dsi-panel-destination = "display_1";
		qcom,mdss-dsi-panel-framerate = <60>;
		qcom,mdss-dsi-virtual-channel-id = <0>;
		qcom,mdss-dsi-stream = <0>;
		qcom,mdss-dsi-panel-width = <540>;
		qcom,mdss-dsi-panel-height = <960>;
		qcom,mdss-pan-physical-width-dimension = <55>;
		qcom,mdss-pan-physical-height-dimension = <99>;

		qcom,mdss-dsi-panel-clockrate = <513976320>;
		qcom,mdss-dsi-h-front-porch = <80>;
		qcom,mdss-dsi-h-back-porch = <80>;
		qcom,mdss-dsi-h-pulse-width = <4>;
		qcom,mdss-dsi-h-sync-skew = <0>;
		qcom,mdss-dsi-v-back-porch = <19>;
		qcom,mdss-dsi-v-front-porch = <33>;
		qcom,mdss-dsi-v-pulse-width = <2>;
		qcom,mdss-dsi-h-left-border = <0>;
		qcom,mdss-dsi-h-right-border = <0>;
		qcom,mdss-dsi-v-top-border = <0>;
		qcom,mdss-dsi-v-bottom-border = <0>;
		qcom,mdss-dsi-bpp = <24>;
		qcom,mdss-dsi-underflow-color = <0xff>;
		qcom,mdss-dsi-border-color = <0>;
		qcom,mdss-dsi-on-command = [
			29 01 00 00 00 00 05 FF AA 55 25 81
			29 01 00 00 00 00 2B F9 02 A0 00 00 15 15 04 0B 08 0A 09 10 12 05 00 15 0C 15 15 15 15 15 15 15 15 15 15 15 15 06 15 12 0D 00 02 09 08 0A 07 0E 15 15
			29 01 00 00 00 00 05 F9 00 1A 00 40
			29 01 00 00 00 00 06 F0 55 AA 52 08 00
			29 01 00 00 00 00 03 B1 68 06
			13 01 00 00 00 00 02 B6 09
			29 01 00 00 00 00 03 B7 70 70
			29 01 00 00 00 00 05 B8 01 04 04 04
			13 01 00 00 00 00 02 BC 00
			13 01 00 00 00 00 02 C1 01
			29 01 00 00 00 00 0C CA 01 E4 E4 E4 00 00 00 02 02 00 00
			29 01 00 00 00 00 06 F0 55 AA 52 08 01
			13 01 00 00 00 00 02 B0 0A
			13 01 00 00 00 00 02 B1 0A
			13 01 00 00 00 00 02 B2 00
			13 01 00 00 00 00 02 B3 10
			13 01 00 00 00 00 02 B4 06
			13 01 00 00 00 00 02 B6 44
			13 01 00 00 00 00 02 B7 34
			13 01 00 00 00 00 02 B8 14
			13 01 00 00 00 00 02 B9 35
			13 01 00 00 00 00 02 BA 14
			13 01 00 00 00 00 02 C2 00
			13 01 00 00 00 00 02 CF 00
			29 01 00 00 00 00 06 F0 55 AA 52 00 00
			15 01 00 00 00 00 02 53 2C
			15 01 00 00 00 00 02 55 82
			05 01 00 00 78 00 01 11		/* Exit sleep mode */
			15 01 00 00 00 00 02 51 FF
			05 01 00 00 28 00 01 29];	/* display on */
		qcom,mdss-dsi-off-command = [
			05 01 00 00 0a 00 01 28		/* display_off */
			05 01 00 00 78 00 01 10];	/* enter sleep mode */

		qcom,mdss-dsi-on-command-state = "dsi_lp_mode";
		qcom,mdss-dsi-off-command-state = "dsi_lp_mode";
		qcom,mdss-dsi-h-sync-pulse = <0>;
		qcom,mdss-dsi-traffic-mode = "non_burst_sync_event";
		qcom,mdss-dsi-bllp-eof-power-mode;
		qcom,mdss-dsi-bllp-power-mode;
		qcom,mdss-dsi-lane-0-state;
		qcom,mdss-dsi-lane-1-state;
		qcom,mdss-dsi-panel-timings = [8e 20 15 00 47 50 1a 24 24 03 04 00];
		qcom,mdss-dsi-t-clk-post = <0x04>;
		qcom,mdss-dsi-t-clk-pre = <0x1e>;
		qcom,mdss-dsi-bl-min-level = <1>;
		qcom,mdss-dsi-bl-max-level = <255>;
		qcom,mdss-dsi-dma-trigger = "trigger_sw";
		qcom,mdss-dsi-mdp-trigger = "none";
		qcom,mdss-dsi-bl-pmic-control-type = "bl_ctrl_wled";
		qcom,mdss-dsi-lane-map = "lane_map_3012";
		qcom,panel-en-reset-sequence = <1 2>, <0 1>, <1 21> ;
		qcom,panel-dis-reset-sequence = <0 1>;
		qcom,mdss-dsi-lp11-init;
		qcom,mdss-dsi-tx-eot-append;
	};
};
