/* Copyright (c) 2014, The Linux Foundation. All rights reserved.
 *
 * This program is free software; you can redistribute it and/or modify
 * it under the terms of the GNU General Public License version 2 and
 * only version 2 as published by the Free Software Foundation.
 *
 * This program is distributed in the hope that it will be useful,
 * but WITHOUT ANY WARRANTY; without even the implied warranty of
 * MERCHANTABILITY or FITNESS FOR A PARTICULAR PURPOSE.  See the
 * GNU General Public License for more details.
 */

/*---------------------------------------------------------------------------
 * This file is autogenerated file using gcdb parser. Please do not edit it.
 * Update input XML file to add a new entry or update variable in this file
 * VERSION = "1.0"
 *---------------------------------------------------------------------------*/
&mdss_mdp {
	mot_boe_450_qhd_vid_v2: qcom,mdss_dsi_mot_boe_450_qhd_video_v2 {
		qcom,panel-esd-power-mode-chk = <0x9C>;

		qcom,mdss-dsi-panel-name = "mipi_mot_video_boe_qhd_450_v2";
		qcom,mdss-dsi-panel-supplier = "boe";
		qcom,mdss-dsi-panel-controller = <&mdss_dsi0>;
		qcom,mdss-dsi-panel-type = "dsi_video_mode";
		qcom,mdss-dsi-panel-destination = "display_1";
		qcom,mdss-dsi-panel-framerate = <60>;
		qcom,mdss-dsi-virtual-channel-id = <0>;
		qcom,mdss-dsi-stream = <0>;
		qcom,mdss-dsi-panel-width = <540>;
		qcom,mdss-dsi-panel-height = <960>;
		qcom,mdss-pan-physical-width-dimension = <55>;
		qcom,mdss-pan-physical-height-dimension = <99>;

		qcom,mdss-dsi-panel-clockrate = <513976320>;
		qcom,mdss-dsi-h-front-porch = <80>;
		qcom,mdss-dsi-h-back-porch = <80>;
		qcom,mdss-dsi-h-pulse-width = <4>;
		qcom,mdss-dsi-h-sync-skew = <0>;
		qcom,mdss-dsi-v-back-porch = <19>;
		qcom,mdss-dsi-v-front-porch = <33>;
		qcom,mdss-dsi-v-pulse-width = <2>;
		qcom,mdss-dsi-h-left-border = <0>;
		qcom,mdss-dsi-h-right-border = <0>;
		qcom,mdss-dsi-v-top-border = <0>;
		qcom,mdss-dsi-v-bottom-border = <0>;
		qcom,mdss-dsi-bpp = <24>;
		qcom,mdss-dsi-underflow-color = <0xff>;
		qcom,mdss-dsi-border-color = <0>;
		qcom,mdss-dsi-on-command = [
			29 01 00 00 00 00 06 F0 55 AA 52 08 00
			29 01 00 00 00 00 06 B0 00 0C 40 3C 3C
			29 01 00 00 00 00 03 B1 6B 06
			13 01 00 00 00 00 02 B6 09
			29 01 00 00 00 00 03 B7 03 02
			29 01 00 00 00 00 05 B8 01 04 04 04
			13 01 00 00 00 00 02 BA 01
			29 01 00 00 00 00 03 BB 63 30
			13 01 00 00 00 00 02 BC 00
			29 01 00 00 00 00 04 CC 03 17 50
			29 01 00 00 00 00 0a D4 00 00 00 00 00 00 00 00 00
			29 01 00 00 00 00 11 D6 00 00 00 01 01 01 01 01 01 01 01 01 02 02 02 02
			29 01 00 00 00 00 0d D7 31 31 31 31 31 31 31 31 31 31 31 31
			29 01 00 00 00 00 0e D8 31 31 31 31 31 31 31 31 31 31 31 31 31
			29 01 00 00 00 00 0b E3 F0 E4 DE D7 D0 CB C9 C6 C3 C0
			29 01 00 00 00 00 06 F0 55 AA 52 08 01
			13 01 00 00 00 00 02 B0 0A
			13 01 00 00 00 00 02 B6 33
			13 01 00 00 00 00 02 B1 0A
			13 01 00 00 00 00 02 B7 24
			13 01 00 00 00 00 02 B2 01
			13 01 00 00 00 00 02 B8 33
			13 01 00 00 00 00 02 B3 0A
			13 01 00 00 00 00 02 B9 23
			13 01 00 00 00 00 02 B4 0A
			13 01 00 00 00 00 02 BA 25
			15 01 00 00 00 00 02 53 2C
			15 01 00 00 00 00 02 55 82
			05 01 00 00 78 00 01 11		/* Exit sleep mode */
			15 01 00 00 00 00 02 51 FF
			05 01 00 00 28 00 01 29];	/* display on */
		qcom,mdss-dsi-off-command = [
			05 01 00 00 0a 00 01 28		/* display_off */
			05 01 00 00 78 00 01 10];	/* enter sleep mode */

		qcom,mdss-dsi-on-command-state = "dsi_lp_mode";
		qcom,mdss-dsi-off-command-state = "dsi_lp_mode";
		qcom,mdss-dsi-h-sync-pulse = <0>;
		qcom,mdss-dsi-traffic-mode = "non_burst_sync_event";
		qcom,mdss-dsi-bllp-eof-power-mode;
		qcom,mdss-dsi-bllp-power-mode;
		qcom,mdss-dsi-lane-0-state;
		qcom,mdss-dsi-lane-1-state;
		qcom,mdss-dsi-panel-timings = [8e 20 15 00 47 50 1a 24 24 03 04 00];
		qcom,mdss-dsi-t-clk-post = <0x04>;
		qcom,mdss-dsi-t-clk-pre = <0x1e>;
		qcom,mdss-dsi-bl-min-level = <1>;
		qcom,mdss-dsi-bl-max-level = <255>;
		qcom,mdss-dsi-dma-trigger = "trigger_sw";
		qcom,mdss-dsi-mdp-trigger = "none";
		qcom,mdss-dsi-bl-pmic-control-type = "bl_ctrl_wled";
		qcom,mdss-dsi-lane-map = "lane_map_3012";
		qcom,panel-en-reset-sequence = <1 2>, <0 1>, <1 21> ;
		qcom,panel-dis-reset-sequence = <0 1>;
		qcom,mdss-dsi-lp11-init;
		qcom,mdss-dsi-tx-eot-append;
	};

	mot_boe_450_qhd_vid_v1: qcom,mdss_dsi_mot_boe_450_qhd_video_v1 {
		qcom,panel-esd-power-mode-chk = <0x9C>;

		qcom,mdss-dsi-panel-name = "mipi_mot_video_boe_qhd_450_v1";
		qcom,mdss-dsi-panel-supplier = "boe";
		qcom,mdss-dsi-panel-controller = <&mdss_dsi0>;
		qcom,mdss-dsi-panel-type = "dsi_video_mode";
		qcom,mdss-dsi-panel-destination = "display_1";
		qcom,mdss-dsi-panel-framerate = <60>;
		qcom,mdss-dsi-virtual-channel-id = <0>;
		qcom,mdss-dsi-stream = <0>;
		qcom,mdss-dsi-panel-width = <540>;
		qcom,mdss-dsi-panel-height = <960>;
		qcom,mdss-pan-physical-width-dimension = <55>;
		qcom,mdss-pan-physical-height-dimension = <99>;

		qcom,mdss-dsi-panel-clockrate = <513976320>;
		qcom,mdss-dsi-h-front-porch = <80>;
		qcom,mdss-dsi-h-back-porch = <80>;
		qcom,mdss-dsi-h-pulse-width = <4>;
		qcom,mdss-dsi-h-sync-skew = <0>;
		qcom,mdss-dsi-v-back-porch = <19>;
		qcom,mdss-dsi-v-front-porch = <33>;
		qcom,mdss-dsi-v-pulse-width = <2>;
		qcom,mdss-dsi-h-left-border = <0>;
		qcom,mdss-dsi-h-right-border = <0>;
		qcom,mdss-dsi-v-top-border = <0>;
		qcom,mdss-dsi-v-bottom-border = <0>;
		qcom,mdss-dsi-bpp = <24>;
		qcom,mdss-dsi-underflow-color = <0xff>;
		qcom,mdss-dsi-border-color = <0>;
		qcom,mdss-dsi-on-command = [
			29 01 00 00 00 00 06 F0 55 AA 52 08 00
			29 01 00 00 00 00 06 B0 00 0C 40 3C 3C
			29 01 00 00 00 00 03 B1 FC 06
			13 01 00 00 00 00 02 B6 09
			29 01 00 00 00 00 03 B7 03 02
			29 01 00 00 00 00 05 B8 01 02 02 02
			13 01 00 00 00 00 02 BA 01
			13 01 00 00 00 00 02 BC 00
			29 01 00 00 00 00 04 CC 03 17 50
			29 01 00 00 00 00 0a D4 00 00 00 00 00 00 00 00 00
			29 01 00 00 00 00 11 D6 00 00 00 01 01 01 01 01 01 01 01 01 02 02 02 02
			29 01 00 00 00 00 0d D7 31 31 31 31 31 31 31 31 31 31 31 31
			29 01 00 00 00 00 0e D8 31 31 31 31 31 31 31 31 31 31 31 31 31
			29 01 00 00 00 00 0b E3 F0 E4 DE D7 D0 CB C9 C6 C3 C0
			29 01 00 00 00 00 06 F0 55 AA 52 08 01
			13 01 00 00 00 00 02 B0 0A
			13 01 00 00 00 00 02 B6 43
			13 01 00 00 00 00 02 B1 0A
			13 01 00 00 00 00 02 B7 34
			13 01 00 00 00 00 02 B2 00
			13 01 00 00 00 00 02 B8 13
			13 01 00 00 00 00 02 B3 0A
			13 01 00 00 00 00 02 B9 23
			13 01 00 00 00 00 02 B4 0A
			13 01 00 00 00 00 02 BA 24
			15 01 00 00 00 00 02 53 2C
			15 01 00 00 00 00 02 55 82
			05 01 00 00 78 00 01 11		/* Exit sleep mode */
			15 01 00 00 00 00 02 51 FF
			05 01 00 00 28 00 01 29];	/* display on */
		qcom,mdss-dsi-off-command = [
			05 01 00 00 0a 00 01 28		/* display_off */
			05 01 00 00 78 00 01 10];	/* enter sleep mode */

		qcom,mdss-dsi-on-command-state = "dsi_lp_mode";
		qcom,mdss-dsi-off-command-state = "dsi_lp_mode";
		qcom,mdss-dsi-h-sync-pulse = <0>;
		qcom,mdss-dsi-traffic-mode = "non_burst_sync_event";
		qcom,mdss-dsi-bllp-eof-power-mode;
		qcom,mdss-dsi-bllp-power-mode;
		qcom,mdss-dsi-lane-0-state;
		qcom,mdss-dsi-lane-1-state;
		qcom,mdss-dsi-panel-timings = [8e 20 15 00 47 50 1a 24 24 03 04 00];
		qcom,mdss-dsi-t-clk-post = <0x04>;
		qcom,mdss-dsi-t-clk-pre = <0x1e>;
		qcom,mdss-dsi-bl-min-level = <1>;
		qcom,mdss-dsi-bl-max-level = <255>;
		qcom,mdss-dsi-dma-trigger = "trigger_sw";
		qcom,mdss-dsi-mdp-trigger = "none";
		qcom,mdss-dsi-bl-pmic-control-type = "bl_ctrl_wled";
		qcom,mdss-dsi-lane-map = "lane_map_3012";
		qcom,panel-en-reset-sequence = <1 2>, <0 1>, <1 21> ;
		qcom,panel-dis-reset-sequence = <0 1>;
		qcom,mdss-dsi-lp11-init;
		qcom,mdss-dsi-tx-eot-append;
	};

	mot_boe_450_qhd_vid_v0: qcom,mdss_dsi_mot_boe_450_qhd_video_v0 {
		qcom,panel-esd-power-mode-chk = <0x9C>;

		qcom,mdss-dsi-panel-name = "mipi_mot_video_boe_qhd_450_v0";
		qcom,mdss-dsi-panel-supplier = "boe";
		qcom,mdss-dsi-panel-controller = <&mdss_dsi0>;
		qcom,mdss-dsi-panel-type = "dsi_video_mode";
		qcom,mdss-dsi-panel-destination = "display_1";
		qcom,mdss-dsi-panel-framerate = <60>;
		qcom,mdss-dsi-virtual-channel-id = <0>;
		qcom,mdss-dsi-stream = <0>;
		qcom,mdss-dsi-panel-width = <540>;
		qcom,mdss-dsi-panel-height = <960>;
		qcom,mdss-pan-physical-width-dimension = <55>;
		qcom,mdss-pan-physical-height-dimension = <99>;

		qcom,mdss-dsi-panel-clockrate = <513976320>;
		qcom,mdss-dsi-h-front-porch = <80>;
		qcom,mdss-dsi-h-back-porch = <80>;
		qcom,mdss-dsi-h-pulse-width = <4>;
		qcom,mdss-dsi-h-sync-skew = <0>;
		qcom,mdss-dsi-v-back-porch = <19>;
		qcom,mdss-dsi-v-front-porch = <33>;
		qcom,mdss-dsi-v-pulse-width = <2>;
		qcom,mdss-dsi-h-left-border = <0>;
		qcom,mdss-dsi-h-right-border = <0>;
		qcom,mdss-dsi-v-top-border = <0>;
		qcom,mdss-dsi-v-bottom-border = <0>;
		qcom,mdss-dsi-bpp = <24>;
		qcom,mdss-dsi-underflow-color = <0xff>;
		qcom,mdss-dsi-border-color = <0>;
		qcom,mdss-dsi-on-command = [
			/* CMD2 Page 0 */
			29 01 00 00 00 00 06 F0 55 AA 52 08 00
			/* Source EQ & Gate Eq */
			29 01 00 00 00 00 02 B6 08
			29 01 00 00 00 00 03 B7 00 00
			/* Column-Inversion */
			29 01 00 00 00 00 02 BC 00
			/* Display Timing */
			29 01 00 00 00 00 04 CC 03 00 00
			/* CMD2, Page 1 */
			29 01 00 00 00 00 06 F0 55 AA 52 08 01
			/* Pump setting */
			29 01 00 00 00 00 04 B0 0A 0A 0A
			29 01 00 00 00 00 04 B6 44 44 44
			29 01 00 00 00 00 04 B1 0A 0A 0A
			29 01 00 00 00 00 04 B7 24 24 24
			29 01 00 00 00 00 04 B2 03 03 03
			29 01 00 00 00 00 04 B8 33 33 33
			29 01 00 00 00 00 04 B3 0D 0D 0D
			29 01 00 00 00 00 04 B9 24 24 24
			29 01 00 00 00 00 04 B4 0A 0A 0A
			29 01 00 00 00 00 04 BA 24 24 24
			/* VGMP & VGMN for gamma */
			29 01 00 00 00 00 04 BC 00 78 00
			29 01 00 00 00 00 04 BD 00 78 00
			/* VCOM */
			29 01 00 00 00 00 02 BE 4f
			/* Gamma Code */
			29 01 00 00 00 00 11 D1 00 95 00 A8 00 B8 00 C9 00 E2 00 F3 01 02 01 2B
			29 01 00 00 00 00 11 D2 01 5E 01 95 01 D1 02 09 02 34 02 55 02 68 02 9F
			29 01 00 00 00 00 11 D3 02 D3 03 02 03 12 03 3F 03 5E 03 84 03 9B 03 B9
			29 01 00 00 00 00 05 D4 03 F1 03 FF

			29 01 00 00 00 00 11 D5 00 43 00 58 00 78 00 90 00 A2 00 C3 00 DE 01 0B
			29 01 00 00 00 00 11 D6 01 2E 01 65 01 91 01 D9 02 14 02 15 02 48 02 7F
			29 01 00 00 00 00 11 D7 02 A3 02 D2 02 F2 03 1F 03 3E 03 64 03 7B 03 99
			29 01 00 00 00 00 05 D8 03 E1 03 FF

			29 01 00 00 00 00 11 D9 00 43 00 58 00 78 00 90 00 A2 00 C3 00 DE 01 0B
			29 01 00 00 00 00 11 DD 01 2E 01 65 01 91 01 D9 02 14 02 15 02 48 02 7F
			29 01 00 00 00 00 11 DE 02 A3 02 D2 02 F2 03 1F 03 3E 03 64 03 7B 03 99

			29 01 00 00 00 00 11 E0 00 95 00 A8 00 B8 00 C9 00 E2 00 F3 01 02 01 2B
			29 01 00 00 00 00 11 E1 01 5E 01 95 01 D1 02 09 02 34 02 55 02 68 02 9F
			29 01 00 00 00 00 11 E2 02 D3 03 02 03 12 03 3F 03 5E 03 84 03 9B 03 B9
			29 01 00 00 00 00 05 E3 03 F1 03 FF

			29 01 00 00 00 00 11 E4 00 43 00 58 00 78 00 90 00 A2 00 C3 00 DE 01 0B
			29 01 00 00 00 00 11 E5 01 2E 01 65 01 91 01 D9 02 14 02 15 02 48 02 7F
			29 01 00 00 00 00 11 E6 02 A3 02 D2 02 F2 03 1F 03 3E 03 64 03 7B 03 99
			29 01 00 00 00 00 05 E7 03 E1 03 FF

			29 01 00 00 00 00 11 E8 00 43 00 58 00 78 00 90 00 A2 00 C3 00 DE 01 0B
			29 01 00 00 00 00 11 E9 01 2E 01 65 01 91 01 D9 02 14 02 15 02 48 02 7F
			29 01 00 00 00 00 11 EA 02 A3 02 D2 02 F2 03 1F 03 3E 03 64 03 7B 03 99
			29 01 00 00 00 00 05 EB 03 E1 03 FF

			05 01 00 00 78 00 01 11		/* Exit sleep mode */
			15 01 00 00 00 00 02 53 2C
			15 01 00 00 00 00 02 51 FF
			05 01 00 00 28 00 01 29];	/* display on */
		qcom,mdss-dsi-off-command = [
			05 01 00 00 0a 00 01 28		/* display_off */
			05 01 00 00 78 00 01 10];	/* enter sleep mode */

		qcom,mdss-dsi-on-command-state = "dsi_lp_mode";
		qcom,mdss-dsi-off-command-state = "dsi_lp_mode";
		qcom,mdss-dsi-h-sync-pulse = <0>;
		qcom,mdss-dsi-traffic-mode = "non_burst_sync_event";
		qcom,mdss-dsi-bllp-eof-power-mode;
		qcom,mdss-dsi-bllp-power-mode;
		qcom,mdss-dsi-lane-0-state;
		qcom,mdss-dsi-lane-1-state;
		qcom,mdss-dsi-panel-timings = [8e 20 15 00 47 50 1a 24 24 03 04 00];
		qcom,mdss-dsi-t-clk-post = <0x04>;
		qcom,mdss-dsi-t-clk-pre = <0x1e>;
		qcom,mdss-dsi-bl-min-level = <1>;
		qcom,mdss-dsi-bl-max-level = <255>;
		qcom,mdss-dsi-dma-trigger = "trigger_sw";
		qcom,mdss-dsi-mdp-trigger = "none";
		qcom,mdss-dsi-bl-pmic-control-type = "bl_ctrl_wled";
		qcom,mdss-dsi-lane-map = "lane_map_3012";
		qcom,panel-en-reset-sequence = <1 2>, <0 1>, <1 21> ;
		qcom,panel-dis-reset-sequence = <0 1>;
		qcom,mdss-dsi-lp11-init;
		qcom,mdss-dsi-tx-eot-append;
	};
};
