/* Copyright (c) 2015, LGE Inc.  All rights reserved.
 *
 * This program is free software; you can redistribute it and/or modify
 * it under the terms of the GNU General Public License version 2 and
 * only version 2 as published by the Free Software Foundation.
 *
 * This program is distributed in the hope that it will be useful,
 * but WITHOUT ANY WARRANTY; without even the implied warranty of
 * MERCHANTABILITY or FITNESS FOR A PARTICULAR PURPOSE.  See the
 * GNU General Public License for more details.
 */

/dts-v1/;
#include "msm8926-nemo/msm8926-nemo-rev-evb1.dtsi"

/ {
	model = "LGE MSM 8926 NEMO rev-evb1";
	compatible = "qcom,msm8926";
	qcom,board-id = <141 0>;
	qcom,msm-id = <200 0x10001>;
};
