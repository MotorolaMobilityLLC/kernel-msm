/* Copyright (c) 2013 Motorola Mobility LLC
 *
 * This program is free software; you can redistribute it and/or modify
 * it under the terms of the GNU General Public License version 2 and
 * only version 2 as published by the Free Software Foundation.
 *
 * This program is distributed in the hope that it will be useful,
 * but WITHOUT ANY WARRANTY; without even the implied warranty of
 * MERCHANTABILITY or FITNESS FOR A PARTICULAR PURPOSE.  See the
 * GNU General Public License for more details.
 */

/include/ "msm8974-v2-moto-common.dtsi"

/ {
	model = "Motorola QC-MSM8974 Abbagoochie";
	compatible = "qcom,msm8974-abbagoochie",
		     "qcom,msm8974-moto",
		     "qcom,msm8974";
};
