/* Copyright (c) 2012-2013, The Linux Foundation. All rights reserved.
 * Copyright (c) 2013 Motorola Mobility LLC
 *
 * This program is free software; you can redistribute it and/or modify
 * it under the terms of the GNU General Public License version 2 and
 * only version 2 as published by the Free Software Foundation.
 *
 * This program is distributed in the hope that it will be useful,
 * but WITHOUT ANY WARRANTY; without even the implied warranty of
 * MERCHANTABILITY or FITNESS FOR A PARTICULAR PURPOSE.  See the
 * GNU General Public License for more details.
 */

/include/ "msm8974-moto-reserve.dtsi"
/include/ "msm8974pro-ac-pm8941.dtsi"
/include/ "msm8974pro-moto-common.dtsi"

&sdhc_1 {
	qcom,pad-pull-on = <0x0 0x3 0x3 0x0>; /* no-pull, pull-up, pull-up, no-pull */
	qcom,pad-pull-off = <0x0 0x3 0x3 0x0>; /* no-pull, pull-up, pull-up, no-pull */
};
