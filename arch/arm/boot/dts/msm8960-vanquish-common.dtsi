/include/ "skeleton.dtsi"

/include/ "msm8960.dtsi"

/include/ "msm8960-motref.dtsi"

/include/ "msm8960-motref-pinmux.dtsi"

/ {
	model = "Motorola MSM8960 Vanquish";
	compatible = "mmi,msm8960-old";

	mmi,product = "mmi,msm8960-vanquish";

	mmi,dt_revision = <2>;

	Aliases@0 {
	};

	Machine@0 {
	};

};
