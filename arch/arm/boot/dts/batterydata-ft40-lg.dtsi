mmi,ft40-lg-batterydata {
	qcom,fcc-mah = <2321>;
	qcom,default-rbatt-mohm = <163>;
	qcom,rbatt-capacitive-mohm = <0>;
	qcom,flat-ocv-threshold-uv = <3800000>;
	qcom,max-voltage-uv = <4350000>;
	qcom,v-cutoff-uv = <3200000>;
	qcom,chg-term-ua = <186000>;
	qcom,batt-id-kohm = <20>;
	qcom,batt-id-range = <380578 424195>;
	qcom,batt-id-sn = "SNN5955";

	qcom,fcc-temp-lut {
		qcom,lut-col-legend = <(-10) 0 23 60>;
		qcom,lut-data = <1697 2123 2321 2243>;
	};

	qcom,pc-temp-ocv-lut {
		qcom,lut-col-legend = <(-10) 0 23 60>;
		qcom,lut-row-legend = <100 95 90 85 80 75 70>,
				<65 60 55 50 45 40 35>,
				<30 25 20 15 10 9 8>,
				<7 6 5 4 3 2 1 0>;
		qcom,lut-data = <4300 4300 4300 4300>,
				<4258 4260 4258 4243>,
				<4202 4204 4204 4188>,
				<4149 4152 4150 4137>,
				<4100 4102 4101 4087>,
				<4052 4058 4055 4040>,
				<3992 4001 4005 3997>,
				<3948 3961 3967 3958>,
				<3906 3917 3928 3918>,
				<3868 3874 3877 3869>,
				<3840 3844 3845 3841>,
				<3817 3822 3823 3818>,
				<3800 3805 3806 3800>,
				<3789 3791 3791 3784>,
				<3780 3783 3779 3757>,
				<3768 3773 3761 3735>,
				<3745 3748 3735 3712>,
				<3716 3712 3697 3677>,
				<3698 3696 3688 3665>,
				<3695 3695 3686 3664>,
				<3691 3692 3684 3661>,
				<3684 3688 3678 3654>,
				<3669 3676 3660 3637>,
				<3640 3648 3629 3608>,
				<3596 3605 3591 3566>,
				<3537 3552 3541 3512>,
				<3459 3483 3471 3441>,
				<3348 3384 3370 3344>,
				<3200 3200 3200 3200>;

	};

	qcom,rbatt-sf-lut {
		qcom,lut-col-legend = <(-10) 0 23 60>;
		qcom,lut-row-legend = <100 95 90 85 80 75 70>,
				<65 60 55 50 45 40 35>,
				<30 25 20 15 10 9 8>,
				<7 6 5 4 3 2 1 0>;
		qcom,lut-data = <610 318 100 68>,
				<622 325 107 72>,
				<634 332 113 76>,
				<642 344 114 81>,
				<659 353 123 85>,
				<684 384 136 87>,
				<669 385 148 89>,
				<669 392 164 95>,
				<659 373 169 102>,
				<654 349 129 83>,
				<663 347 119 80>,
				<686 360 122 83>,
				<719 379 131 91>,
				<772 405 139 97>,
				<843 445 148 83>,
				<928 499 137 85>,
				<1006 537 131 86>,
				<1111 577 128 84>,
				<1207 644 152 89>,
				<1187 627 154 90>,
				<1225 647 158 88>,
				<1271 673 163 91>,
				<1320 697 158 100>,
				<1363 715 166 107>,
				<1424 748 179 99>,
				<1518 800 187 99>,
				<1646 868 196 103>,
				<1854 960 224 117>,
				<2348 1357 375 172>;
	};
};