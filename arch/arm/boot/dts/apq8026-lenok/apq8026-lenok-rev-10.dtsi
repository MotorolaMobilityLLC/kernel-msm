/* Copyright (c) 2014 LGE Inc. All rights reserved.
 *
 * This program is free software; you can redistribute it and/or modify
 * it under the terms of the GNU General Public License version 2 and
 * only version 2 as published by the Free Software Foundation.
 *
 * This program is distributed in the hope that it will be useful,
 * but WITHOUT ANY WARRANTY; without even the implied warranty of
 * MERCHANTABILITY or FITNESS FOR A PARTICULAR PURPOSE.  See the
 * GNU General Public License for more details.
 */

#include "apq8026-lenok.dtsi"

&soc {
	earjack-debugger {
		status = "ok";
		lge,adc-low-threshold = <810>;
		lge,adc-high-threshold = <1000>;
		lge,trigger-mode = "low";
	};
};
