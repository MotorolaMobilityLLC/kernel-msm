/* Copyright (c) 2012-2013, Motorola Mobility LLC. All rights reserved.
 *
 * This program is free software; you can redistribute it and/or modify
 * it under the terms of the GNU General Public License version 2 and
 * only version 2 as published by the Free Software Foundation.
 *
 * This program is distributed in the hope that it will be useful,
 * but WITHOUT ANY WARRANTY; without even the implied warranty of
 * MERCHANTABILITY or FITNESS FOR A PARTICULAR PURPOSE.  See the
 * GNU General Public License for more details.
 */

/dts-v1/;

/include/ "msm8960ab-ghost-common.dtsi"

/* Note, this is common with p1 */
/include/ "msm8960ab-ghost-p1-legacy.dtsi"

/*
 * The devices called P2 actually carry HW GPIO IDs for P4. Note that devices
 * with HE GPIO ID P5 are called P1B4. Thanks product team!
 */
/ {
	mmi,revision = "p4";
};
