mmi,ft40-sony-batterydata {
	qcom,fcc-mah = <2366>;
	qcom,default-rbatt-mohm = <167>;
	qcom,rbatt-capacitive-mohm = <0>;
	qcom,flat-ocv-threshold-uv = <3800000>;
	qcom,max-voltage-uv = <4350000>;
	qcom,v-cutoff-uv = <3200000>;
	qcom,chg-term-ua = <197000>;
	qcom,batt-id-kohm = <32>;
	qcom,batt-id-range = <535984 589380>;
	qcom,batt-id-sn = "SNN5956";

	qcom,fcc-temp-lut {
		qcom,lut-col-legend = <(-10) 0 23 60>;
		qcom,lut-data = <1774 2215 2366 2354>;
	};

	qcom,pc-temp-ocv-lut {
		qcom,lut-col-legend = <(-10) 0 23 60>;
		qcom,lut-row-legend = <100 95 90 85 80 75 70>,
				<65 60 55 50 45 40 35>,
				<30 25 20 15 10 9 8>,
				<7 6 5 4 3 2 1 0>;
		qcom,lut-data = <4300 4300 4300 4300>,
				<4252 4252 4246 4234>,
				<4194 4195 4191 4180>,
				<4140 4142 4137 4129>,
				<4089 4092 4088 4080>,
				<4039 4044 4042 4034>,
				<3990 3998 3999 3993>,
				<3945 3954 3961 3956>,
				<3905 3911 3920 3915>,
				<3871 3874 3876 3869>,
				<3842 3845 3845 3842>,
				<3819 3821 3823 3820>,
				<3800 3803 3805 3801>,
				<3785 3789 3791 3786>,
				<3775 3778 3778 3761>,
				<3763 3765 3757 3732>,
				<3744 3745 3737 3713>,
				<3714 3716 3711 3688>,
				<3681 3686 3684 3664>,
				<3677 3683 3681 3661>,
				<3672 3678 3678 3657>,
				<3665 3673 3673 3651>,
				<3655 3663 3661 3634>,
				<3634 3638 3632 3602>,
				<3595 3595 3590 3559>,
				<3540 3539 3535 3506>,
				<3467 3467 3463 3437>,
				<3367 3367 3365 3343>,
				<3200 3200 3200 3200>;
	};

	qcom,rbatt-sf-lut {
		qcom,lut-col-legend = <(-10) 0 23 60>;
		qcom,lut-row-legend = <100 95 90 85 80 75 70>,
				<65 60 55 50 45 40 35>,
				<30 25 20 15 10 9 8>,
				<7 6 5 4 3 2 1 0>;
		qcom,lut-data = <451 247 100 62>,
				<462 259 105 67>,
				<474 271 110 73>,
				<484 281 115 75>,
				<492 294 121 76>,
				<494 305 130 78>,
				<489 309 144 84>,
				<478 303 159 93>,
				<470 287 148 99>,
				<472 274 119 74>,
				<478 274 110 75>,
				<492 279 113 76>,
				<511 293 117 77>,
				<532 308 127 79>,
				<558 323 132 74>,
				<584 335 121 75>,
				<605 336 119 79>,
				<637 342 117 78>,
				<578 307 114 78>,
				<583 311 115 76>,
				<597 319 117 76>,
				<617 329 120 78>,
				<643 340 120 76>,
				<670 338 118 75>,
				<705 351 122 76>,
				<783 379 124 79>,
				<925 426 127 83>,
				<1240 509 140 93>,
				<2296 696 215 165>;
	};
};