mmi,el40-sony-batterydata {
	qcom,fcc-mah = <1935>;
	qcom,default-rbatt-mohm = <204>;
	qcom,rbatt-capacitive-mohm = <0>;
	qcom,flat-ocv-threshold-uv = <3800000>;
	qcom,max-voltage-uv = <4350000>;
	qcom,v-cutoff-uv = <3200000>;
	qcom,chg-term-ua = <170000>;
	qcom,batt-id-kohm = <32>;
	qcom,batt-id-range = <535984 589380>;

	qcom,fcc-temp-lut {
		qcom,lut-col-legend = <(-10) 0 23 60>;
		qcom,lut-data = <1935 1935 1935 1935>;
	};

	qcom,pc-temp-ocv-lut {
		qcom,lut-col-legend = <(-10) 0 23 60>;
		qcom,lut-row-legend = <100 95 90 85 80 75 70>,
				<65 60 55 50 45 40 35>,
				<30 25 20 15 10 9 8>,
				<7 6 5 4 3 2 1 0>;
		qcom,lut-data = <4300 4300 4300 4300>,
				<4248 4250 4247 4235>,
				<4188 4193 4191 4182>,
				<4134 4140 4139 4130>,
				<4083 4089 4089 4081>,
				<4032 4042 4043 4036>,
				<3983 3996 4000 3995>,
				<3938 3952 3961 3957>,
				<3899 3909 3917 3913>,
				<3865 3872 3874 3871>,
				<3836 3842 3844 3843>,
				<3813 3819 3822 3821>,
				<3795 3801 3805 3803>,
				<3781 3787 3791 3787>,
				<3769 3776 3776 3758>,
				<3754 3763 3754 3732>,
				<3732 3742 3734 3712>,
				<3700 3711 3709 3686>,
				<3671 3680 3684 3665>,
				<3666 3677 3681 3662>,
				<3660 3672 3677 3658>,
				<3652 3667 3670 3650>,
				<3641 3657 3655 3631>,
				<3622 3634 3622 3598>,
				<3582 3591 3578 3555>,
				<3529 3537 3524 3500>,
				<3458 3466 3454 3430>,
				<3364 3368 3356 3338>,
				<3200 3200 3200 3200>;
	};

	qcom,rbatt-sf-lut {
		qcom,lut-col-legend = <(-10) 0 23 60>;
		qcom,lut-row-legend = <100 95 90 85 80 75 70>,
				<65 60 55 50 45 40 35>,
				<30 25 20 15 10 9 8>,
				<7 6 5 4 3 2 1 0>;
		qcom,lut-data = <668 356 100 49>,
				<682 366 107 52>,
				<697 376 114 55>,
				<707 386 120 58>,
				<718 401 127 60>,
				<716 414 138 62>,
				<703 419 152 68>,
				<717 415 162 79>,
				<719 405 148 76>,
				<728 399 122 59>,
				<745 402 118 58>,
				<768 415 122 59>,
				<799 437 129 61>,
				<837 461 139 65>,
				<880 486 143 59>,
				<925 508 130 60>,
				<977 527 130 61>,
				<940 527 133 62>,
				<947 530 130 62>,
				<970 525 129 62>,
				<1007 527 130 62>,
				<1053 529 133 63>,
				<1107 549 133 63>,
				<1174 561 135 63>,
				<1254 582 142 64>,
				<1388 632 150 65>,
				<1627 708 165 72>,
				<2062 832 190 87>,
				<3256 1139 338 165>;
	};
};