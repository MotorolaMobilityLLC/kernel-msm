/* Copyright (c) 2012, Code Aurora Forum. All rights reserved.
 *
 * This program is free software; you can redistribute it and/or modify
 * it under the terms of the GNU General Public License version 2 and
 * only version 2 as published by the Free Software Foundation.
 *
 * This program is distributed in the hope that it will be useful,
 * but WITHOUT ANY WARRANTY; without even the implied warranty of
 * MERCHANTABILITY or FITNESS FOR A PARTICULAR PURPOSE.  See the
 * GNU General Public License for more details.
 */

&soc {
	vibrator {
		status = "ok";
		compatible = "msm,pwm_vibrator";
		haptic-pwr-gpio = <&msmgpio 62 0x00>;
		motor-pwm-gpio = <&msmgpio 22 0x00>;
		motor-pwm-func = <6>;
		motor-amp = <63>;
		n-value = <127>;
		vibe-warmup-delay = <0>;
		vibe-braking-gain = <100>;
		vibe-braking-ms = <0>;
		vibe-driving-ms = <20>;
		vdd-supply = <&pm8226_l28>;
		use-vdd-supply;
	};

	earjack-debugger {
		compatible = "serial,earjack-debugger";
		status = "ok";
		qcom,usbid-adc_tm = <&pm8226_adc_tm>;
		qcom,usbid-vadc = <&pm8226_vadc>;
	};
};
