/* Copyright (c) 2013, The Linux Foundation. All rights reserved.
 * Copyright (c) 2013, LGE Inc.
 *
 * This program is free software; you can redistribute it and/or modify
 * it under the terms of the GNU General Public License version 2 and
 * only version 2 as published by the Free Software Foundation.
 *
 * This program is distributed in the hope that it will be useful,
 * but WITHOUT ANY WARRANTY; without even the implied warranty of
 * MERCHANTABILITY or FITNESS FOR A PARTICULAR PURPOSE.  See the
 * GNU General Public License for more details.
 */

&usb_otg {
	qcom,hsusb-otg-mode = <1>;
	qcom,no-set-vbus-power;
};

&android_usb {
	qcom,android-usb-swfi-latency = <0>;
};
