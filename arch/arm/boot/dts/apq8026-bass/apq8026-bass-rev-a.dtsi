/* Copyright (c) 2014,2015, LGE Inc. All rights reserved.
 *
 * This program is free software; you can redistribute it and/or modify
 * it under the terms of the GNU General Public License version 2 and
 * only version 2 as published by the Free Software Foundation.
 *
 * This program is distributed in the hope that it will be useful,
 * but WITHOUT ANY WARRANTY; without even the implied warranty of
 * MERCHANTABILITY or FITNESS FOR A PARTICULAR PURPOSE.  See the
 * GNU General Public License for more details.
 */

#include "apq8026-bass.dtsi"

&soc {
	earjack-debugger {
		status = "ok";
		lge,adc-low-threshold = <810>;
		lge,adc-high-threshold = <1000>;
		lge,trigger-mode = "low";
	};
};

&dsi_lgd_lg4237_cmd {
	qcom,mdss-dsi-on-command = [05 01 00 00 80 00 01 11
				39 01 00 00 00 00 02 36 40
				15 01 00 00 00 00 02 53 20
				15 01 00 00 00 00 02 B0 AC
				39 01 00 00 00 00 04 C2 08 80 01
				15 01 00 00 00 00 02 5C 24 /* Color Management ON, S curve ON */
				39 01 00 00 00 00 02 5E 0B /* Color Management offset */
				39 01 00 00 00 00 31 5F
				80 80 80 80 80 80
				80 80 80 80 80 80
				8D 8D 8D 8D 8D 8D
				8D 8D 8D 8D 8D 8D
				7F 7F 7F 7F 7F 7F
				7F 7F 7F 7F 7F 7F
				FF FF FF FF FF FF
				FF FF FF FF FF FF /* Color Management 10*/
				39 01 00 00 00 00 11 E1
				32 3C 46 48 4E 46
				40 30 00 FB F1 EE
				E2 F6 08 40 /* digital gamma( S curve) R */
				39 01 00 00 00 00 11 E2
				32 3C 46 48 4E 46
				40 30 00 FB F1 EE
				E2 F6 08 40 /* digital gamma( S curve) G */
				39 01 00 00 00 00 11 E3
				32 3C 46 48 4E 46
				40 30 00 FB F1 EE
				E2 F6 08 40 /* digital gamma( S curve) B */
				05 01 00 00 00 00 01 35
				05 01 00 00 00 00 01 29];
};
