/* Copyright (c) 2014,2015 LGE Inc. All rights reserved.
 *
 * This program is free software; you can redistribute it and/or modify
 * it under the terms of the GNU General Public License version 2 and
 * only version 2 as published by the Free Software Foundation.
 *
 * This program is distributed in the hope that it will be useful,
 * but WITHOUT ANY WARRANTY; without even the implied warranty of
 * MERCHANTABILITY or FITNESS FOR A PARTICULAR PURPOSE.  See the
 * GNU General Public License for more details.
 */

&usb_otg {
	qcom,hsusb-otg-mode = <1>;
	qcom,no-set-vbus-power;
	qcom,hsusb-otg-phy-init-seq =
			<0x44 0x80 0x6F 0x81 0x34 0x82 0x13 0x83 0xffffffff>;
};

&android_usb {
	/delete-property/ qcom,pm-qos-latency;
};
