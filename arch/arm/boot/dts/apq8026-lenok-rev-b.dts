/* Copyright (c) 2014, LGE Inc.  All rights reserved.
 *
 * This program is free software; you can redistribute it and/or modify
 * it under the terms of the GNU General Public License version 2 and
 * only version 2 as published by the Free Software Foundation.
 *
 * This program is distributed in the hope that it will be useful,
 * but WITHOUT ANY WARRANTY; without even the implied warranty of
 * MERCHANTABILITY or FITNESS FOR A PARTICULAR PURPOSE.  See the
 * GNU General Public License for more details.
 */

/dts-v1/;
#include "apq8026-lenok/apq8026-lenok-rev-b.dtsi"

/ {
	model = "LGE APQ 8026v2 LENOK rev-b";
	compatible = "qcom,apq8026";
	qcom,board-id = <132 0x03>;
	qcom,msm-id = <199 0x20000>;
};
