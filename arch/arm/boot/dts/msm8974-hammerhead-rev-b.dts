/* Copyright (c) 2013, LGE Inc. All rights reserved.
 * Copyright (c) 2012, Code Aurora Forum. All rights reserved.
 *
 * This program is free software; you can redistribute it and/or modify
 * it under the terms of the GNU General Public License version 2 and
 * only version 2 as published by the Free Software Foundation.
 *
 * This program is distributed in the hope that it will be useful,
 * but WITHOUT ANY WARRANTY; without even the implied warranty of
 * MERCHANTABILITY or FITNESS FOR A PARTICULAR PURPOSE.  See the
 * GNU General Public License for more details.
 */

/dts-v1/;

/include/ "msm8974-lge-common/msm8974-v2-lge.dtsi"
/include/ "msm8974-hammerhead/msm8974-hammerhead-rev-b.dtsi"

/ {
	model = "LGE MSM 8974 HAMMERHEAD";
	compatible = "qcom,msm8974";
	qcom,msm-id = <126 150 0x20001 3>;
};

