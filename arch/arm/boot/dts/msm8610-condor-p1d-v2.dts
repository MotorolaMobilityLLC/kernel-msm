/* Copyright (c) 2013, The Linux Foundation. All rights reserved.
 *
 * This program is free software; you can redistribute it and/or modify
 * it under the terms of the GNU General Public License version 2 and
 * only version 2 as published by the Free Software Foundation.
 *
 * This program is distributed in the hope that it will be useful,
 * but WITHOUT ANY WARRANTY; without even the implied warranty of
 * MERCHANTABILITY or FITNESS FOR A PARTICULAR PURPOSE.  See the
 * GNU General Public License for more details.
 */

/dts-v1/;

/include/ "msm8610-moto-reserve.dtsi"
/include/ "msm8610-v2.dtsi"
/include/ "msm8610-moto-common.dtsi"

/ {
	/* HWREV: 0x0101 0x81d0
	 *        ^^^^^^ ^^^^^^
	 *        Rev1.1 P1(P1d)
	 */
	qcom,msm-id = <147 0x41 0x010181d0>;
};
