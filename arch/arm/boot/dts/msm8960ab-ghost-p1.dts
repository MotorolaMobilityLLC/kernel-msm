/* Copyright (c) 2012-2013, Motorola Mobility LLC. All rights reserved.
 *
 * This program is free software; you can redistribute it and/or modify
 * it under the terms of the GNU General Public License version 2 and
 * only version 2 as published by the Free Software Foundation.
 *
 * This program is distributed in the hope that it will be useful,
 * but WITHOUT ANY WARRANTY; without even the implied warranty of
 * MERCHANTABILITY or FITNESS FOR A PARTICULAR PURPOSE.  See the
 * GNU General Public License for more details.
 */

/dts-v1/;

/include/ "msm8960ab-ghost-common.dtsi"

/* Note, this is common with P2 */
/include/ "msm8960ab-ghost-p1-legacy.dtsi"

/ {
	mmi,revision = "p1";
};

/* GSBI12 - I2C */
&i2c12 {
        msp430@48 {
                msp430_fw_version = "_p1";
        };
};
