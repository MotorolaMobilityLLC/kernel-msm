/* Copyright (c) 2015,HUAWEI TECHNOLOGIES CO., LTD. All rights reserved.
 *
 * This program is free software; you can redistribute it and/or modify
 * it under the terms of the GNU General Public License version 2 and
 * only version 2 as published by the Free Software Foundation.
 *
 * This program is distributed in the hope that it will be useful,
 * but WITHOUT ANY WARRANTY; without even the implied warranty of
 * MERCHANTABILITY or FITNESS FOR A PARTICULAR PURPOSE.  See the
 * GNU General Public License for more details.
 */

&soc {
	/*high speed uart,for BT*/
	hserial:serial@f9920000 {
		compatible = "qcom,msm-hsuart-v14";
		status = "ok";
		reg = <0xf9920000 0x1000>,
		<0xf9904000 0x19000>;
		reg-names = "core_mem", "bam_mem";
		interrupts = <0 110 0>, <0 238 0>;
		interrupt-names = "core_irq", "bam_irq";

		qcom,tx-gpio = <&msmgpio 13 0x00>;
		qcom,rx-gpio = <&msmgpio 12 0x00>;
		qcom,cts-gpio = <&msmgpio 15 0x00>;
		qcom,rfr-gpio = <&msmgpio 14 0x00>;

		qcom,bam-tx-ep-pipe-index = <6>;
		qcom,bam-rx-ep-pipe-index = <7>;

		qcom,msm-bus,name = "blsp1_uart3";
		qcom,msm-bus,num-cases = <2>;
		qcom,msm-bus,num-paths = <1>;
		qcom,msm-bus,vectors-KBps =
				<86 512 0 0>,
				<86 512 500 800>;
	};

        bt_nitrous {
		compatible = "goog,nitrous";
		uart-port = <0>;
		power-gpio = <&msmgpio 67 0>;
		host-wake-gpio = <&msmgpio 64 0>;
		host-wake-polarity = <0>;
		dev-wake-gpio = <&msmgpio 63 0>;
		dev-wake-polarity = <0>;
	};
};
