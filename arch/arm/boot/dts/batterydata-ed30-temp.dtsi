mmi,ed30-temp-batterydata {
	qcom,fcc-mah = <1950>;
	qcom,default-rbatt-mohm = <193>;
	qcom,rbatt-capacitive-mohm = <0>;
	qcom,flat-ocv-threshold-uv = <3800000>;
	qcom,max-voltage-uv = <4200000>;
	qcom,v-cutoff-uv = <3200000>;
	qcom,chg-term-ua = <159000>;
	qcom,batt-id-kohm = <10>;
	qcom,batt-id-range = <220008 241102>;

	qcom,fcc-temp-lut {
		qcom,lut-col-legend = <(-10) 0 23 60>;
		qcom,lut-data = <1950 1950 1950 1950>;
	};

	qcom,pc-temp-ocv-lut {
		qcom,lut-col-legend = <(-10) 23 60>;
		qcom,lut-row-legend = <100 95 90 85 80 75 70>,
				<65 60 55 50 45 40 35>,
				<30 25 20 15 10 9 8>,
				<7 6 5 4 3 2 1 0>;
		qcom,lut-data = <4197 4190 4177>,
				<4141 4134 4127>,
				<4097 4088 4081>,
				<4052 4046 4039>,
				<4000 4000 4000>,
				<3963 3966 3965>,
				<3932 3937 3933>,
				<3900 3909 3904>,
				<3868 3884 3879>,
				<3841 3845 3839>,
				<3819 3815 3814>,
				<3802 3798 3797>,
				<3792 3787 3783>,
				<3786 3779 3774>,
				<3779 3775 3756>,
				<3768 3768 3738>,
				<3747 3742 3716>,
				<3719 3698 3680>,
				<3700 3686 3667>,
				<3698 3684 3666>,
				<3695 3682 3663>,
				<3691 3679 3657>,
				<3682 3669 3644>,
				<3659 3644 3618>,
				<3617 3604 3576>,
				<3564 3552 3522>,
				<3492 3478 3451>,
				<3389 3373 3348>,
				<3200 3200 3200>;
	};

	qcom,rbatt-sf-lut {
		qcom,lut-col-legend = <(-10) 23 60>;
		qcom,lut-row-legend = <100 95 90 85 80 75 70>,
				<65 60 55 50 45 40 35>,
				<30 25 20 15 10 9 8>,
				<7 6 5 4 3 2 1 0>;
		qcom,lut-data = <100 100 100>,
				<100 100 100>,
				<100 100 100>,
				<100 100 100>,
				<100 100 100>,
				<100 100 100>,
				<100 100 100>,
				<100 100 100>,
				<100 100 100>,
				<100 100 100>,
				<100 100 100>,
				<100 100 100>,
				<100 100 100>,
				<100 100 100>,
				<100 100 100>,
				<100 100 100>,
				<100 100 100>,
				<100 100 100>,
				<100 100 100>,
				<100 100 100>,
				<100 100 100>,
				<100 100 100>,
				<100 100 100>,
				<100 100 100>,
				<100 100 100>,
				<100 100 100>,
				<100 100 100>,
				<100 100 100>,
				<100 100 100>;
	};
};