mmi,ed30-lg-batterydata {
	qcom,fcc-mah = <2022>;
	qcom,default-rbatt-mohm = <222>;
	qcom,rbatt-capacitive-mohm = <0>;
	qcom,flat-ocv-threshold-uv = <3800000>;
	qcom,max-voltage-uv = <4350000>;
	qcom,v-cutoff-uv = <3200000>;
	qcom,chg-term-ua = <159000>;
	qcom,batt-id-kohm = <130>;
	qcom,batt-id-range = <1143272 1201721>;

	qcom,fcc-temp-lut {
		qcom,lut-col-legend = <(-10) 0 23 60>;
		qcom,lut-data = <1462 1830 2022 1992>;
	};

	qcom,pc-temp-ocv-lut {
		qcom,lut-col-legend = <(-10) 23 60>;
		qcom,lut-row-legend = <100 95 90 85 80 75 70>,
				<65 60 55 50 45 40 35>,
				<30 25 20 15 10 9 8>,
				<7 6 5 4 3 2 1 0>;
		qcom,lut-data =  <4300 4300 4300>,
				<4259 4252 4242>,
				<4202 4198 4187>,
				<4149 4145 4134>,
				<4099 4095 4083>,
				<4045 4049 4036>,
				<3987 4000 3993>,
				<3942 3963 3954>,
				<3905 3927 3919>,
				<3869 3876 3871>,
				<3840 3843 3838>,
				<3817 3821 3815>,
				<3800 3804 3797>,
				<3789 3790 3782>,
				<3780 3780 3761>,
				<3768 3769 3741>,
				<3747 3742 3719>,
				<3715 3707 3684>,
				<3698 3688 3668>,
				<3696 3687 3666>,
				<3694 3685 3663>,
				<3689 3682 3658>,
				<3679 3673 3644>,
				<3652 3650 3619>,
				<3608 3612 3580>,
				<3552 3562 3527>,
				<3480 3491 3456>,
				<3379 3390 3358>,
				<3200 3200 3200>;
	};

	qcom,rbatt-sf-lut {
		qcom,lut-col-legend = <(-10) 0 23 60>;
		qcom,lut-row-legend = <100 95 90 85 80 75 70>,
				<65 60 55 50 45 40 35>,
				<30 25 20 15 10 9 8>,
				<7 6 5 4 3 2 1 0>;
		qcom,lut-data = <586 284 100 52>,
				<606 297 103 55>,
				<627 310 106 57>,
				<637 322 111 60>,
				<653 334 117 62>,
				<678 356 127 64>,
				<675 367 136 68>,
				<665 362 148 74>,
				<669 339 135 67>,
				<682 332 110 60>,
				<703 342 114 61>,
				<733 361 121 65>,
				<767 385 129 69>,
				<812 412 139 74>,
				<870 448 144 64>,
				<929 488 137 64>,
				<988 512 133 66>,
				<1033 544 136 66>,
				<1074 572 155 69>,
				<1100 587 162 67>,
				<1128 604 168 67>,
				<1156 621 170 70>,
				<1179 627 172 78>,
				<1195 629 174 81>,
				<1219 649 186 76>,
				<1261 676 200 74>,
				<1318 713 218 78>,
				<1404 778 246 85>,
				<1844 1209 406 133>;
	};
};
