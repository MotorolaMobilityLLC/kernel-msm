/*
 * Copyright (c) 2013, The Linux Foundation. All rights reserved.
 *
 * This program is free software; you can redistribute it and/or modify
 * it under the terms of the GNU General Public License version 2 and
 * only version 2 as published by the Free Software Foundation.
 *
 * This program is distributed in the hope that it will be useful,
 * but WITHOUT ANY WARRANTY; without even the implied warranty of
 * MERCHANTABILITY or FITNESS FOR A PARTICULAR PURPOSE.  See the
 * GNU General Public License for more details.
 */

&i2c {
	actuator0: qcom,actuator@6c {
		cell-index = <1>;
		reg = <0x18 0x0>;
		compatible = "qcom,actuator";
		qcom,cci-master = <0>;
	};
	qcom,camera@20 {
		compatible = "qcom,s5k5e2";
		reg = <0x20>;
		qcom,slave-id = <0x20 0x0000 0x5e20>;
		qcom,csiphy-sd-index = <0>;
		qcom,csid-sd-index = <0>;
		qcom,actuator-src = <&actuator0>;
		qcom,mount-angle = <90>;
		qcom,sensor-name = "s5k5e2";
		cam_vdig-supply = <&pm8110_l6>;
                cam_vaf-supply = <&pm8110_l22>;
		qcom,cam-vreg-name = "cam_vdig", "cam_vio", "cam_vana", "cam_vaf";
		qcom,cam-vreg-type = <0 1 1 0>;
		qcom,cam-vreg-min-voltage = <1800000 0 0 2950000>;
		qcom,cam-vreg-max-voltage = <1800000 0 0 2950000>;
		qcom,cam-vreg-op-mode = <1800000 0 0 2950000>;
		qcom,gpio-no-mux = <0>;
		gpios = <&msmgpio 13 0>,
			<&msmgpio 18 0>,
			<&msmgpio 21 0>;
		qcom,gpio-vana = <1>;
		qcom,gpio-reset = <2>;
		qcom,gpio-req-tbl-num = <0 1 2>;
		qcom,gpio-req-tbl-flags = <0 0 0>;
		qcom,gpio-req-tbl-label = "CAMIF_MCLK",
			"CAM_VANA",
			"CAM_RESET";
		qcom,csi-lane-assign = <0xe4>;
		qcom,csi-lane-mask = <0x3>;
		qcom,sensor-position = <0>;
		qcom,sensor-mode = <0>;
		qcom,sensor-type = <0>;
		qcom,cci-master = <0>;
		status = "ok";
	};

       qcom,camera@7a {
                compatible = "qcom,mt9v113";
                reg = <0x7a 0x0>;
                qcom,slave-id = <0x7a 0x00 0x2280>;
                qcom,csiphy-sd-index = <1>;
                qcom,csid-sd-index = <1>;
                qcom,csi_phy_sel = <1>;
                qcom,mount-angle = <270>;
                qcom,sensor-name = "mt9v113";
                cam_vdig-supply = <&pm8110_l6>;
                qcom,cam-vreg-name = "cam_vdig";
                qcom,cam-vreg-type = <0>;
                qcom,cam-vreg-min-voltage = <1800000>;
                qcom,cam-vreg-max-voltage = <1800000>;
                qcom,cam-vreg-op-mode = <1800000>;
                qcom,gpio-no-mux = <0>;
                gpios = <&msmgpio 14 0>,
                        <&msmgpio 18 0>,
                        <&msmgpio 15 0>,
                        <&msmgpio 20 0>;
                qcom,gpio-vana = <1>;
                qcom,gpio-reset = <2>;
                qcom,gpio-standby = <3>;
                qcom,gpio-req-tbl-num = <0 1 2 3>;
                qcom,gpio-req-tbl-flags = <0 0 0 0>;
                qcom,gpio-req-tbl-label = "CAMIF_MCLK",
                                "CAM_VANA",
                                "CAM_RESET",
                                "CAM_STANDBY";
                qcom,csi-lane-assign = <0xe4>;
                qcom,csi-lane-mask = <0xf>;
                qcom,sensor-position = <1>;
                qcom,sensor-mode = <1>;
                qcom,cci-master = <0>;
                status = "ok";
        };
};
