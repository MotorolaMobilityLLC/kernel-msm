/* Copyright (c) 2013, The Linux Foundation. All rights reserved.
 * Copyright (c) 2014 Motorola Mobility LLC
 *
 * This program is free software; you can redistribute it and/or modify
 * it under the terms of the GNU General Public License version 2 and
 * only version 2 as published by the Free Software Foundation.
 *
 * This program is distributed in the hope that it will be useful,
 * but WITHOUT ANY WARRANTY; without even the implied warranty of
 * MERCHANTABILITY or FITNESS FOR A PARTICULAR PURPOSE.  See the
 * GNU General Public License for more details.
 */

/dts-v1/;

#include "qcom/apq8084.dtsi"
#include "apq8084-shamu/apq8084-lexington.dtsi"
#include "apq8084-shamu/apq8084-moto-old-pwr-grid.dtsi"

/ {
	qcom,msm-id = <178 0x47 0x8000>;

	/delete-node/ cycapsense_prog;
};

&soc {
	sound {
		qcom,ext_hs_detect = "tpa6165";
	};
};

&sdhc_1 {
	qcom,pad-pull-on = <0x0 0x3 0x3 0x0>; /* no-pull, pull-up, pull-up, no-pull */
	qcom,pad-pull-off = <0x0 0x3 0x3 0x0>; /* no-pull, pull-up, pull-up, no-pull */
	qcom,pad-drv-on = <0x7 0x4 0x4>; /* 16mA, 10mA, 10mA */
	qcom,bus-speed-mode = "HS200_1p8v", "DDR_1p8v";
};
