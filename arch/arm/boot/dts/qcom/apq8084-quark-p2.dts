/* Copyright (c) 2014 Motorola Mobility LLC
 *
 * This program is free software; you can redistribute it and/or modify
 * it under the terms of the GNU General Public License version 2 and
 * only version 2 as published by the Free Software Foundation.
 *
 * This program is distributed in the hope that it will be useful,
 * but WITHOUT ANY WARRANTY; without even the implied warranty of
 * MERCHANTABILITY or FITNESS FOR A PARTICULAR PURPOSE.  See the
 * GNU General Public License for more details.
 */

/dts-v1/;

#include "apq8084.dtsi"
#include "apq8084-quark.dtsi"

/ {
	qcom,msm-id = <178 0x42 0x8200>,
		  <178 0x44 0x8200>,
		  <178 0x45 0x8200>;
};

&max17050 {
	maxim,configuration {
		coff		= /bits/ 16 <0xFFE3>; /* -9.28 * 3.125 */
	};
};

&smb1357_otg_vreg {
	qcom,max-batt-curr-ma = <2300>;
};
