/* Copyright (c) 2016, Motorola Mobility LLC. All rights reserved.
 *
 * This program is free software; you can redistribute it and/or modify
 * it under the terms of the GNU General Public License version 2 and
 * only version 2 as published by the Free Software Foundation.
 *
 * This program is distributed in the hope that it will be useful,
 * but WITHOUT ANY WARRANTY; without even the implied warranty of
 * MERCHANTABILITY or FITNESS FOR A PARTICULAR PURPOSE.  See the
 * GNU General Public License for more details.
 */

&mdss_mdp {
	mot_hlt_534_qhd_vid_v0: qcom,mdss_dsi_mot_hlt_534_qhd_video_v0 {
		#include "dsi-panel-mot-hlt-534-qhd-video-common.dtsi"
	};
	mot_hlt_534_qhd_vid_v1: qcom,mdss_dsi_mot_hlt_534_qhd_video_v1 {
		#include "dsi-panel-mot-hlt-534-qhd-video-common.dtsi"
	};
};

&mot_hlt_534_qhd_vid_v0 {
	/delete-property/ qcom,mdss-dsi-on-command;
		qcom,mdss-dsi-on-command = [39 01 00 00 00 00 04 BF 91 61 F2
			39 01 00 00 00 00 03 B3 00 8a
			39 01 00 00 00 00 07 B8 00 E7 01 00 E7 01
			39 01 00 00 00 00 04 BA 3E 23 00
			39 01 00 00 00 00 02 C3 02
			39 01 00 00 00 00 03 C4 00 78
			39 01 00 00 00 00 0A C7 00 03 31 05 65 28 0F A5 A5
			39 01 00 00 00 00 27 C8 7E 6A 4C 35 27 14 16 01 1E 21 26 4C 41 52 4C 54 4F 46 30 7E 6A 4C 35 27 14 16 01 1E 21 26 4C 41 52 4C 54 4F 46 30
			39 01 00 00 00 00 11 D4 1F 1F 1F 1F 06 04 0A 08 00 02 1F 1F 1F 1F 1F 1F
			39 01 00 00 00 00 11 D5 1F 1F 1F 1F 07 05 0B 09 01 03 1F 1F 1F 1F 1F 1F
			39 01 00 00 00 00 15 D8 20 00 00 30 03 30 01 02 00 01 02 06 70 00 00 73 07 06 61 08
			39 01 00 00 00 00 14 D9 00 0A 00 80 00 00 06 7b 00 80 00 33 6A 1F 00 00 00 03 7b
			39 01 00 00 00 00 02 BE 01
			39 01 00 00 00 00 02 C1 10
			39 01 00 00 00 00 02 C5 05
			39 01 00 00 00 00 0b CC 34 20 38 60 11 91 00 40 00 00
			39 01 00 00 00 00 02 BE 00
			39 00 00 00 00 00 02 51 C0
			39 00 00 00 00 00 02 53 2C
			39 00 00 00 00 00 02 55 01
			05 01 00 00 78 00 02 11 00
			05 01 00 00 0A 00 02 29 00];
};
