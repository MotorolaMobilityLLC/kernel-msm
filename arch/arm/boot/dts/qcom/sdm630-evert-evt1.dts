/* Copyright (c) 2017, Motorola Mobility Inc. All rights reserved.
 *
 * This program is free software; you can redistribute it and/or modify
 * it under the terms of the GNU General Public License version 2 and
 * only version 2 as published by the Free Software Foundation.
 *
 * This program is distributed in the hope that it will be useful,
 * but WITHOUT ANY WARRANTY; without even the implied warranty of
 * MERCHANTABILITY or FITNESS FOR A PARTICULAR PURPOSE.  See the
 * GNU General Public License for more details.
 */


/dts-v1/;

#include "sdm630.dtsi"
#include "sdm630-evert.dtsi"

/ {
	qcom,board-id = <0x45 0xA100>;
};

&soc {
	fpc_fpc1020{
		pinctrl-0 = <&fps_ldo_3P3_en_default>;
	};
};

