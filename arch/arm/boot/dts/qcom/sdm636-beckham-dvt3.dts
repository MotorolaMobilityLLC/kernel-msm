/* Copyright (c) 2016, Motorola Mobility Inc. All rights reserved.
 *
 * This program is free software; you can redistribute it and/or modify
 * it under the terms of the GNU General Public License version 2 and
 * only version 2 as published by the Free Software Foundation.
 *
 * This program is distributed in the hope that it will be useful,
 * but WITHOUT ANY WARRANTY; without even the implied warranty of
 * MERCHANTABILITY or FITNESS FOR A PARTICULAR PURPOSE.  See the
 * GNU General Public License for more details.
 */


/dts-v1/;

#include "sdm636.dtsi"
#include "sdm636-beckham.dtsi"

/ {
	qcom,board-id = <0x4A 0xB300>;
};

&anx_slimport {
	analogix,p-dwn-gpio = <&tlmm 55 0>;
	analogix,vdd-1p0-enable-gpio = <&tlmm 80 0x0>;
	avdd-3p3-supply = <&pm660l_l8>;
};
