/* Copyright (c) 2016, The Linux Foundation. All rights reserved.
 *
 * This program is free software; you can redistribute it and/or modify
 * it under the terms of the GNU General Public License version 2 and
 * only version 2 as published by the Free Software Foundation.
 *
 * This program is distributed in the hope that it will be useful,
 * but WITHOUT ANY WARRANTY; without even the implied warranty of
 * MERCHANTABILITY or FITNESS FOR A PARTICULAR PURPOSE.  See the
 * GNU General Public License for more details.
 */

qcom,gl40-sony {
	serialnum = "SNN5975";
	/* #2362071_Moto_GL40_3510mAh_averaged_MasterSlave_Mar14th2016*/
	qcom,max-voltage-uv = <4400000>;
	qcom,nom-batt-capacity-mah = <3510>;
	qcom,batt-id-kohm = <243>;
	qcom,battery-beta = <3900>;
	qcom,battery-type = "GL40-SONY-3510mah";
	qcom,chg-rslow-comp-c1 = <3181483>;
	qcom,chg-rslow-comp-c2 = <5106101>;
	qcom,chg-rs-to-rslow = <886839>;
	qcom,chg-rslow-comp-thr = <0xAF>;
	qcom,checksum = <0x0FC7>;
	qcom,gui-version = "PMI8950GUI - 2.0.0.16";
	qcom,fg-profile-data = [
		 E7 83 FD 7C
		 28 81 57 77
		 3A 83 37 70
		 B4 6A 2E 7D
		 FA 81 D5 99
		 5E BC 8E C8
		 51 0F E4 83
		 78 7C BD 80
		 89 76 42 83
		 A7 6B 95 7A
		 7D 8C 13 82
		 34 9A 65 BD
		 BC CA 55 0E
		 FB 0D 04 5A
		 14 70 A6 FB
		 AF 33 47 45
		 00 00 00 00
		 C7 3E 10 30
		 FD 16 00 00
		 00 00 00 00
		 00 00 00 00
		 03 70 D3 6A
		 E2 75 DB 7B
		 07 7C C8 6B
		 AD 74 D2 7A
		 00 7C A3 6B
		 3A 86 8F BA
		 0F AD 5A 85
		 55 A0 71 0C
		 28 00 FF 36
		 F0 11 30 03
		 00 00 00 0C
	];
};
