/* Copyright (c) 2015, The Linux Foundation. All rights reserved.
 *
 * This program is free software; you can redistribute it and/or modify
 * it under the terms of the GNU General Public License version 2 and
 * only version 2 as published by the Free Software Foundation.
 *
 * This program is distributed in the hope that it will be useful,
 * but WITHOUT ANY WARRANTY; without even the implied warranty of
 * MERCHANTABILITY or FITNESS FOR A PARTICULAR PURPOSE.  See the
 * GNU General Public License for more details.
 */

&mdss_mdp {
	dsi_dijing_otm1901a_1080_vid: qcom,mdss_dsi_dijing_otm1901a_1080p_video {
		qcom,mdss-dsi-panel-name = "dijing OTM1901A 1080p video mode dsi panel";
		qcom,mdss-dsi-panel-type = "dsi_video_mode";
		qcom,cont-splash-enabled;
		qcom,mdss-dsi-panel-framerate = <60>;
		qcom,mdss-dsi-virtual-channel-id = <0>;
		qcom,mdss-dsi-stream = <0>;
		qcom,mdss-dsi-panel-width = <1080>;
		qcom,mdss-dsi-panel-height = <1920>;
		qcom,mdss-dsi-h-front-porch = <90>;
		qcom,mdss-dsi-h-back-porch = <60>;
		qcom,mdss-dsi-h-pulse-width = <20>;
		qcom,mdss-dsi-h-sync-skew = <0>;
		qcom,mdss-dsi-v-front-porch = <8>;
		qcom,mdss-dsi-v-back-porch = <10>;
		qcom,mdss-dsi-v-pulse-width = <2>;
		qcom,mdss-dsi-h-left-border = <0>;
		qcom,mdss-dsi-h-right-border = <0>;
		qcom,mdss-dsi-v-top-border = <0>;
		qcom,mdss-dsi-v-bottom-border = <0>;
		qcom,mdss-dsi-bpp = <24>;
		qcom,mdss-dsi-underflow-color = <0xff>;
		qcom,mdss-dsi-border-color = <0>;
		qcom,mdss-dsi-h-sync-pulse = <0>;
		qcom,mdss-dsi-traffic-mode = "burst_mode";
		qcom,mdss-dsi-bllp-eof-power-mode;
		qcom,mdss-dsi-bllp-power-mode;
		qcom,mdss-dsi-lane-0-state;
		qcom,mdss-dsi-lane-1-state;
		qcom,mdss-dsi-lane-2-state;
		qcom,mdss-dsi-lane-3-state;
		qcom,mdss-dsi-panel-timings = [e7 36 24 00 66 6a 2a 3a 2d 03 04 00];
		qcom,mdss-dsi-t-clk-post = <0x03>;
		qcom,mdss-dsi-t-clk-pre = <0x2b>;
		qcom,mdss-dsi-bl-min-level = <10>;
		qcom,mdss-dsi-bl-max-level = <225>;
		qcom,mdss-dsi-dma-trigger = "trigger_sw";
		qcom,mdss-dsi-mdp-trigger = "none";
                qcom,mdss-pan-physical-width-dimension = <69>;
                qcom,mdss-pan-physical-height-dimension = <122>;
		qcom,mdss-dsi-on-command = [
			29 01 00 00 00 00 02
			00 00
			29 01 00 00 00 00 04
			FF 19 01 01
			29 01 00 00 00 00 02
			00 80
			29 01 00 00 00 00 03
			FF 19 01
			29 01 00 00 00 00 02
			00 00
			29 01 00 00 00 00 02
			1C 33
			29 01 00 00 00 00 02
			00 A0
			29 01 00 00 00 00 02
			C1 E8
			29 01 00 00 00 00 02
			00 A7
			29 01 00 00 00 00 02
			C1 00
			29 01 00 00 00 00 02
			00 90
			29 01 00 00 00 00 07
			C0 00 2F 00 00 00 01
			29 01 00 00 00 00 02
			00 C0
			29 01 00 00 00 00 07
			C0 00 2F 00 00 00 01
			29 01 00 00 00 00 02
			00 9A
			29 01 00 00 00 00 02
			C0 1E
			29 01 00 00 00 00 02
			00 AC
			29 01 00 00 00 00 02
			C0 06
			29 01 00 00 00 00 02
			00 DC
			29 01 00 00 00 00 02
			C0 06
			29 01 00 00 00 00 02
			00 81
			29 01 00 00 00 00 02
			A5 04
			29 01 00 00 00 00 02
			00 84
			29 01 00 00 00 00 02
			C4 20
			29 01 00 00 00 00 02
			00 A5
			29 01 00 00 00 00 02
			B3 1d
			29 01 00 00 00 00 02
			00 92
			29 01 00 00 00 00 02
			E9 00
			29 01 00 00 00 00 02
			00 90
			29 01 00 00 00 00 02
			F3 01
			29 01 00 00 00 00 02
			00 B4
			29 01 00 00 00 00 02
			C0 D0
			29 01 00 00 00 00 02
			00 93
			29 01 00 00 00 00 02
			C5 19
			29 01 00 00 00 00 02
			00 95
			29 01 00 00 00 00 02
			C5 2D
			29 01 00 00 00 00 02
			00 97
			29 01 00 00 00 00 02
			C5 14
			29 01 00 00 00 00 02
			00 99
			29 01 00 00 00 00 02
			C5 29
			29 01 00 00 00 00 02
			00 00
			29 01 00 00 00 00 03
			D8 1D 1D
			29 01 00 00 00 00 02
			00 B3
			29 01 00 00 00 00 02
			C0 CC
			29 01 00 00 00 00 02
			00 B4
			29 01 00 00 00 00 02
			C0 80
			29 01 00 00 00 00 02
			00 BC
			29 01 00 00 00 00 02
			C0 00
			29 01 00 00 00 00 02
			00 F7
			29 01 00 00 00 00 05
			C3 04 18 04 04
			29 01 00 00 00 00 02
			00 81
			29 01 00 00 00 00 02
			A5 07
			29 01 00 00 00 00 02
			00 9D
			29 01 00 00 00 00 02
			C5 77
			29 01 00 00 00 00 02
			00 9B
			29 01 00 00 00 00 03
			C5 55 55
			29 01 00 00 00 00 02
			00 80
			29 01 00 00 00 00 02
			C4 15
			/*remove VCOM
			29 01 00 00 00 00 02
			00 00
			29 01 00 00 00 00 02
			D9 00
			29 01 00 00 00 00 02
			00 01
			29 01 00 00 00 00 02
			D9 B4
			*/
			29 01 00 00 00 00 02
			00 80
			29 01 00 00 00 00 0f
			C0 00 87 00 0A 0A 00
			87 0A 0A 00 87 00 0A
			0A
			29 01 00 00 00 00 02
			00 F0
			29 01 00 00 00 00 07
			C3 22 02 00 00 00 0C
			29 01 00 00 00 00 02
			00 A0
			29 01 00 00 00 00 08
			C0 00 00 00 00 03 22
			03
			29 01 00 00 00 00 02
			00 D0
			29 01 00 00 00 00 08
			C0 00 00 00 00 03 22
			03
			29 01 00 00 00 00 02
			00 90
			29 01 00 00 00 00 09
			C2 83 01 00 00 82 01
			00 00
			29 01 00 00 00 00 02
			00 80
			29 01 00 00 00 00 0d
			C3 82 02 03 00 03 84
			81 03 03 00 03 84
			29 01 00 00 00 00 02
			00 90
			29 01 00 00 00 00 0d
			C3 00 01 03 00 03 84
			01 02 03 00 03 84
			29 01 00 00 00 00 02
			00 80
			29 01 00 00 00 00 10
			CC 09 0A 11 12 13 14
			15 16 17 18 28 28 28
			28 28
			29 01 00 00 00 00 02
			00 90
			29 01 00 00 00 00 10
			CC 0A 09 14 13 12 11
			15 16 17 18 28 28 28
			28 28
			29 01 00 00 00 00 02
			00 A0
			29 01 00 00 00 00 10
			CC 1D 1E 1F 19 1A 1B
			1C 20 21 22 23 24 25
			26 27
			29 01 00 00 00 00 02
			00 B0
			29 01 00 00 00 00 09
			CC 01 02 03 05 06 07
			04 08
			29 01 00 00 00 00 02
			00 C0
			29 01 00 00 00 00 0d
			CC 00 00 00 00 00 00
			00 00 00 00 00 77
			29 01 00 00 00 00 02
			00 D0
			29 01 00 00 00 00 0d
			CC 00 00 00 00 05 00
			00 00 00 00 00 77
			29 01 00 00 00 00 02
			00 80
			29 01 00 00 00 00 10
			CB 00 00 00 00 00 00
			00 00 00 00 00 00 00
			00 00
			29 01 00 00 00 00 02
			00 90
			29 01 00 00 00 00 10
			CB 00 00 00 00 00 00
			00 00 00 00 00 00 00
			00 00
			29 01 00 00 00 00 02
			00 A0
			29 01 00 00 00 00 10
			CB 01 01 01 01 01 01
			00 00 00 00 00 00 00
			00 00
			29 01 00 00 00 00 02
			00 B0
			29 01 00 00 00 00 10
			CB 00 01 FD 00 00 00
			00 00 00 00 00 00 00
			00 00
			29 01 00 00 00 00 02
			00 C0
			29 01 00 00 00 00 09
			CB 00 00 00 00 00 00
			77 77
			29 01 00 00 00 00 02
			00 D0
			29 01 00 00 00 00 09
			CB 00 00 00 00 00 00
			77 77
			29 01 00 00 00 00 02
			00 E0
			29 01 00 00 00 00 09
			CB 00 00 00 00 00 00
			77 77
			29 01 00 00 00 00 02
			00 F0
			29 01 00 00 00 00 09
			CB 01 01 01 00 00 00
			77 77
			29 01 00 00 00 00 02
			00 80
			29 01 00 00 00 00 10
			CD 3F 3F 3F 3F 3F 3F
			3F 3F 3F 02 12 11 3F
			04 3F
			29 01 00 00 00 00 02
			00 90
			29 01 00 00 00 00 0c
			CD 06 3F 3F 26 26 26
			21 20 1F 26 26
			29 01 00 00 00 00 02
			00 A0
			29 01 00 00 00 00 10
			CD 3F 3F 3F 3F 3F 3F
			3F 3F 3F 01 12 11 3F
			03 3F
			29 01 00 00 00 00 02
			00 B0
			29 01 00 00 00 00 0c
			CD 05 3F 3F 26 26 26
			21 20 1F 26 26
			29 01 00 00 00 00 02
			00 00
			29 01 00 00 00 00 19
			e1 30 35 36 3a 40 44
			46 52 58 66 6c 72 88
			81 77 60 4d 39 2c 24
			12 09 06 03
			29 01 00 00 00 00 02
			00 00
			29 01 00 00 00 00 19
			e2 30 35 36 3a 40 44
			46 52 58 66 6c 72 88
			81 77 60 4d 39 2c 24
			12 09 06 03
			29 01 00 00 00 00 02
			00 00
			29 01 00 00 00 00 19
			e3 1c 1d 20 25 28 2c
			36 43 48 59 63 6c 8d
			84 7a 63 4d 39 2c 24
			1d 11 07 03
			29 01 00 00 00 00 02
			00 00
			29 01 00 00 00 00 19
			e4 1c 1d 20 25 28 2c
			36 43 48 59 63 6c 8d
			84 7a 63 4d 39 2c 24
			1d 11 07 03
			29 01 00 00 00 00 02
			00 00
			29 01 00 00 00 00 19
			e5 00 07 08 0d 13 1b
			25 36 40 52 5f 69 8f
			86 7b 63 4d 39 2c 24
			1e 0d 04 03
			29 01 00 00 00 00 02
			00 00
			29 01 00 00 00 00 19
			e6 00 07 08 0d 13 1b
			25 36 40 52 5f 69 8f
			86 7b 63 4c 38 30 20
			1e 0d 04 03
			29 01 00 00 00 00 02
			00 81
			29 01 00 00 00 00 02
			A5 07
			29 01 00 00 00 00 02
			00 80
			29 01 00 00 00 00 02
			C4 1A
			29 01 00 00 00 00 02
			00 9B
			29 01 00 00 00 00 03
			C5 55 50
			29 01 00 00 00 00 02
			00 F7
			29 01 00 00 00 00 05
			C3 04 16 04 04
			29 01 00 00 00 00 02
			00 F2
			29 01 00 00 00 00 04
			C1 80 00 00
			29 01 00 00 00 00 02
			00 9D
			29 01 00 00 00 00 02
			C5 77
			29 01 00 00 00 00 02
			00 F7
			29 01 00 00 00 00 05
			C3 00 FF 00 00
			29 01 00 00 00 00 02
			00 F2
			29 01 00 00 00 00 04
			C1 00 00 00
			29 01 00 00 00 00 02
			00 d0
			29 01 00 00 00 00 05
			F5 00 00 00 00
			29 01 00 00 00 00 02
			00 00
			29 01 00 00 00 00 04
			FF FF FF FF
			29 01 00 00 00 00 02
			51 00
			29 01 00 00 00 00 02
			53 24
			05 01 00 00 78 00 02
			11 00
			05 01 00 00 00 00 02
			29 00
		];
		qcom,mdss-dsi-off-command = [
			05 01 00 00 32 00 02
			28 00
			05 01 00 00 10 00 02
			10 00
		];

		qcom,mdss-dsi-on-command-state = "dsi_lp_mode";
		qcom,mdss-dsi-off-command-state = "dsi_lp_mode";

		qcom,mdss-dsi-bl-pmic-control-type = "bl_ctrl_dcs";
		qcom,mdss-dsi-reset-sequence = <1 20>, <0 10>, <1 20>;
		qcom,mdss-dsi-tx-eot-append;
		qcom,panel-supply-entries = <&dsi_panel_pwr_supply>;

		qcom,mdss-dsi-panel-status-command = [06 01 00 01 05 00 02 0A 08];
		qcom,mdss-dsi-panel-status-command-state = "dsi_hs_mode";
		qcom,mdss-dsi-panel-status-check-mode = "reg_read";
		qcom,mdss-dsi-panel-status-value = <0x9c>;
		qcom,esd-check-enabled;
	};
};
