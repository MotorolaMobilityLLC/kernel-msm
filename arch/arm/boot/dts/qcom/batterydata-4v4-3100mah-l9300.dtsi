/* Copyright (c) 2015, The Linux Foundation. All rights reserved.
 *
 * This program is free software; you can redistribute it and/or modify
 * it under the terms of the GNU General Public License version 2 and
 * only version 2 as published by the Free Software Foundation.
 *
 * This program is distributed in the hope that it will be useful,
 * but WITHOUT ANY WARRANTY; without even the implied warranty of
 * MERCHANTABILITY or FITNESS FOR A PARTICULAR PURPOSE.  See the
 * GNU General Public License for more details.
 */

qcom,l9300_3100mah {
	qcom,max-voltage-uv = <4400000>;
	qcom,nom-batt-capacity-mah = <3100>;
	qcom,batt-id-kohm = <47>;
	qcom,battery-beta = <3380>;
	qcom,battery-type = "l9300_3100mah_20160104";
	qcom,fastchg-current-ma = <3000>;
	qcom,fg-cc-cv-threshold-mv = <4390>;
	qcom,chg-rslow-comp-c1 = <4269225>;
	qcom,chg-rslow-comp-c2 = <7871954>;
	qcom,chg-rs-to-rslow = <1093662>;
	qcom,chg-rslow-comp-thr = <0xBA>;
	qcom,checksum = <0x3264>;
	qcom,thermal-coefficients = [DA 86 F0 50 08 3C];
	qcom,gui-version = "PMI8950GUI - 2.0.0.15";
	qcom,fg-profile-data = [
		 D5 83 2E 7C
		 5E 80 83 75
		 62 83 AC 6E
		 D9 88 22 94
		 2E 82 CB 99
		 C1 BC 4A C9
		 56 0E E6 83
		 4E 7C 4D 80
		 24 75 5B 83
		 C5 5A A7 81
		 06 8E 53 82
		 AA 99 06 BD
		 03 CA 55 0D
		 FA 0B A3 5A
		 14 70 98 FD
		 0F 36 44 3D
		 FD 2E 00 00
		 74 44 FC 2B
		 5E 34 00 00
		 00 00 00 00
		 00 00 00 00
		 39 6B 1F 6A
		 50 69 C7 81
		 C1 6F DE 60
		 8E 5A 24 7B
		 80 6F 80 61
		 20 7D 83 92
		 1B 50 62 05
		 64 A0 71 0C
		 28 00 FF 36
		 F0 11 30 03
		 00 00 00 0C
	];
};
