/* Copyright (c) 2016, Motorola Mobility Inc. All rights reserved.
 *
 * This program is free software; you can redistribute it and/or modify
 * it under the terms of the GNU General Public License version 2 and
 * only version 2 as published by the Free Software Foundation.
 *
 * This program is distributed in the hope that it will be useful,
 * but WITHOUT ANY WARRANTY; without even the implied warranty of
 * MERCHANTABILITY or FITNESS FOR A PARTICULAR PURPOSE.  See the
 * GNU General Public License for more details.
 */


/dts-v1/;

#include "sdm636.dtsi"
#include "sdm636-beckham.dtsi"

/ {
	qcom,board-id = <0x49 0xB2A0>;
};

&mot_tianma_601_1080p_cmd_v0 {
	qcom,mdss-dsi-on-command = [
		15 00 00 00 00 00 02 FE 70
		15 00 00 00 00 00 02 7E 4A      /* 5100 Source Linear*/
		15 00 00 00 00 00 02 49 05
		15 00 00 00 00 00 02 4A 14
		15 00 00 00 00 00 02 4B 32
		15 00 00 00 00 00 02 4C 6B
		15 00 00 00 00 00 02 4D AD
		15 00 00 00 00 00 02 4E DA
		15 00 00 00 00 00 02 4F 25
		15 00 00 00 00 00 02 50 8E
		15 00 00 00 00 00 02 51 33
		15 00 00 00 00 00 02 AD F4
		15 00 00 00 00 00 02 AE 83
		15 00 00 00 00 00 02 AF 00
		15 00 00 00 00 00 02 B0 50
		15 00 00 00 00 00 02 B1 3A
		15 00 00 00 00 00 02 FE 00
		15 00 00 00 00 00 02 35 00
		15 00 00 00 00 00 02 53 20	/* HBM off ,dimming = 1frame*/
		39 00 00 00 00 00 02 51 00
		15 00 00 00 00 00 02 55 00      /* ACL OFF */
		05 01 00 00 78 00 01 11
		05 01 00 00 0A 00 01 29];	/* display on */
};
