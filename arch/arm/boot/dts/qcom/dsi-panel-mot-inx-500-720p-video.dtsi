/* Copyright (c) 2014, Motorola Mobility LLC. All rights reserved.
 *
 * This program is free software; you can redistribute it and/or modify
 * it under the terms of the GNU General Public License version 2 and
 * only version 2 as published by the Free Software Foundation.
 *
 * This program is distributed in the hope that it will be useful,
 * but WITHOUT ANY WARRANTY; without even the implied warranty of
 * MERCHANTABILITY or FITNESS FOR A PARTICULAR PURPOSE.  See the
 * GNU General Public License for more details.
 */

&mdss_mdp {
	mot_inx_500_720p_vid_v0: qcom,mdss_dsi_mot_inx_500_720p_video_v0 {
		qcom,mdss-dsi-panel-name = "mipi_mot_video_inx_720p_500_v0";
		qcom,mdss-dsi-panel-controller = <&mdss_dsi0>;
		qcom,mdss-dsi-panel-type = "dsi_video_mode";
		qcom,mdss-dsi-panel-destination = "display_1";
		qcom,mdss-dsi-panel-framerate = <60>;
		qcom,mdss-dsi-virtual-channel-id = <0>;
		qcom,mdss-dsi-stream = <0>;
		qcom,mdss-dsi-panel-width = <720>;
		qcom,mdss-dsi-panel-height = <1280>;
		qcom,mdss-pan-physical-width-dimension = <62>;
		qcom,mdss-pan-physical-height-dimension = <110>;
		qcom,mdss-dsi-panel-clockrate = <421729920>;
		qcom,mdss-dsi-h-front-porch = <48>;
		qcom,mdss-dsi-h-back-porch = <68>;
		qcom,mdss-dsi-h-pulse-width = <8>;
		qcom,mdss-dsi-h-sync-skew = <0>;
		qcom,mdss-dsi-v-back-porch = <50>;
		qcom,mdss-dsi-v-front-porch = <52>;
		qcom,mdss-dsi-v-pulse-width = <6>;
		qcom,mdss-dsi-h-left-border = <0>;
		qcom,mdss-dsi-h-right-border = <0>;
		qcom,mdss-dsi-v-top-border = <0>;
		qcom,mdss-dsi-v-bottom-border = <0>;
		qcom,mdss-dsi-bpp = <24>;
		qcom,mdss-dsi-underflow-color = <0xff>;
		qcom,mdss-dsi-border-color = <0>;
		qcom,splash-no-solid-fill;

		qcom,mdss-dsi-on-command = [
			29 01 00 00 00 00 06 F0 55 AA 52 08 00	/* Page 0 */
			29 01 00 00 00 00 0B E8 F3 D9 CC C0 B8 B0 A0 A0 A0 9C /* Brightness control for Moving Mode */
			29 01 00 00 00 00 03 D9 03 06		/* Set PWM frequency as 32.55k Hz*/
			29 01 00 00 00 00 02 EA 09		/* PWM compensation */
			05 01 00 00 78 00 02 11 00		/* Exit sleep */
			15 01 00 00 00 00 02 51 E2		/* Brightness */
			15 01 00 00 00 00 02 53 2C		/* CTRL Display */
			15 01 00 00 00 00 02 55 01		/* CABC Effect */
			05 01 00 00 00 00 02 29 00];		/* Display on */

		qcom,mdss-dsi-off-command = [
			05 01 00 00 78 00 02 28 00
			05 01 00 00 00 00 02 10 00];

		qcom,mdss-dsi-on-command-state = "dsi_lp_mode";
		qcom,mdss-dsi-off-command-state = "dsi_hs_mode";
		qcom,mdss-dsi-cabc-ui-command = [15 01 00 00 00 00 02 55 01];
		qcom,mdss-dsi-cabc-mv-command = [15 01 00 00 00 00 02 55 03];
		qcom,mdss-dsi-hbm-off-brightness = <256>;
		qcom,mdss-dsi-hbm-on-brightness = <257>;
		qcom,mdss-dsi-h-sync-pulse = <1>;
		qcom,mdss-dsi-traffic-mode = "burst_mode";
		qcom,mdss-dsi-bllp-eof-power-mode;
		qcom,mdss-dsi-bllp-power-mode;
		qcom,mdss-dsi-lane-0-state;
		qcom,mdss-dsi-lane-1-state;
		qcom,mdss-dsi-lane-2-state;
		qcom,mdss-dsi-lane-3-state;
		qcom,mdss-dsi-panel-timings = [7B 1A 10 00 3E 42 16 1E 15 03 04 00];
		qcom,mdss-dsi-t-clk-post = <0x04>;
		qcom,mdss-dsi-t-clk-pre = <0x1A>;
		qcom,mdss-dsi-bl-min-level = <1>;
		qcom,mdss-dsi-bl-max-level = <255>;
		qcom,mdss-dsi-dma-trigger = "trigger_sw";
		qcom,mdss-dsi-mdp-trigger = "none";
		qcom,mdss-dsi-bl-pmic-control-type = "bl_ctrl_wled";
		qcom,mdss-dsi-reset-sequence = <1 1>, <0 10>, <1 20>;
		qcom,mdss-dsi-lp11-init;
		qcom,mdss-dsi-tx-eot-append;
	};
};
