/* Copyright (c) 2016, Motorla Mobility LLC. All rights reserved.
 *
 * This program is free software; you can redistribute it and/or modify
 * it under the terms of the GNU General Public License version 2 and
 * only version 2 as published by the Free Software Foundation.
 *
 * This program is distributed in the hope that it will be useful,
 * but WITHOUT ANY WARRANTY; without even the implied warranty of
 * MERCHANTABILITY or FITNESS FOR A PARTICULAR PURPOSE.  See the
 * GNU General Public License for more details.
 */

#include "msm8996-v3.dtsi"
#include "msm8996-wabash-common.dtsi"

&i2c_7 {
	analogix_anx78e6@72 {
		/delete-property/ interrupt-parent;
		/delete-property/ interrupts;
		/delete-property/ analogix,cbl-det-gpio;
	};
};

