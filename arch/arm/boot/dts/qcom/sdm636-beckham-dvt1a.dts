/* Copyright (c) 2016, Motorola Mobility Inc. All rights reserved.
 *
 * This program is free software; you can redistribute it and/or modify
 * it under the terms of the GNU General Public License version 2 and
 * only version 2 as published by the Free Software Foundation.
 *
 * This program is distributed in the hope that it will be useful,
 * but WITHOUT ANY WARRANTY; without even the implied warranty of
 * MERCHANTABILITY or FITNESS FOR A PARTICULAR PURPOSE.  See the
 * GNU General Public License for more details.
 */


/dts-v1/;

#include "sdm636.dtsi"
#include "sdm636-beckham.dtsi"
#include "dsi-panel-mot-smd-549-1080p-alb-cmd.dtsi"

/ {
	qcom,board-id = <0x48 0xB1A0>;
};

&mot_smd_549_1080p_alb_cmd_v0 {
	qcom,panel-supply-entries {
			qcom,panel-supply-entry@4 {
				reg = <4>;
				qcom,supply-name = "oled_disp";
				qcom,supply-min-voltage = <5000000>;
				qcom,supply-max-voltage = <8100000>;
				qcom,supply-enable-load = <100000>;
				qcom,supply-disable-load = <100>;
			};
	};
};
