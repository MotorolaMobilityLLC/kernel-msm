/* Copyright (c) 2016, Motorola Mobility LLC. All rights reserved.
 *
 * This program is free software; you can redistribute it and/or modify
 * it under the terms of the GNU General Public License version 2 and
 * only version 2 as published by the Free Software Foundation.
 *
 * This program is distributed in the hope that it will be useful,
 * but WITHOUT ANY WARRANTY; without even the implied warranty of
 * MERCHANTABILITY or FITNESS FOR A PARTICULAR PURPOSE.  See the
 * GNU General Public License for more details.
 */

&mdss_mdp {
	mot_djn_520_720p_vid_v0: qcom,mdss_dsi_mot_djn_520_720p_video_v0 {
		#include "dsi-panel-mot-djn-520-720p-video-common.dtsi"
	};
	mot_djn_520_720p_vid_v1: qcom,mdss_dsi_mot_djn_520_720p_video_v1 {
		#include "dsi-panel-mot-djn-520-720p-video-common.dtsi"
	};
};

&mot_djn_520_720p_vid_v0 {
	/delete-property/ qcom,mdss-dsi-on-command;
	qcom,mdss-dsi-on-command = [05 01 00 00 78 00 02 11 00
	39 01 00 00 00 00 04 B9 FF 83 94
	39 01 00 00 00 00 0B B1 48 0B 6B 09 33 54 71 71 2C 43
	39 01 00 00 00 00 07 BA 63 03 68 6B B2 C0
	39 01 00 00 00 00 07 B2 00 80 64 0C 06 2F
	39 01 00 00 00 00 17 B4 21 7F 21 7F 21 7F 01 0C 84 75 00 3F 21 7F 21 7F 21 7F 01 0C 84 3F
	39 01 00 00 00 00 22 D3 00 00 00 00 00 00 08 08 32 10 05 00 05 32 13 C1 00 01 32 10 08 00 00 37 03 07 07 37 05 05 37 0C 40
	39 01 00 00 00 00 2D D5 18 18 18 18 22 23 20 21 04 05 06 07 00 01 02 03 18 18 18 18 18 18 18 18 18 18 18 18 18 18 18 18 18 18 18 18 18 18 18 18 19 19 19 19
	39 01 00 00 00 00 2D D6 18 18 19 19 21 20 23 22 03 02 01 00 07 06 05 04 18 18 18 18 18 18 18 18 18 18 18 18 18 18 18 18 18 18 18 18 18 18 18 18 19 19 18 18
	39 01 00 00 00 00 02 BD 01
	39 01 00 00 00 00 02 B1 00
	39 01 00 00 00 00 02 BD 00
	39 01 00 00 00 00 02 CC 07
	39 01 00 00 00 00 03 C0 1F 73
	39 01 00 00 00 00 03 B6 90 90
	39 01 00 00 00 00 02 D4 02
	39 01 00 00 00 00 02 C6 EF
	39 01 00 00 00 00 0A C9 13 00 14 1E 31 1E 00 91 00
	39 01 00 00 00 00 02 53 2C
	39 01 00 00 00 00 02 55 01
	39 01 00 00 00 00 02 51 E0
	39 01 00 00 00 00 3B E0 00 01 05 09 0A 0D 0F 0D 1B 2C 3E 3F 4C 62 6C 73 81 84 81 92 A3 51 50 55 5A 5F 68 78 7F 00 01 05 09 0A 0D 0F 0D 1B 2C 3E 3F 4C 62 6C 73 81 84 81 92 A3 51 50 55 5A 5F 68 78 7F
	05 01 00 00 14 00 02 29 00];		/* Display on */
};
