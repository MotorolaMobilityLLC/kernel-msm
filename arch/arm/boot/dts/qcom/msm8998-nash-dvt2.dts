/* Copyright (c) 2016, Motorola Mobility Inc. All rights reserved.
 *
 * This program is free software; you can redistribute it and/or modify
 * it under the terms of the GNU General Public License version 2 and
 * only version 2 as published by the Free Software Foundation.
 *
 * This program is distributed in the hope that it will be useful,
 * but WITHOUT ANY WARRANTY; without even the implied warranty of
 * MERCHANTABILITY or FITNESS FOR A PARTICULAR PURPOSE.  See the
 * GNU General Public License for more details.
 */

/dts-v1/;

#include "msm8998-nash.dtsi"

/ {
	qcom,board-id = <0x42 0xB2A0>;
};

&cci {
	/* OV5695 OTP */
	qcom,eeprom@1 {
		cam_vdig-supply = <&pm8998_l14>;
		qcom,cam-vreg-min-voltage = <0 1256000>;
		qcom,cam-vreg-max-voltage = <0 1256000>;
	};

	/* OV5695 */
	qcom,camera@1 {
		cam_vdig-supply = <&pm8998_l14>;
		qcom,cam-vreg-min-voltage = <0 1256000>;
		qcom,cam-vreg-max-voltage = <0 1256000>;
	};
};
