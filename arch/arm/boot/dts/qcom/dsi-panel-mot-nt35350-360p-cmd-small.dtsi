/* Copyright (c) 2013, The Linux Foundation. All rights reserved.
 *
 * This program is free software; you can redistribute it and/or modify
 * it under the terms of the GNU General Public License version 2 and
 * only version 2 as published by the Free Software Foundation.
 *
 * This program is distributed in the hope that it will be useful,
 * but WITHOUT ANY WARRANTY; without even the implied warranty of
 * MERCHANTABILITY or FITNESS FOR A PARTICULAR PURPOSE.  See the
 * GNU General Public License for more details.
 */

/*---------------------------------------------------------------------------
 * This file is autogenerated file using gcdb parser. Please do not edit it.
 * Update input XML file to add a new entry or update variable in this file
 * VERSION = "1.0"
 *---------------------------------------------------------------------------*/
&mdss_mdp {
	dsi_mot_nt35350_360p_cmd_small: qcom,mdss_dsi_mot_nt35350_360p_cmd_small {
		qcom,mdss-dsi-panel-config-version = "1.08.01";
		qcom,mdss-dsi-panel-name = "mot nt35350 command mode dsi panel 2.0";
		qcom,mdss-dsi-panel-controller = <&mdss_dsi0>;
		qcom,mdss-dsi-panel-type = "dsi_cmd_mode";
		qcom,mdss-dsi-panel-destination = "display_1";
		qcom,mdss-dsi-panel-framerate = <60>;
		qcom,mdss-dsi-panel-clockrate = <208000000>;
		qcom,mdss-dsi-panel-esc-clockrate = <12800000>;
		qcom,mdss-dsi-virtual-channel-id = <0>;
		qcom,mdss-dsi-stream = <0>;
		qcom,mdss-dsi-panel-width = <360>;
		qcom,mdss-dsi-panel-height = <325>;
		qcom,mdss-dsi-h-front-porch = <0>;
		qcom,mdss-dsi-h-back-porch = <0>;
		qcom,mdss-dsi-h-pulse-width = <0>;
		qcom,mdss-dsi-h-sync-skew = <0>;
		qcom,mdss-dsi-v-back-porch = <55>;
		qcom,mdss-dsi-v-front-porch = <20>;
		qcom,mdss-dsi-v-pulse-width = <1>;
		qcom,mdss-dsi-h-left-border = <0>;
		qcom,mdss-dsi-h-right-border = <0>;
		qcom,mdss-dsi-v-top-border = <0>;
		qcom,mdss-dsi-v-bottom-border = <0>;
		qcom,mdss-dsi-bpp = <24>;
		qcom,mdss-dsi-underflow-color = <0xff>;
		qcom,mdss-dsi-border-color = <0>;
		qcom,mdss-dsi-on-command = [15 01 00 00 00 00 02 FF 24
		15 01 00 00 00 00 02 FB 01
		15 01 00 00 00 00 02 C8 00
		15 01 00 00 00 00 02 D2 E6
		15 01 00 00 00 00 02 D3 E6
		15 01 00 00 00 00 02 D4 CE
		15 01 00 00 00 00 02 D5 01
		15 01 00 00 00 00 02 D8 43
		15 01 00 00 00 00 02 FF 10
		15 01 00 00 00 00 02 FB 01
		39 01 00 00 00 00 05 2A 00 00 01 67
		39 01 00 00 00 00 05 2B 00 00 01 45
		15 01 00 00 00 00 02 C0 01
		05 01 00 00 64 00 01 11
		05 01 00 00 28 00 01 29];
		qcom,mdss-dsi-off-command = [05 01 00 00 00 00 01 28
		05 01 00 00 55 00 01 10];
		qcom,mdss-dsi-on-command-state = "dsi_lp_mode";
		qcom,mdss-dsi-off-command-state = "dsi_hs_mode";
		qcom,mdss-dsi-h-sync-pulse = <0>;
		qcom,mdss-dsi-traffic-mode = "burst_mode";
		qcom,mdss-dsi-bllp-eof-power-mode;
		qcom,mdss-dsi-bllp-power-mode;
		qcom,mdss-dsi-lane-0-state;
		qcom,mdss-dsi-te-pin-select = <1>;
		qcom,mdss-dsi-te-dcs-command = <1>;
		qcom,mdss-dsi-te-check-enable;
		qcom,mdss-dsi-te-using-te-pin;
		qcom,mdss-dsi-panel-timings = [3A 12 08 00 2A 2E 0C 14 0E 03 04 00];
		qcom,mdss-dsi-t-clk-post = <0x05>;
		qcom,mdss-dsi-t-clk-pre = <0x11>;
		qcom,mdss-dsi-dma-trigger = "trigger_sw";
		qcom,mdss-dsi-mdp-trigger = "none";
		qcom,mdss-pan-physical-width-dimension = <35>;
		qcom,mdss-pan-physical-height-dimension = <31>;
		qcom,mdss-dsi-reset-sequence = <1 10>, <0 1>, <1 10>;
		qcom,mdss-dsi-tx-eot-append;
		qcom,cont-splash-enabled;
		qcom,mdss-backlight-disabled;
		qcom,mdss-dsi-dcs-idle-enable;
		qcom,mdss-dsi-panel-idle-on-command = [15 01 00 00 00 00 02 FF 24
		15 01 00 00 00 00 02 D2 CE
		15 01 00 00 00 00 02 D3 CE
		15 01 00 00 00 00 02 D5 03
		15 01 00 00 00 00 02 D8 C3
		15 01 00 00 00 00 02 FF 10];
		qcom,mdss-dsi-panel-idle-on-command-state = "dsi_hs_mode";
		qcom,mdss-dsi-panel-idle-off-command = [15 01 00 00 00 00 02 FF 24
		15 01 00 00 00 00 02 D2 E6
		15 01 00 00 00 00 02 D3 E6
		15 01 00 00 00 00 02 D5 01
		15 01 00 00 00 00 02 D8 43
		15 01 00 00 00 00 02 FF 10];
		qcom,mdss-dsi-panel-idle-off-command-state = "dsi_hs_mode";
		qcom,even-line-align;
		qcom,ulps-enabled;
		qcom,esd-check-enabled;
		qcom,mdss-dsi-panel-status-command = [14 01 00 01 01 00 01 0A];
		qcom,mdss-dsi-panel-status-command-state = "dsi_hs_mode";
		qcom,mdss-dsi-panel-status-check-mode = "reg_read";
		qcom,mdss-dsi-panel-status-values = [9C DC];
	};
};
