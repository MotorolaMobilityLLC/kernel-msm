/* Copyright (c) 2016, Motorola Mobility LLC. All rights reserved.
 *
 * This program is free software; you can redistribute it and/or modify
 * it under the terms of the GNU General Public License version 2 and
 * only version 2 as published by the Free Software Foundation.
 *
 * This program is distributed in the hope that it will be useful,
 * but WITHOUT ANY WARRANTY; without even the implied warranty of
 * MERCHANTABILITY or FITNESS FOR A PARTICULAR PURPOSE.  See the
 * GNU General Public License for more details.
 */

&mdss_mdp {
	mot_tianma_499_720p_vid_v0: qcom,mdss_dsi_mot_tianma_499_720p_video_v0 {
		#include "dsi-panel-mot-tianma-499-720p-video-common.dtsi"
	};

	mot_tianma_499_720p_vid_v1: qcom,mdss_dsi_mot_tianma_499_720p_video_v1 {
		#include "dsi-panel-mot-tianma-499-720p-video-common.dtsi"
	};

	mot_tianma_499_720p_vid_v2: qcom,mdss_dsi_mot_tianma_499_720p_video_v2 {
		#include "dsi-panel-mot-tianma-499-720p-video-common.dtsi"
	};
};

&mot_tianma_499_720p_vid_v0 {
	/delete-property/ qcom,mdss-dsi-on-command;
	qcom,mdss-dsi-on-command = [
	39 00 00 00 00 00 04 FF 98 81 03
	15 00 00 00 00 00 02 01 00
	15 00 00 00 00 00 02 02 00
	15 00 00 00 00 00 02 03 73
	15 00 00 00 00 00 02 04 D3
	15 00 00 00 00 00 02 05 00
	15 00 00 00 00 00 02 06 0A
	15 00 00 00 00 00 02 07 0E
	15 00 00 00 00 00 02 08 00
	15 00 00 00 00 00 02 09 01
	15 00 00 00 00 00 02 0a 01
	15 00 00 00 00 00 02 0b 01
	15 00 00 00 00 00 02 0c 01
	15 00 00 00 00 00 02 0d 01
	15 00 00 00 00 00 02 0e 01
	15 00 00 00 00 00 02 0f 15
	15 00 00 00 00 00 02 10 15
	15 00 00 00 00 00 02 11 00
	15 00 00 00 00 00 02 12 00
	15 00 00 00 00 00 02 13 00
	15 00 00 00 00 00 02 14 00
	15 00 00 00 00 00 02 15 00
	15 00 00 00 00 00 02 16 00
	15 00 00 00 00 00 02 17 00
	15 00 00 00 00 00 02 18 00
	15 00 00 00 00 00 02 19 00
	15 00 00 00 00 00 02 1a 00
	15 00 00 00 00 00 02 1b 00
	15 00 00 00 00 00 02 1c 00
	15 00 00 00 00 00 02 1d 00
	15 00 00 00 00 00 02 1e 40
	15 00 00 00 00 00 02 1f 80
	15 00 00 00 00 00 02 20 06
	15 00 00 00 00 00 02 21 01
	15 00 00 00 00 00 02 22 00
	15 00 00 00 00 00 02 23 00
	15 00 00 00 00 00 02 24 00
	15 00 00 00 00 00 02 25 00
	15 00 00 00 00 00 02 26 00
	15 00 00 00 00 00 02 27 00
	15 00 00 00 00 00 02 28 33
	15 00 00 00 00 00 02 29 03
	15 00 00 00 00 00 02 2a 00
	15 00 00 00 00 00 02 2b 00
	15 00 00 00 00 00 02 2c 00
	15 00 00 00 00 00 02 2d 00
	15 00 00 00 00 00 02 2e 00
	15 00 00 00 00 00 02 2f 00
	15 00 00 00 00 00 02 30 00
	15 00 00 00 00 00 02 31 00
	15 00 00 00 00 00 02 32 00
	15 00 00 00 00 00 02 33 00
	15 00 00 00 00 00 02 34 03
	15 00 00 00 00 00 02 35 00
	15 00 00 00 00 00 02 36 03
	15 00 00 00 00 00 02 37 00
	15 00 00 00 00 00 02 38 00
	15 00 00 00 00 00 02 39 00
	15 00 00 00 00 00 02 3a 40
	15 00 00 00 00 00 02 3b 40
	15 00 00 00 00 00 02 3c 00
	15 00 00 00 00 00 02 3d 00
	15 00 00 00 00 00 02 3e 00
	15 00 00 00 00 00 02 3f 00
	15 00 00 00 00 00 02 40 00
	15 00 00 00 00 00 02 41 00
	15 00 00 00 00 00 02 42 00
	15 00 00 00 00 00 02 43 00
	15 00 00 00 00 00 02 44 00
	15 00 00 00 00 00 02 50 01
	15 00 00 00 00 00 02 51 23
	15 00 00 00 00 00 02 52 45
	15 00 00 00 00 00 02 53 67
	15 00 00 00 00 00 02 54 89
	15 00 00 00 00 00 02 55 ab
	15 00 00 00 00 00 02 56 01
	15 00 00 00 00 00 02 57 23
	15 00 00 00 00 00 02 58 45
	15 00 00 00 00 00 02 59 67
	15 00 00 00 00 00 02 5a 89
	15 00 00 00 00 00 02 5b ab
	15 00 00 00 00 00 02 5c cd
	15 00 00 00 00 00 02 5d ef
	15 00 00 00 00 00 02 5e 11
	15 00 00 00 00 00 02 5f 0D
	15 00 00 00 00 00 02 60 0C
	15 00 00 00 00 00 02 61 0F
	15 00 00 00 00 00 02 62 0E
	15 00 00 00 00 00 02 63 06
	15 00 00 00 00 00 02 64 07
	15 00 00 00 00 00 02 65 02
	15 00 00 00 00 00 02 66 02
	15 00 00 00 00 00 02 67 02
	15 00 00 00 00 00 02 68 02
	15 00 00 00 00 00 02 69 02
	15 00 00 00 00 00 02 6a 02
	15 00 00 00 00 00 02 6b 02
	15 00 00 00 00 00 02 6c 02
	15 00 00 00 00 00 02 6d 02
	15 00 00 00 00 00 02 6e 02
	15 00 00 00 00 00 02 6f 02
	15 00 00 00 00 00 02 70 02
	15 00 00 00 00 00 02 71 02
	15 00 00 00 00 00 02 72 08
	15 00 00 00 00 00 02 73 00
	15 00 00 00 00 00 02 74 01
	15 00 00 00 00 00 02 75 0D
	15 00 00 00 00 00 02 76 0C
	15 00 00 00 00 00 02 77 0F
	15 00 00 00 00 00 02 78 0E
	15 00 00 00 00 00 02 79 06
	15 00 00 00 00 00 02 7a 07
	15 00 00 00 00 00 02 7b 02
	15 00 00 00 00 00 02 7c 02
	15 00 00 00 00 00 02 7d 02
	15 00 00 00 00 00 02 7e 02
	15 00 00 00 00 00 02 7f 02
	15 00 00 00 00 00 02 80 02
	15 00 00 00 00 00 02 81 02
	15 00 00 00 00 00 02 82 02
	15 00 00 00 00 00 02 83 02
	15 00 00 00 00 00 02 84 02
	15 00 00 00 00 00 02 85 02
	15 00 00 00 00 00 02 86 02
	15 00 00 00 00 00 02 87 02
	15 00 00 00 00 00 02 88 08
	15 00 00 00 00 00 02 89 00
	15 00 00 00 00 00 02 8A 01

	39 00 00 00 00 00 04 FF 98 81 04
	15 00 00 00 00 00 02 6C 15
	15 00 00 00 00 00 02 6E 3B
	15 00 00 00 00 00 02 6F 37
	15 00 00 00 00 00 02 8D 14
	15 00 00 00 00 00 02 3A A4
	15 00 00 00 00 00 02 87 BA
	15 00 00 00 00 00 02 26 76
	15 00 00 00 00 00 02 B2 D1
	15 00 00 00 00 00 02 B5 06
	15 00 00 00 00 00 02 31 75

	39 00 00 00 00 00 04 FF 98 81 01
	15 00 00 00 00 00 02 22 09
	15 00 00 00 00 00 02 31 00
	15 00 00 00 00 00 02 34 01
	15 00 00 00 00 00 02 50 8D
	15 00 00 00 00 00 02 51 98
	15 00 00 00 00 00 02 53 6F
	15 00 00 00 00 00 02 55 7A
	15 00 00 00 00 00 02 60 1F
	15 00 00 00 00 00 02 A0 1D
	15 00 00 00 00 00 02 A1 30
	15 00 00 00 00 00 02 A2 3C
	15 00 00 00 00 00 02 A3 13
	15 00 00 00 00 00 02 A4 15
	15 00 00 00 00 00 02 A5 28
	15 00 00 00 00 00 02 A6 1B
	15 00 00 00 00 00 02 A7 1E
	15 00 00 00 00 00 02 A8 A1
	15 00 00 00 00 00 02 A9 1B
	15 00 00 00 00 00 02 AA 29
	15 00 00 00 00 00 02 AB 8A
	15 00 00 00 00 00 02 AC 1E
	15 00 00 00 00 00 02 AD 1F
	15 00 00 00 00 00 02 AE 53
	15 00 00 00 00 00 02 AF 27
	15 00 00 00 00 00 02 B0 2C
	15 00 00 00 00 00 02 B1 4C
	15 00 00 00 00 00 02 B2 56
	15 00 00 00 00 00 02 B3 1D

	15 00 00 00 00 00 02 C0 1D
	15 00 00 00 00 00 02 C1 30
	15 00 00 00 00 00 02 C2 3C
	15 00 00 00 00 00 02 C3 13
	15 00 00 00 00 00 02 C4 15
	15 00 00 00 00 00 02 C5 28
	15 00 00 00 00 00 02 C6 1B
	15 00 00 00 00 00 02 C7 1E
	15 00 00 00 00 00 02 C8 A1
	15 00 00 00 00 00 02 C9 1B
	15 00 00 00 00 00 02 CA 29
	15 00 00 00 00 00 02 CB 8A
	15 00 00 00 00 00 02 CC 1E
	15 00 00 00 00 00 02 CD 1F
	15 00 00 00 00 00 02 CE 53
	15 00 00 00 00 00 02 CF 27
	15 00 00 00 00 00 02 D0 2C
	15 00 00 00 00 00 02 D1 4C
	15 00 00 00 00 00 02 D2 56
	15 00 00 00 00 00 02 D3 1D

	39 00 00 00 00 00 04 FF 98 81 02
	15 00 00 00 00 00 02 06 40
	15 00 00 00 00 00 02 07 02

	39 00 00 00 00 00 04 FF 98 81 00
	39 00 00 00 00 00 03 51 0C F4
	15 00 00 00 00 00 02 53 2C
	15 00 00 00 00 00 02 55 01
	15 00 00 00 00 00 02 68 06
	05 01 00 00 78 00 01 11
	05 01 00 00 14 00 01 29];		/* Display on */
};

&mot_tianma_499_720p_vid_v1 {
	/delete-property/ qcom,mdss-dsi-on-command;
	qcom,mdss-dsi-on-command = [
	39 00 00 00 00 00 04 FF 98 81 02
	15 00 00 00 00 00 02 06 40
	15 00 00 00 00 00 02 07 02

	39 00 00 00 00 00 04 FF 98 81 00
	39 00 00 00 00 00 03 51 0C F4
	15 00 00 00 00 00 02 53 2C
	15 00 00 00 00 00 02 55 01
	15 00 00 00 00 00 02 68 06
	05 01 00 00 78 00 01 11
	05 01 00 00 14 00 01 29];		/* Display on */
};
