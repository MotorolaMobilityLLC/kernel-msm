
qcom,jt40-atl-pm660  {
	serialnum = "SB18C20873";
	qcom, = <24>;
	/* #3123721_Lenovo_JT40atl_3010mAh_averaged_MasterSlave_Oct9th2017*/
	qcom,max-voltage-uv = <4400000>;
	qcom,fg-cc-cv-threshold-mv = <4390>;
	qcom,nom-batt-capacity-mah = <3010>;
	qcom,batt-id-kohm = <237>;
	qcom,battery-beta = <3435>;
	qcom,battery-type = "JT40-ATL-3000mah";
	qcom,checksum = <0x32EB>;
	qcom,gui-version = "PM660GUI - 0.0.0.44";
	qcom,fg-profile-data = [
		 6A 1F BB 05
		 69 0A 56 06
		 93 1D E9 06
		 B6 12 C1 1D
		 D9 18 CF 22
		 B3 45 8E 52
		 55 00 00 00
		 10 00 00 00
		 00 00 5E BC
		 64 C4 06 BB
		 1F 00 08 00
		 05 E2 8E ED
		 AF FD 37 EB
		 C0 01 9E 12
		 DB FD D2 2B
		 19 06 09 20
		 27 00 14 00
		 C3 1F 8A 05
		 83 0A 8B FC
		 6C 1D 5D E2
		 10 0B CE 14
		 58 19 B6 22
		 AF 45 AB 52
		 54 00 00 00
		 0E 00 00 00
		 00 00 D1 CC
		 27 B2 F9 B2
		 1B 00 00 00
		 E4 EB 8E ED
		 FB FD 55 00
		 5B DA AD 03
		 A3 E4 BD 12
		 99 33 CC FF
		 07 10 00 00
		 B1 0C 66 46
		 1B 00 40 00
		 56 01 0A FA
		 FF 00 00 00
		 00 00 00 00
		 00 00 00 00
		 00 00 00 00
		 00 00 00 00
		 00 00 00 00
		 00 00 00 00
		 00 00 00 00
		 00 00 00 00
		 00 00 00 00
		 00 00 00 00
		 00 00 00 00
		 00 00 00 00
		 00 00 00 00
		 00 00 00 00
		 00 00 00 00
		 00 00 00 00
		 00 00 00 00
		 00 00 00 00
	];
};
