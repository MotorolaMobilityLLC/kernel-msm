
qcom,bl270_lg64 {
	/* #2451137_Lenovo_BL270_4000mAh_averaged_MasterSlave_Jun20th2016*/
	qcom,max-voltage-uv = <4400000>;
	qcom,nom-batt-capacity-mah = <4000>;
	qcom,batt-id-kohm = <64>;
	qcom,battery-beta = <3380>;
	qcom,battery-type = "bl270_lg64_4000mah";
	qcom,chg-rslow-comp-c1 = <2802707>;
	qcom,chg-rslow-comp-c2 = <2940468>;
	qcom,chg-rs-to-rslow = <836216>;
	qcom,chg-rslow-comp-thr = <0x99>;
	qcom,checksum = <0x2E47>;
	qcom,gui-version = "PMI8950GUI - 2.0.0.16";
	qcom,fg-profile-data = [
		 EF 83 4B 7D
		 5B 81 A3 77
		 54 83 B6 58
		 4F 80 9E 87
		 19 82 97 9A
		 D7 BD 12 CB
		 5B 0E 19 88
		 63 7F DF 82
		 3B 7D 48 83
		 90 72 D0 77
		 C5 5B 70 82
		 62 98 85 B6
		 53 C2 60 0D
		 2A 10 50 5A
		 14 70 EE FC
		 81 3E 74 3D
		 5F 38 00 00
		 3C 46 3C 39
		 CF 30 00 00
		 00 00 00 00
		 00 00 00 00
		 86 6A FF 68
		 1D 71 E6 83
		 14 74 77 62
		 81 59 79 7B
		 02 6F 1F 61
		 74 7E 7C 81
		 1A 5D 61 B8
		 5E A0 71 0C
		 28 00 FF 36
		 F0 11 30 03
		 00 00 00 0C
	];
};
