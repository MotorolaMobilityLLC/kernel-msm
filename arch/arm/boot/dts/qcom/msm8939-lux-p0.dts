/* Copyright (c) 2014, Motorola Mobility LLC. All rights reserved.
*
* This program is free software; you can redistribute it and/or modify
* it under the terms of the GNU General Public License version 2 and
* only version 2 as published by the Free Software Foundation.
*
* This program is distributed in the hope that it will be useful,
* but WITHOUT ANY WARRANTY; without even the implied warranty of
* MERCHANTABILITY or FITNESS FOR A PARTICULAR PURPOSE.  See the
* GNU General Public License for more details.
*/

/dts-v1/;

#include "msm8939-lux.dtsi"

/ {
	qcom,board-id = <0x47 0x8000>;
};

&i2c_5 {
	lp8556@2c {
		status = "ok";
		compatible = "ti,lp8556";
		reg = <0x2c>;
		bl-name = "lcd-backlight";
		dev-ctrl = /bits/ 8 <0x85>;
		init-brt = /bits/ 8 <0xff>;
		pinctrl-names = "default";
		pinctrl-0 = <&backlight_reset_default>;
	};
};
