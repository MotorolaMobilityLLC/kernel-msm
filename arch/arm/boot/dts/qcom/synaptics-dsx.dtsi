/* Copyright (C) 2014 Synaptics Incorporated
 *
 * Copyright (C) 2014 Alexandra Chin <alexandra.chin@tw.synaptics.com>
 * Copyright (C) 2014 Scott Lin <scott.lin@tw.synaptics.com>
 *
 * This program is free software; you can redistribute it and/or modify
 * it under the terms of the GNU General Public License as published by
 * the Free Software Foundation; either version 2 of the License, or
 * (at your option) any later version.
 *
 * This program is distributed in the hope that it will be useful,
 * but WITHOUT ANY WARRANTY; without even the implied warranty of
 * MERCHANTABILITY or FITNESS FOR A PARTICULAR PURPOSE. See the
 * GNU General Public License for more details.
 */

&soc {
	i2c@f9927000 {
		status = "ok";
		#address-cells = <1>;
		#size-cells = <0>;
		synaptics_dsx@20 {
			compatible = "synaptics,dsx";
			reg = <0x20>;
			interrupt-parent = <&msmgpio>;
			interrupts = <17 0x2008>;
			vdd_ana-supply = <&pm8226_l19>;
			vcc_i2c-supply = <&pm8226_lvs1>;
			synaptics,pwr-reg-name = "vdd_ana";
			synaptics,bus-reg-name = "vcc_i2c";
			synaptics,reset-gpio = <&msmgpio 16 0x00>;
			synaptics,irq-gpio = <&msmgpio 17 0x2008>;
			synaptics,irq-on-state = <0>;
			synaptics,irq-flags = <0x2002>; /* IRQF_ONESHOT | IRQF_TRIGGER_FALLING */
			synaptics,power-delay-ms = <160>;
			synaptics,reset-on-state = <0>;
			synaptics,reset-active-ms = <10>;
			synaptics,reset-delay-ms = <200>;
			//synaptics,max-y-for-2d = <800>; /* remove if no virtual buttons */
			synaptics,vir-button-codes = <102 100 900 100 60 158 300 900 100 60>;
		};
	};
};
