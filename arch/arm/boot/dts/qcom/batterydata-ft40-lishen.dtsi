/* Copyright (c) 2013-2015, The Linux Foundation. All rights reserved.
 *
 * This program is free software; you can redistribute it and/or modify
 * it under the terms of the GNU General Public License version 2 and
 * only version 2 as published by the Free Software Foundation.
 *
 * This program is distributed in the hope that it will be useful,
 * but WITHOUT ANY WARRANTY; without even the implied warranty of
 * MERCHANTABILITY or FITNESS FOR A PARTICULAR PURPOSE.  See the
 * GNU General Public License for more details.
 */

maxim,ft40-lishen-batterydata {
	/* Required properties */
	serialnum	= "SNN5957";

	/* Table from Maxim for FT40 Lishen 2456 mAhr Battery */
	config		= /bits/ 16 <0x0254>;
	full_soc_thresh	= /bits/ 16 <0x5f00>;	/* app note constant */
	design_cap	= /bits/ 16 <4912>;	/* mAh times 2 */
	ichgt_term	= /bits/ 16 <0x0280>;	/* battery attribute */
	learn_cfg	= /bits/ 16 <0x2606>;	/* app note constant */
	filter_cfg	= /bits/ 16 <0x87A4>;	/* app note constant */
	relax_cfg	= /bits/ 16 <0x203B>;
	fullcap		= /bits/ 16 <4912>;	/* mAh times 2 */
	fullcapnom	= /bits/ 16 <4912>;	/* mAh times 2 */
	qrtbl00		= /bits/ 16 <0x6580>;	/* battery attribute */
	qrtbl10		= /bits/ 16 <0x2c80>;	/* battery attribute */
	qrtbl20		= /bits/ 16 <0x0f80>;	/* battery attribute */
	qrtbl30		= /bits/ 16 <0x0b00>;	/* battery attribute */
	rcomp0 		= /bits/ 16 <0x003f>;	/* battery attribute */
	tcompc0		= /bits/ 16 <0x1a3d>;	/* battery attribute */
	maxim,cell-char-tbl = /bits/ 16 <	/* battery attribute */
		0x9430 0xb340 0xb790 0xba00 0xbb50 0xbbd0
		0xbda0 0xbea0 0xc000 0xc320 0xc4d0 0xc760
		0xc9d0 0xcce0 0xd160 0xd720 0x0090 0x0600
		0x0d40 0x11a0 0x1910 0x1700 0x1b00 0x12e0
		0x09b0 0x0ce0 0x06e0 0x08e0 0x0790 0x07f0
		0x06e0 0x06e0 0x0200 0x0200 0x0200 0x0200
		0x0200 0x0200 0x0200 0x0200 0x0200 0x0200
		0x0200 0x0200 0x0200 0x0200 0x0200 0x0200
	>;
	/* Optional properties */
	tgain		= /bits/ 16 <0xE71C>;	/* thermistor attribute */
	toff		= /bits/ 16 <0x251A>;	/* thermistor attribute */
	cgain		= /bits/ 16 <0x4000>;	/* current sense attribute */
	misc_cfg	= /bits/ 16 <0x0170>;
	rev		= /bits/ 16 <0x0002>;
};
