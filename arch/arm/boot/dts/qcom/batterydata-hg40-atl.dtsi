
qcom,hg40-atl {
	serialnum = "SNN5976";
	/* #2513596_Lenovo_HG40_3000mAh_averaged_MasterSlave_Aug2nd2016*/
	qcom,max-voltage-uv = <4400000>;
	qcom,nom-batt-capacity-mah = <3000>;
	qcom,batt-id-kohm = <0>;
	qcom,battery-beta = <0>;
	qcom,battery-type = "HG40-ATL-3000mah";
	qcom,chg-rslow-comp-c1 = <3073614>;
	qcom,chg-rslow-comp-c2 = <3981400>;
	qcom,chg-rs-to-rslow = <1280731>;
	qcom,chg-rslow-comp-thr = <0x9D>;
	qcom,checksum = <0xB426>;
	qcom,gui-version = "PMI8950GUI - 2.0.0.16";
	qcom,fg-profile-data = [
		 E0 83 C3 7C
		 0F 81 36 77
		 65 83 4C 74
		 5C 89 67 94
		 3A 82 6D 99
		 54 BC AA C8
		 56 10 02 88
		 A7 7D A8 81
		 1F 7C 54 83
		 34 6A B6 78
		 21 86 4E 82
		 B5 99 08 BD
		 07 CA 59 0D
		 DE 0B 7F 59
		 14 70 B2 FD
		 E0 35 52 3E
		 FD 16 00 00
		 17 46 56 23
		 5F 28 00 00
		 00 00 00 00
		 00 00 00 00
		 EC 70 41 70
		 31 71 E9 83
		 EF 6E 25 5A
		 34 5A 39 7A
		 A8 6E 4D 5B
		 28 7F 6B 96
		 17 A1 62 44
		 64 A0 71 0C
		 28 00 FF 36
		 F0 11 30 03
		 00 00 00 0C
	];
};
