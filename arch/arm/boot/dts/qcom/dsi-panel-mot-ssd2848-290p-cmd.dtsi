/* Copyright (c) 2013, The Linux Foundation. All rights reserved.
 *
 * This program is free software; you can redistribute it and/or modify
 * it under the terms of the GNU General Public License version 2 and
 * only version 2 as published by the Free Software Foundation.
 *
 * This program is distributed in the hope that it will be useful,
 * but WITHOUT ANY WARRANTY; without even the implied warranty of
 * MERCHANTABILITY or FITNESS FOR A PARTICULAR PURPOSE.  See the
 * GNU General Public License for more details.
 */

/*---------------------------------------------------------------------------
 * This file is autogenerated file using gcdb parser. Please do not edit it.
 * Update input XML file to add a new entry or update variable in this file
 * VERSION = "1.0"
 *---------------------------------------------------------------------------*/
&mdss_mdp {
	dsi_mot_ssd2848_290p_cmd: qcom,mdss_dsi_mot_ssd2848_290p_cmd {
		qcom,mdss-dsi-panel-name = "mot 290p command mode dsi panel";
		qcom,mdss-dsi-panel-controller = <&mdss_dsi0>;
		qcom,mdss-dsi-panel-type = "dsi_cmd_mode";
		qcom,mdss-dsi-panel-destination = "display_1";
		qcom,mdss-dsi-panel-framerate = <60>;
		qcom,mdss-dsi-virtual-channel-id = <0>;
		qcom,mdss-dsi-stream = <0>;
		qcom,mdss-dsi-panel-width = <320>;
		qcom,mdss-dsi-panel-height = <290>;
		qcom,mdss-dsi-h-front-porch = <0>;
		qcom,mdss-dsi-h-back-porch = <0>;
		qcom,mdss-dsi-h-pulse-width = <0>;
		qcom,mdss-dsi-h-sync-skew = <0>;
		qcom,mdss-dsi-v-back-porch = <1>;
		qcom,mdss-dsi-v-front-porch = <1>;
		qcom,mdss-dsi-v-pulse-width = <1>;
		qcom,mdss-dsi-h-left-border = <0>;
		qcom,mdss-dsi-h-right-border = <0>;
		qcom,mdss-dsi-v-top-border = <0>;
		qcom,mdss-dsi-v-bottom-border = <0>;
		qcom,mdss-dsi-bpp = <24>;
		qcom,mdss-dsi-underflow-color = <0xff>;
		qcom,mdss-dsi-border-color = <0>;
		qcom,mdss-dsi-init-command = [23 01 00 00 00 00 02 FF 00
		29 01 00 00 00 00 06 00 08 01 F4 05 32
		29 01 00 00 00 00 06 00 0C 00 00 00 0B
		29 01 00 00 00 00 06 00 14 0C 07 80 0F
		05 01 00 00 01 00 01 11
		29 01 00 00 00 00 06 10 08 01 20 01 45
		29 01 00 00 00 00 06 20 0C 00 00 00 02
		29 01 00 00 00 00 06 20 10 00 F7 00 6C
		29 01 00 00 00 00 06 20 14 01 88 00 34
		29 01 00 00 00 00 06 20 18 01 4E 00 0C
		29 01 00 00 00 00 06 20 20 01 40 01 40
		29 01 00 00 00 00 06 20 24 01 40 01 40
		29 01 00 00 00 00 06 20 30 00 00 00 15
		29 01 00 00 00 00 06 20 34 00 00 00 00
		29 01 00 00 00 00 06 20 38 01 3F 01 3F
		29 01 00 00 00 00 06 20 3C 01 40 01 40
		29 01 00 00 00 00 06 20 A0 00 00 05 00
		39 01 00 00 00 00 05 2A 00 00 01 3F
		39 01 00 00 00 00 05 2B 00 00 01 3F
		29 01 00 00 00 00 06 60 08 00 04 00 0A
		29 01 00 00 00 00 06 60 0C 0C 34 02 0A
		29 01 00 00 00 00 06 60 10 01 40 02 14
		29 01 00 00 00 00 06 60 14 01 00 01 4E
		29 01 00 00 00 00 06 60 40 13 01 0A 01
		29 01 00 00 00 00 06 60 44 05 05 04 0A
		29 01 00 00 00 00 06 60 84 00 00 01 40
		23 01 00 00 00 00 02 FF 01
		39 01 00 00 00 00 03 F0 54 47
		15 01 00 00 00 00 02 A0 00
		39 01 00 00 00 00 04 BD 00 11 31
		15 01 00 00 00 00 02 E9 46
		15 01 00 00 00 00 02 B1 12
		15 01 00 00 00 00 02 E2 F5
		39 01 00 00 00 00 05 BA 06 15 2B 01
		39 01 00 00 00 00 06 B3 02 0A 14 2A 2A
		39 01 00 00 00 00 05 B5 78 78 76 F6
		39 01 00 00 00 00 12 C0 00 06 17 11 16 25 0E 0C 0C 0E 0C 2F 07 0A 3F 3F 3F
		39 01 00 00 00 00 12 C1 00 06 17 11 16 25 0E 0C 0C 0E 0C 2F 07 0A 3F 3F 3F
		39 01 00 00 00 00 12 C2 00 06 17 11 16 25 0E 0C 0C 0E 0C 2F 07 0A 3F 3F 3F
		39 01 00 00 00 00 12 C3 00 06 17 11 16 25 0E 0C 0C 0E 0C 2F 07 0A 3F 3F 3F
		39 01 00 00 00 00 12 C4 00 06 17 11 16 25 0E 0C 0C 0E 0C 2F 07 0A 3F 3F 3F
		39 01 00 00 00 00 12 C5 00 06 17 11 16 25 0E 0C 0C 0E 0C 2F 07 0A 3F 3F 3F
		15 01 00 00 00 00 02 A0 80
		39 01 00 00 00 00 03 F0 00 00
		05 01 00 00 78 00 01 11
		05 01 00 00 00 00 01 29
		23 01 00 00 00 00 02 FF 00];
		qcom,mdss-dsi-on-command = [23 01 00 00 00 00 02 FF 00
		05 01 00 00 00 00 01 29];
		qcom,mdss-dsi-off-command = [23 01 00 00 00 00 02 FF 01
		05 01 00 00 00 00 01 28
		05 01 00 00 00 00 01 10
		23 01 00 00 00 00 02 FF 00
		05 01 00 00 32 00 01 28
		05 01 00 00 14 00 01 10
		29 01 00 00 05 00 06 10 28 00 00 00 01];
		qcom,mdss-dsi-on-command-state = "dsi_lp_mode";
		qcom,mdss-dsi-off-command-state = "dsi_hs_mode";
		qcom,mdss-dsi-h-sync-pulse = <0>;
		qcom,mdss-dsi-traffic-mode = "burst_mode";
		qcom,mdss-dsi-bllp-eof-power-mode;
		qcom,mdss-dsi-bllp-power-mode;
		qcom,mdss-dsi-lane-0-state;
		qcom,mdss-dsi-te-pin-select = <1>;
		qcom,mdss-dsi-te-dcs-command = <1>;
		qcom,mdss-dsi-te-check-enable;
		qcom,mdss-dsi-te-using-te-pin;
		qcom,mdss-dsi-panel-timings = [2D 0C 04 00 24 28 08 10 07 03 04 00];
		qcom,mdss-dsi-t-clk-post = <0x05>;
		qcom,mdss-dsi-t-clk-pre = <0x0E>;
		qcom,mdss-dsi-dma-trigger = "trigger_sw";
		qcom,mdss-dsi-mdp-trigger = "none";
		qcom,mdss-pan-physical-width-dimension = <40>;
		qcom,mdss-pan-physical-height-dimension = <36>;
		qcom,mdss-dsi-reset-sequence = <0 25>, <1 1>;
		qcom,mdss-dsi-tx-eot-append;
		qcom,mdss-brightness-max-level = <0>; /* disable mdss back light device */
	};
};
