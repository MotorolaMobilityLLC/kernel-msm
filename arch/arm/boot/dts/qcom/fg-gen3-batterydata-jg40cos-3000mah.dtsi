/* Copyright (c) 2016-2017, The Linux Foundation. All rights reserved.
 *
 * This program is free software; you can redistribute it and/or modify
 * it under the terms of the GNU General Public License version 2 and
 * only version 2 as published by the Free Software Foundation.
 *
 * This program is distributed in the hope that it will be useful,
 * but WITHOUT ANY WARRANTY; without even the implied warranty of
 * MERCHANTABILITY or FITNESS FOR A PARTICULAR PURPOSE.  See the
 * GNU General Public License for more details.
 */

qcom,jg40cos_3000mah {
	serialnum = "SB18C36892";
	qcom, = <24>;
	/* Moto_Lake_JG40cos_3000mAh_averaged_MasterSlave_Aug31st2018*/
	qcom,max-voltage-uv = <4400000>;
	qcom,fg-cc-cv-threshold-mv = <4390>;
	qcom,nom-batt-capacity-mah = <3000>;
	qcom,batt-id-kohm = <0>;
	qcom,battery-beta = <3435>;
	qcom,battery-type = "moto_lake_jg40cos_3000mah_averaged_masterslave_aug31st2018";
	qcom,checksum = <0xA2F4>;
	qcom,gui-version = "PM660GUI - 0.0.0.45";
	qcom,fg-profile-data = [
		 6D 1F C7 05
		 54 0A 7A 06
		 DF 1C E5 01
		 E6 0D 6B 0A
		 54 17 14 2A
		 14 44 88 5A
		 77 00 00 00
		 10 00 00 00
		 00 00 FF 07
		 DD CD 89 C2
		 30 00 08 00
		 C9 D2 9B E5
		 EE 04 0C 02
		 A4 15 37 FD
		 1E D5 EB 23
		 37 06 09 20
		 27 00 14 00
		 9B 20 93 04
		 38 0B 9E 05
		 CD 1C BE 02
		 8F 0C 9B 0B
		 77 18 6D 23
		 B9 44 2D 5A
		 76 00 00 00
		 10 00 00 00
		 00 00 DC D5
		 EB C3 13 C2
		 21 00 00 00
		 0D EA 9B E5
		 05 FC 29 01
		 2F FD D1 FA
		 07 02 12 2A
		 CC 33 CC FF
		 07 10 00 00
		 DB 0B 66 46
		 21 00 40 00
		 4D 01 0A FA
		 FF 00 00 00
		 00 00 00 00
		 00 00 00 00
		 00 00 00 00
		 00 00 00 00
		 00 00 00 00
		 00 00 00 00
		 00 00 00 00
		 00 00 00 00
		 00 00 00 00
		 00 00 00 00
		 00 00 00 00
		 00 00 00 00
		 00 00 00 00
		 00 00 00 00
		 00 00 00 00
		 00 00 00 00
		 00 00 00 00
		 00 00 00 00
	];
};
