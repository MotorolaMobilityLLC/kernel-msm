/* Copyright (c) 2014-2015, Motorla Mobility LLC. All rights reserved.
 *
 * This program is free software; you can redistribute it and/or modify
 * it under the terms of the GNU General Public License version 2 and
 * only version 2 as published by the Free Software Foundation.
 *
 * This program is distributed in the hope that it will be useful,
 * but WITHOUT ANY WARRANTY; without even the implied warranty of
 * MERCHANTABILITY or FITNESS FOR A PARTICULAR PURPOSE.  See the
 * GNU General Public License for more details.
 */

/* RAM OOPS */
/memreserve/ 0xaf000000 0x80000;

#include "msm8994-v2.0.dtsi"
#include "msm8994-moto-common.dtsi"

/* There should be no changes to this file unless a v3 shows up. Make your
 * changes in moto-common instead.
 */

