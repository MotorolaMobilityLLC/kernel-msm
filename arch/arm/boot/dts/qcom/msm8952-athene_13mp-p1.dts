/* Copyright (c) 2015, Motorola Mobility Inc. All rights reserved.
 *
 * This program is free software; you can redistribute it and/or modify
 * it under the terms of the GNU General Public License version 2 and
 * only version 2 as published by the Free Software Foundation.
 *
 * This program is distributed in the hope that it will be useful,
 * but WITHOUT ANY WARRANTY; without even the implied warranty of
 * MERCHANTABILITY or FITNESS FOR A PARTICULAR PURPOSE.  See the
 * GNU General Public License for more details.
 */


/dts-v1/;

#include "msm8952-athene.dtsi"

/ {
	model = "Athene_13MP";
	qcom,board-id = <0x42 0x81a0>, <0x42 0x81ad>;
};

&cci {
	/* IMX214 EEPROM */
	eeprom2: qcom,eeprom@2 {
		cell-index = <2>;
		reg = <0x2>;
		qcom,eeprom-name = "mot_imx214";
		compatible = "qcom,eeprom";
		qcom,slave-addr = <0xA0>;
		qcom,cci-master = <0>;
		qcom,i2c-freq-mode = <1>;
		qcom,num-blocks = <8>;

		qcom,page0 = <0 0x00 1 0x00 1 0>;
		qcom,poll0 = <0 0x00 1 0x00 1 0>;
		qcom,saddr0 = <0xA0>;
		qcom,mem0 = <256 0x00 1 0x00 1 0>;

		qcom,page1 = <0 0x00 1 0x00 1 0>;
		qcom,poll1 = <0 0x00 1 0x00 1 0>;
		qcom,saddr1 = <0xA2>;
		qcom,mem1 = <256 0x00 1 0x00 1 0>;

		qcom,page2 = <0 0x00 1 0x00 1 0>;
		qcom,poll2 = <0 0x00 1 0x00 1 0>;
		qcom,saddr2 = <0xA4>;
		qcom,mem2 = <256 0x00 1 0x00 1 0>;

		qcom,page3 = <0 0x00 1 0x00 1 0>;
		qcom,poll3 = <0 0x00 1 0x00 1 0>;
		qcom,saddr3 = <0xA6>;
		qcom,mem3 = <256 0x00 1 0x00 1 0>;

		qcom,page4 = <0 0x00 1 0x00 1 0>;
		qcom,poll4 = <0 0x00 1 0x00 1 0>;
		qcom,saddr4 = <0xA8>;
		qcom,mem4 = <256 0x00 1 0x00 1 0>;

		qcom,page5 = <0 0x00 1 0x00 1 0>;
		qcom,poll5 = <0 0x00 1 0x00 1 0>;
		qcom,saddr5 = <0xAA>;
		qcom,mem5 = <256 0x00 1 0x00 1 0>;

		qcom,page6 = <0 0x00 1 0x00 1 0>;
		qcom,poll6 = <0 0x00 1 0x00 1 0>;
		qcom,saddr6 = <0xAC>;
		qcom,mem6 = <256 0x00 1 0x00 1 0>;

		qcom,page7 = <0 0x00 1 0x00 1 0>;
		qcom,poll7 = <0 0x00 1 0x00 1 0>;
		qcom,saddr7 = <0xAE>;
		qcom,mem7 = <256 0x00 1 0x00 1 0>;

		cam_vio-supply = <&pm8950_l10>;
		qcom,cam-vreg-name = "cam_vio";
		qcom,cam-vreg-min-voltage = <1800000> ;
		qcom,cam-vreg-max-voltage = <1800000>;
		qcom,cam-vreg-op-mode = <1800000>;
		qcom,gpio-no-mux = <0>;

		qcom,cam-power-seq-type = "sensor_vreg";
		qcom,cam-power-seq-val = "cam_vio";
		qcom,cam-power-seq-cfg-val = <1>;
		qcom,cam-power-seq-delay = <3>;

		status = "ok";
	};

	qcom,camera@0 {
		/delete-property/ qcom,eeprom-src;
		qcom,eeprom-src = <&eeprom2>;
	};
};
