/* Copyright (c) 2014, Motorola Mobility LLC. All rights reserved.
*
* This program is free software; you can redistribute it and/or modify
* it under the terms of the GNU General Public License version 2 and
* only version 2 as published by the Free Software Foundation.
*
* This program is distributed in the hope that it will be useful,
* but WITHOUT ANY WARRANTY; without even the implied warranty of
* MERCHANTABILITY or FITNESS FOR A PARTICULAR PURPOSE.  See the
* GNU General Public License for more details.
*/

/dts-v1/;

#include "msm8916-styx.dtsi"

/ {
	qcom,board-id = <0x45 0x82b0>;
};

&spi_0 {
	stml0xx@0 {
		headset_hw_version = <1>;
		headset_button_0-1_threshold = <0x0096>;
		headset_button_1-2_threshold = <0x012C>;
		headset_button_2-3_threshold = <0x01C2>;
		headset_button_3-upper_threshold = <0x02EE>;
	};
};
