/* Copyright (c) 2013-2014, The Linux Foundation. All rights reserved.
 *
 * This program is free software; you can redistribute it and/or modify
 * it under the terms of the GNU General Public License version 2 and
 * only version 2 as published by the Free Software Foundation.
 *
 * This program is distributed in the hope that it will be useful,
 * but WITHOUT ANY WARRANTY; without even the implied warranty of
 * MERCHANTABILITY or FITNESS FOR A PARTICULAR PURPOSE.  See the
 * GNU General Public License for more details.
 */

qcom,palladium-batterydata {
	qcom,fcc-mah = <380>;
	qcom,default-rbatt-mohm = <401>;
	qcom,rbatt-capacitive-mohm = <50>;
	qcom,flat-ocv-threshold-uv = <3800000>;
	qcom,max-voltage-uv = <4350000>;
	qcom,v-cutoff-uv = <3400000>;
	qcom,chg-term-ua = <20000>;
	qcom,batt-id-kohm = <75>;
	qcom,battery-type = "palladium_1500mah";

	qcom,fcc-temp-lut {
		qcom,lut-col-legend = <(-20) 0 25 40 60>;
		qcom,lut-data = <382 384 384 384 384>;
	};

	qcom,pc-temp-ocv-lut {
		qcom,lut-col-legend = <(-20) 0 25 40 60>;
		qcom,lut-row-legend = <100 95 90 85 80>,
				<75 70 65 60 55>,
				<50 45 40 35 30>,
				<25 20 16 13 11>,
				<10 9 8 7 6>,
				<5 4 3 2 1>,
				<0>;
		qcom,lut-data = <4339 4338 4333 4328 4322>,
				<4232 4256 4262 4260 4256>,
				<4160 4199 4206 4204 4201>,
				<4114 4148 4152 4151 4148>,
				<4070 4099 4103 4101 4098>,
				<3966 4058 4064 4056 4051>,
				<3924 3968 3995 4001 4006>,
				<3886 3930 3962 3966 3964>,
				<3854 3898 3920 3924 3924>,
				<3832 3865 3877 3879 3879>,
				<3814 3836 3846 3848 3847>,
				<3800 3812 3823 3824 3824>,
				<3786 3794 3804 3805 3804>,
				<3772 3782 3788 3788 3786>,
				<3760 3770 3774 3770 3764>,
				<3745 3756 3758 3748 3735>,
				<3729 3738 3737 3728 3714>,
				<3712 3725 3714 3704 3690>,
				<3696 3714 3697 3688 3675>,
				<3683 3706 3691 3683 3672>,
				<3676 3701 3690 3682 3670>,
				<3665 3696 3688 3680 3668>,
				<3653 3690 3684 3675 3662>,
				<3636 3680 3672 3660 3642>,
				<3612 3656 3642 3629 3610>,
				<3580 3616 3601 3590 3572>,
				<3534 3564 3554 3544 3527>,
				<3468 3498 3496 3486 3465>,
				<3373 3416 3418 3402 3380>,
				<3244 3293 3286 3264 3246>,
				<3000 3000 3000 3000 3000>;
	};

	qcom,rbatt-sf-lut {
		qcom,lut-col-legend = <(-20) 0 25 40 60>;
		qcom,lut-row-legend = <100 95 90 85 80>,
				<75 70 65 60 55>,
				<50 45 40 35 30>,
				<25 20 16 13 11>,
				<10 9 8 7 6>,
				<5 4 3 2 1>;
		qcom,lut-data = <941 342 100 67 52>,
				<941 342 100 67 52>,
				<984 340 102 69 53>,
				<999 336 104 71 54>,
				<1038 334 106 74 56>,
				<1024 340 113 78 59>,
				<1090 316 106 76 61>,
				<1135 318 110 80 63>,
				<1198 319 103 76 61>,
				<1264 315 96 68 54>,
				<1355 315 95 67 53>,
				<1473 316 96 68 55>,
				<1625 320 98 71 58>,
				<1826 332 100 73 60>,
				<2077 347 101 72 57>,
				<2414 367 102 68 53>,
				<2836 394 104 69 53>,
				<3208 425 105 69 52>,
				<3503 439 105 68 52>,
				<3304 393 103 68 53>,
				<3296 391 104 69 54>,
				<3543 401 106 71 55>,
				<3812 413 109 72 56>,
				<4157 423 110 72 54>,
				<4641 431 108 70 54>,
				<5205 471 111 72 58>,
				<5986 540 116 76 59>,
				<7114 630 123 78 59>,
				<8975 765 122 80 61>,
				<17029 1531 173 128 71>;
	};
};
