/* Copyright (c) 2016, Motorola Mobility Inc. All rights reserved.
 *
 * This program is free software; you can redistribute it and/or modify
 * it under the terms of the GNU General Public License version 2 and
 * only version 2 as published by the Free Software Foundation.
 *
 * This program is distributed in the hope that it will be useful,
 * but WITHOUT ANY WARRANTY; without even the implied warranty of
 * MERCHANTABILITY or FITNESS FOR A PARTICULAR PURPOSE.  See the
 * GNU General Public License for more details.
 */

#include "msm8940-moto-common.dtsi"
#include "msm8940-hannah-common.dtsi"
#include "msm8937-camera-sensor-mot-hannah.dtsi"

 / {
	model = "hannah";
	compatible = "qcom,msm8940-hannah", "qcom,msm8940-moto",
			"qcom,msm8940";
};

