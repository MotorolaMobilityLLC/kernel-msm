/* Copyright (c) 2016, The Linux Foundation. All rights reserved.
 *
 * This program is free software; you can redistribute it and/or modify
 * it under the terms of the GNU General Public License version 2 and
 * only version 2 as published by the Free Software Foundation.
 *
 * This program is distributed in the hope that it will be useful,
 * but WITHOUT ANY WARRANTY; without even the implied warranty of
 * MERCHANTABILITY or FITNESS FOR A PARTICULAR PURPOSE.  See the
 * GNU General Public License for more details.
 */

qcom,gv30-lg {
	serialnum = "SNN5972";
	/* #2298022_Moto_GV30_2630mAh_averaged_MasterSlave_Jan13th2016*/
	qcom,max-voltage-uv = <4400000>;
	qcom,nom-batt-capacity-mah = <2630>;
	qcom,batt-id-kohm = <100>;
	qcom,battery-beta = <3900>;
	qcom,battery-type = "GV30-LG-2630mah";
	qcom,chg-rslow-comp-c1 = <3052595>;
	qcom,chg-rslow-comp-c2 = <3517758>;
	qcom,chg-rs-to-rslow = <1155281>;
	qcom,chg-rslow-comp-thr = <0x99>;
	qcom,checksum = <0x82AA>;
	qcom,gui-version = "PMI8996GUI - 1.1.0.0";
	qcom,fg-profile-data = [
		 67 83 5B 66
		 C1 78 1D 6D
		 52 83 2E 53
		 E3 7B E3 85
		 1D 82 8C 98
		 91 B5 9B C0
		 70 17 E4 83
		 93 7C E7 80
		 F4 76 47 83
		 7B 70 17 73
		 74 86 7E 82
		 D1 92 6E B4
		 F1 BB 58 16
		 79 0A 09 5A
		 14 70 A5 FC
		 EB 45 9E 3C
		 8E 42 00 00
		 E0 44 1B 32
		 26 3C 00 00
		 00 00 00 00
		 00 00 00 00
		 5E 70 DB 6A
		 A7 68 96 81
		 32 75 CF 62
		 57 6A 25 80
		 6C 74 73 60
		 D9 89 59 CA
		 0E 37 62 54
		 5F A0 71 0C
		 28 00 FF 36
		 F0 11 30 03
		 00 00 00 0C
	];
};
