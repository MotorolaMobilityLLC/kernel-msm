/* Copyright (c) 2016, Motorola Mobility LLC. All rights reserved.
 *
 * This program is free software; you can redistribute it and/or modify
 * it under the terms of the GNU General Public License version 2 and
 * only version 2 as published by the Free Software Foundation.
 *
 * This program is distributed in the hope that it will be useful,
 * but WITHOUT ANY WARRANTY; without even the implied warranty of
 * MERCHANTABILITY or FITNESS FOR A PARTICULAR PURPOSE.  See the
 * GNU General Public License for more details.
 */

&mdss_mdp {
	mot_txd_520_720p_vid_v0: qcom,mdss_dsi_mot_txd_520_720p_video_v0 {
		#include "dsi-panel-mot-txd-520-720p-video-common.dtsi"
	};
	mot_txd_520_720p_vid_v1: qcom,mdss_dsi_mot_txd_520_720p_video_v1 {
		#include "dsi-panel-mot-txd-520-720p-video-common.dtsi"
	};
};

&mot_txd_520_720p_vid_v0 {
	/delete-property/ qcom,mdss-dsi-on-command;
	qcom,mdss-dsi-on-command = [
	39 00 00 00 00 00 04 FF 98 81 03
	39 01 00 00 00 00 02 01 00
	39 01 00 00 00 00 02 02 00
	39 01 00 00 00 00 02 03 53
	39 01 00 00 00 00 02 04 53
	39 01 00 00 00 00 02 05 13
	39 01 00 00 00 00 02 06 04
	39 01 00 00 00 00 02 07 02
	39 01 00 00 00 00 02 08 02
	39 01 00 00 00 00 02 09 00
	39 01 00 00 00 00 02 0a 00
	39 01 00 00 00 00 02 0b 00
	39 01 00 00 00 00 02 0c 00
	39 01 00 00 00 00 02 0d 00
	39 01 00 00 00 00 02 0e 00
	39 01 00 00 00 00 02 0f 00
	39 01 00 00 00 00 02 10 00
	39 01 00 00 00 00 02 11 00
	39 01 00 00 00 00 02 12 00
	39 01 00 00 00 00 02 13 00
	39 01 00 00 00 00 02 14 00
	39 01 00 00 00 00 02 15 00
	39 01 00 00 00 00 02 16 00
	39 01 00 00 00 00 02 17 00
	39 01 00 00 00 00 02 18 00
	39 01 00 00 00 00 02 19 00
	39 01 00 00 00 00 02 1a 00
	39 01 00 00 00 00 02 1b 00
	39 01 00 00 00 00 02 1c 00
	39 01 00 00 00 00 02 1d 00
	39 01 00 00 00 00 02 1e C0
	39 01 00 00 00 00 02 1f 80
	39 01 00 00 00 00 02 20 02
	39 01 00 00 00 00 02 21 09
	39 01 00 00 00 00 02 22 00
	39 01 00 00 00 00 02 23 00
	39 01 00 00 00 00 02 24 00
	39 01 00 00 00 00 02 25 00
	39 01 00 00 00 00 02 26 00
	39 01 00 00 00 00 02 27 00
	39 01 00 00 00 00 02 28 55
	39 01 00 00 00 00 02 29 03
	39 01 00 00 00 00 02 2a 00
	39 01 00 00 00 00 02 2b 00
	39 01 00 00 00 00 02 2c 00
	39 01 00 00 00 00 02 2d 00
	39 01 00 00 00 00 02 2e 00
	39 01 00 00 00 00 02 2f 00
	39 01 00 00 00 00 02 30 00
	39 01 00 00 00 00 02 31 00
	39 01 00 00 00 00 02 32 00
	39 01 00 00 00 00 02 33 00
	39 01 00 00 00 00 02 34 03
	39 01 00 00 00 00 02 35 00
	39 01 00 00 00 00 02 36 05
	39 01 00 00 00 00 02 37 00
	39 01 00 00 00 00 02 38 3C
	39 01 00 00 00 00 02 39 00
	39 01 00 00 00 00 02 3a 00
	39 01 00 00 00 00 02 3b 00
	39 01 00 00 00 00 02 3c 00
	39 01 00 00 00 00 02 3d 00
	39 01 00 00 00 00 02 3e 00
	39 01 00 00 00 00 02 3f 00
	39 01 00 00 00 00 02 40 00
	39 01 00 00 00 00 02 41 00
	39 01 00 00 00 00 02 42 00
	39 01 00 00 00 00 02 43 00
	39 01 00 00 00 00 02 44 00
	39 01 00 00 00 00 02 50 01
	39 01 00 00 00 00 02 51 23
	39 01 00 00 00 00 02 52 45
	39 01 00 00 00 00 02 53 67
	39 01 00 00 00 00 02 54 89
	39 01 00 00 00 00 02 55 ab
	39 01 00 00 00 00 02 56 01
	39 01 00 00 00 00 02 57 23
	39 01 00 00 00 00 02 58 45
	39 01 00 00 00 00 02 59 67
	39 01 00 00 00 00 02 5a 89
	39 01 00 00 00 00 02 5b ab
	39 01 00 00 00 00 02 5c cd
	39 01 00 00 00 00 02 5d ef
	39 01 00 00 00 00 02 5e 01
	39 01 00 00 00 00 02 5f 14
	39 01 00 00 00 00 02 60 15
	39 01 00 00 00 00 02 61 0C
	39 01 00 00 00 00 02 62 0D
	39 01 00 00 00 00 02 63 0E
	39 01 00 00 00 00 02 64 0F
	39 01 00 00 00 00 02 65 10
	39 01 00 00 00 00 02 66 11
	39 01 00 00 00 00 02 67 08
	39 01 00 00 00 00 02 68 02
	39 01 00 00 00 00 02 69 0A
	39 01 00 00 00 00 02 6a 02
	39 01 00 00 00 00 02 6b 02
	39 01 00 00 00 00 02 6c 02
	39 01 00 00 00 00 02 6d 02
	39 01 00 00 00 00 02 6e 02
	39 01 00 00 00 00 02 6f 02
	39 01 00 00 00 00 02 70 02
	39 01 00 00 00 00 02 71 02
	39 01 00 00 00 00 02 72 06
	39 01 00 00 00 00 02 73 02
	39 01 00 00 00 00 02 74 02
	39 01 00 00 00 00 02 75 14
	39 01 00 00 00 00 02 76 15
	39 01 00 00 00 00 02 77 0F
	39 01 00 00 00 00 02 78 0E
	39 01 00 00 00 00 02 79 0D
	39 01 00 00 00 00 02 7a 0C
	39 01 00 00 00 00 02 7b 11
	39 01 00 00 00 00 02 7c 10
	39 01 00 00 00 00 02 7d 06
	39 01 00 00 00 00 02 7e 02
	39 01 00 00 00 00 02 7f 0A
	39 01 00 00 00 00 02 80 02
	39 01 00 00 00 00 02 81 02
	39 01 00 00 00 00 02 82 02
	39 01 00 00 00 00 02 83 02
	39 01 00 00 00 00 02 84 02
	39 01 00 00 00 00 02 85 02
	39 01 00 00 00 00 02 86 02
	39 01 00 00 00 00 02 87 02
	39 01 00 00 00 00 02 88 08
	39 01 00 00 00 00 02 89 02
	39 01 00 00 00 00 02 8A 02
	39 01 00 00 00 00 04 FF 98 81 04
	39 01 00 00 00 00 02 6C 15
	39 01 00 00 00 00 02 6E 2F
	39 01 00 00 00 00 02 6F 55
	39 01 00 00 00 00 02 3A A4
	39 01 00 00 00 00 02 8D 1F
	39 01 00 00 00 00 02 87 BA
	39 01 00 00 00 00 02 26 76
	39 01 00 00 00 00 02 B2 D1
	39 01 00 00 00 00 02 88 0B
	39 01 00 00 00 00 04 FF 98 81 01
	39 01 00 00 00 00 02 22 09
	39 01 00 00 00 00 02 31 00
	39 01 00 00 00 00 02 53 77
	39 01 00 00 00 00 02 55 85
	39 01 00 00 00 00 02 50 96
	39 01 00 00 00 00 02 51 91
	39 01 00 00 00 00 02 60 14
	39 01 00 00 00 00 02 A0 00
	39 01 00 00 00 00 02 A1 10
	39 01 00 00 00 00 02 A2 1B
	39 01 00 00 00 00 02 A3 0F
	39 01 00 00 00 00 02 A4 12
	39 01 00 00 00 00 02 A5 24
	39 01 00 00 00 00 02 A6 19
	39 01 00 00 00 00 02 A7 1C
	39 01 00 00 00 00 02 A8 65
	39 01 00 00 00 00 02 A9 1B
	39 01 00 00 00 00 02 AA 29
	39 01 00 00 00 00 02 AB 5A
	39 01 00 00 00 00 02 AC 19
	39 01 00 00 00 00 02 AD 17
	39 01 00 00 00 00 02 AE 4C
	39 01 00 00 00 00 02 AF 21
	39 01 00 00 00 00 02 B0 27
	39 01 00 00 00 00 02 B1 49
	39 01 00 00 00 00 02 B2 5D
	39 01 00 00 00 00 02 B3 3F
	39 01 00 00 00 00 02 C0 00
	39 01 00 00 00 00 02 C1 10
	39 01 00 00 00 00 02 C2 1C
	39 01 00 00 00 00 02 C3 0F
	39 01 00 00 00 00 02 C4 12
	39 01 00 00 00 00 02 C5 24
	39 01 00 00 00 00 02 C6 19
	39 01 00 00 00 00 02 C7 1C
	39 01 00 00 00 00 02 C8 66
	39 01 00 00 00 00 02 C9 1C
	39 01 00 00 00 00 02 CA 29
	39 01 00 00 00 00 02 CB 5A
	39 01 00 00 00 00 02 CC 19
	39 01 00 00 00 00 02 CD 17
	39 01 00 00 00 00 02 CE 4B
	39 01 00 00 00 00 02 CF 21
	39 01 00 00 00 00 02 D0 27
	39 01 00 00 00 00 02 D1 4A
	39 01 00 00 00 00 02 D2 5D
	39 01 00 00 00 00 02 D3 3F
	39 01 00 00 00 00 04 FF 98 81 02
	39 01 00 00 00 00 02 06 40
	39 01 00 00 00 00 02 07 05
	39 01 00 00 00 00 04 FF 98 81 00
	39 01 00 00 78 00 02 11 00
	39 01 00 00 0A 00 02 29 00
	39 00 00 00 00 00 03 51 0C F4
	39 00 00 00 00 00 02 53 2C
	39 00 00 00 00 00 02 55 01];		/* Display on */
};
