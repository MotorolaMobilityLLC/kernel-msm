/* Copyright (c) 2013-2014, The Linux Foundation. All rights reserved.
 *
 * This program is free software; you can redistribute it and/or modify
 * it under the terms of the GNU General Public License version 2 and
 * only version 2 as published by the Free Software Foundation.
 *
 * This program is distributed in the hope that it will be useful,
 * but WITHOUT ANY WARRANTY; without even the implied warranty of
 * MERCHANTABILITY or FITNESS FOR A PARTICULAR PURPOSE.  See the
 * GNU General Public License for more details.
 */

maxim,fc40-lg-batterydata {
	/* Required properties */
	serialnum	= "SNN5965";

	/* Table from Maxim for FC40 LG 2510 mAhr Battery */
	config		= /bits/ 16 <0x0254>;
	full_soc_thresh	= /bits/ 16 <0x5F00>;	/* app note constant */
	design_cap	= /bits/ 16 <5020>;	/* mAh times 2 */
	ichgt_term	= /bits/ 16 <0x0319>;	/* battery attribute */
	learn_cfg	= /bits/ 16 <0x2603>;	/* app note constant */
	filter_cfg	= /bits/ 16 <0x87A4>;	/* app note constant */
	relax_cfg	= /bits/ 16 <0x203B>;
	fullcap		= /bits/ 16 <5020>;	/* mAh times 2 */
	fullcapnom	= /bits/ 16 <5020>;	/* mAh times 2 */
	lavg_empty      = /bits/ 16 <0x0FAF>;   /* (2510mA/4/0.15625mA) */
	qrtbl00		= /bits/ 16 <0x3E80>;	/* battery attribute */
	qrtbl10		= /bits/ 16 <0x1C82>;	/* battery attribute */
	qrtbl20		= /bits/ 16 <0x0B05>;	/* battery attribute */
	qrtbl30		= /bits/ 16 <0x0907>;	/* battery attribute */
	rcomp0		= /bits/ 16 <0x008C>;	/* battery attribute */
	tcompc0		= /bits/ 16 <0x3D3C>;	/* battery attribute */
	vempty          = /bits/ 16 <0xA05F>;   /* battery attribute */
	maxim,cell-char-tbl = /bits/ 16 <	/* battery attribute */
		0x8190 0xb630 0xb790 0xb9b0 0xbbb0 0xbcb0
		0xbdd0 0xbe80 0xc040 0xc1e0 0xc4b0 0xc720
		0xcbb0 0xcf20 0xd310 0xd740 0x0070 0x1420
		0x0c00 0x0e00 0x1800 0x1700 0x2120 0x1060
		0x0df0 0x08e0 0x0950 0x0840 0x07f0 0x06f0
		0x06d0 0x06d0 0x0100 0x0100 0x0100 0x0100
		0x0100 0x0100 0x0100 0x0100 0x0100 0x0100
		0x0100 0x0100 0x0100 0x0100 0x0100 0x0100
	>;
	/* Optional properties */
	tgain		= /bits/ 16 <0xE71C>;	/* thermistor attribute */
	toff		= /bits/ 16 <0x251A>;	/* thermistor attribute */
	cgain		= /bits/ 16 <0x4000>;	/* current sense attribute */
	misc_cfg	= /bits/ 16 <0x0170>;
	rev		= /bits/ 16 <0x0004>;
};
