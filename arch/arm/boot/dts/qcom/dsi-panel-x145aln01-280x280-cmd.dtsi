/* Copyright (c) 2013-2014, The Linux Foundation. All rights reserved.
 *
 * This program is free software; you can redistribute it and/or modify
 * it under the terms of the GNU General Public License version 2 and
 * only version 2 as published by the Free Software Foundation.
 *
 * This program is distributed in the hope that it will be useful,
 * but WITHOUT ANY WARRANTY; without even the implied warranty of
 * MERCHANTABILITY or FITNESS FOR A PARTICULAR PURPOSE.  See the
 * GNU General Public License for more details.
 */

/*---------------------------------------------------------------------------
 * This file is autogenerated file using gcdb parser. Please do not edit it.
 * Update input XML file to add a new entry or update variable in this file
 * VERSION = "1.0"
 *---------------------------------------------------------------------------*/
&mdss_mdp {
	dsi_x145aln01_280x280_cmd: qcom,mdss_dsi_x145aln01_280_cmd {
		qcom,mdss-dsi-panel-name = "x145aln01 280x280 command mode dsi panel";
		qcom,mdss-dsi-panel-controller = <&mdss_dsi0>;
		qcom,mdss-dsi-panel-type = "dsi_cmd_mode";
		qcom,mdss-dsi-panel-destination = "display_1";
		qcom,mdss-dsi-panel-framerate = <57>;
		qcom,mdss-dsi-virtual-channel-id = <0>;
		qcom,mdss-dsi-stream = <0>;
		qcom,mdss-dsi-panel-width = <280>;
		qcom,mdss-dsi-panel-height = <280>;
		qcom,mdss-pan-physical-height-dimension = <26>;
		qcom,mdss-pan-physical-width-dimension = <26>;

		qcom,mdss-dsi-h-front-porch = <4>;
		qcom,mdss-dsi-h-back-porch = <4>;
		qcom,mdss-dsi-h-pulse-width = <4>;
		qcom,mdss-dsi-h-sync-skew = <0>;
		qcom,mdss-dsi-v-back-porch = <2>;
		qcom,mdss-dsi-v-front-porch = <2>;
		qcom,mdss-dsi-v-pulse-width = <2>;
		qcom,mdss-dsi-h-left-border = <0>;
		qcom,mdss-dsi-h-right-border = <0>;
		qcom,mdss-dsi-v-top-border = <0>;
		qcom,mdss-dsi-v-bottom-border = <0>;
		qcom,mdss-dsi-bpp = <24>;
		qcom,mdss-dsi-underflow-color = <0xff>;
		qcom,mdss-dsi-border-color = <0>;
		qcom,mdss-dsi-on-command-V2 = [

			15 01 00 00 00 00 02 FE 01
			15 01 00 00 00 00 02 2A 06
			15 01 00 00 00 00 02 FE 05
			15 01 00 00 00 00 02 05 00
			15 01 00 00 00 00 02 FE 07
			15 01 00 00 00 00 02 07 6D
			15 01 00 00 00 00 02 FE 0A
			15 01 00 00 00 00 02 1C 1B
			15 01 00 00 00 00 02 FE 00
			39 01 00 00 00 00 05 2A 00 00 01 17
			39 01 00 00 00 00 05 2B 00 00 01 17
			39 01 00 00 00 00 05 31 00 00 01 17
			05 01 00 00 FF 00 02 12 00
			15 01 00 00 00 00 02 35 00
			05 01 00 00 FF 00 02 11 00
			32 01 00 00 00 00 02 00 00
			05 01 00 00 FF 00 02 29 00

			];

		qcom,mdss-dsi-off-command = [
					05 01 00 00 32 00 02 28 00
					05 01 00 00 78 00 02 10 00

					];

		qcom,mdss-dsi-idle-on-command-V2 = [
					05 01 00 00 64 00 02 39 00
					];
		qcom,mdss-dsi-idle-off-command-V2 = [
					05 01 00 00 64 00 02 38 00
					];

		qcom,mdss-dsi-idle-on-command = [
					05 01 00 00 64 00 02 39 00
					];
		qcom,mdss-dsi-idle-off-command = [
					05 01 00 00 64 00 02 38 00
					];

		qcom,mdss-dsi-idle-command-state = "dsi_lp_mode";

		qcom,mdss-dsi-on-command-state = "dsi_lp_mode";
		qcom,mdss-dsi-off-command-state = "dsi_hs_mode";
		qcom,mdss-dsi-bllp-eof-power-mode;
		qcom,mdss-dsi-bllp-power-mode;
		qcom,mdss-dsi-lane-map = "lane_map_3012";
		qcom,mdss-dsi-lane-0-state;
		qcom,mdss-dsi-te-pin-select = <1>;
		qcom,mdss-dsi-te-dcs-command = <1>;
		qcom,mdss-dsi-te-check-enable;
		qcom,mdss-dsi-te-using-te-pin;

		/* By AUO's suggestion: MIPI Clock rate = ~290Mbps. */
		qcom,mdss-dsi-panel-timings = [38 0C 08 00 64 64 0C 19 08 03 04 00];


		qcom,mdss-dsi-t-clk-post = <0x04>;
		qcom,mdss-dsi-t-clk-pre = <0x1b>;
		qcom,mdss-dsi-bl-min-level = <1>;
		qcom,mdss-dsi-bl-max-level = <255>;
		qcom,mdss-dsi-dma-trigger = "trigger_sw";
		qcom,mdss-dsi-mdp-trigger = "none";
		qcom,mdss-dsi-bl-pmic-control-type = "bl_ctrl_dcs";
		qcom,mdss-dsi-reset-sequence = <1 20>, <0 1>, <1 20>;

	};
};
