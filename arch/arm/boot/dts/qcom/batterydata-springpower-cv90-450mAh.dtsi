/* Copyright (c) 2015, The Linux Foundation. All rights reserved.
 *
 * This program is free software; you can redistribute it and/or modify
 * it under the terms of the GNU General Public License version 2 and
 * only version 2 as published by the Free Software Foundation.
 *
 * This program is distributed in the hope that it will be useful,
 * but WITHOUT ANY WARRANTY; without even the implied warranty of
 * MERCHANTABILITY or FITNESS FOR A PARTICULAR PURPOSE.  See the
 * GNU General Public License for more details.
 */

qcom,springpower-cv90-450mAh-data {
	qcom,battery-type = "springpower_cv90_450mAh";
	qcom,batt-id-kohm = <100>;
	qcom,chg-term-ua = <50000>;
	qcom,default-rbatt-mohm = <427>;
	qcom,fcc-mah = <450>;
	qcom,max-voltage-uv = <4200000>;
	qcom,rbatt-capacitive-mohm = <50>;
	qcom,v-cutoff-uv = <3400000>;
	qcom,flat-ocv-threshold-uv = <3800000>;
	qcom,batt-id-range-pct = <15>;

	qcom,fcc-temp-lut {
		qcom,lut-col-legend = <(-20) 0 25 40 60>;
		qcom,lut-data = <456 460 460 460 460>;
	};

	qcom,pc-temp-ocv-lut {
		qcom,lut-col-legend = <(-20) 0 25 40 60>;
		qcom,lut-row-legend = <100 95 90 85 80>,
					<75 70 65 60 55>,
					<50 45 40 35 30>,
					<25 20 16 13 11>,
					<10 9 8 7 6>,
					<5 4 3 2 1>,
					<0>;
		qcom,lut-data = <4170 4167 4160 4157 4152>,
				<4098 4110 4107 4105 4102>,
				<4055 4070 4066 4062 4059>,
				<3982 4008 4020 4021 4020>,
				<3932 3960 3984 3985 3983>,
				<3902 3932 3954 3952 3950>,
				<3870 3902 3922 3922 3920>,
				<3840 3872 3884 3887 3886>,
				<3814 3844 3850 3850 3849>,
				<3792 3822 3826 3826 3824>,
				<3775 3802 3808 3808 3806>,
				<3762 3786 3794 3794 3792>,
				<3750 3774 3782 3782 3780>,
				<3740 3764 3771 3770 3764>,
				<3728 3752 3759 3752 3742>,
				<3710 3736 3744 3736 3722>,
				<3689 3720 3724 3715 3702>,
				<3664 3710 3703 3693 3680>,
				<3639 3702 3689 3680 3669>,
				<3619 3694 3686 3678 3666>,
				<3606 3688 3684 3676 3664>,
				<3590 3679 3682 3674 3661>,
				<3572 3668 3676 3667 3652>,
				<3547 3650 3661 3650 3632>,
				<3516 3624 3631 3619 3600>,
				<3480 3587 3590 3578 3560>,
				<3429 3538 3540 3530 3511>,
				<3364 3472 3478 3468 3449>,
				<3294 3380 3394 3384 3362>,
				<3220 3254 3268 3252 3222>,
				<3110 3024 3000 3000 3000>;
	};

	qcom,rbatt-sf-lut {
		qcom,lut-col-legend = <(-20) 0 25 40 60>;
		qcom,lut-row-legend = <100 95 90 85 80>,
					<75 70 65 60 55>,
					<50 45 40 35 30>,
					<25 20 16 13 11>,
					<10 9 8 7 6>,
					<5 4 3 2 1>;
		qcom,lut-data = <1222 318 100 69 51>,
				<1222 318 100 69 51>,
				<1299 337 108 74 53>,
				<1280 336 112 77 56>,
				<1284 331 122 82 58>,
				<1308 340 130 87 62>,
				<1322 342 137 94 67>,
				<1335 343 125 92 68>,
				<1351 344 104 75 56>,
				<1372 341 101 70 53>,
				<1412 346 102 71 54>,
				<1456 350 106 74 57>,
				<1519 357 109 79 59>,
				<1592 363 110 79 58>,
				<1689 364 107 70 52>,
				<1806 362 106 68 51>,
				<1956 377 107 71 52>,
				<2075 413 107 71 52>,
				<2121 434 104 71 52>,
				<1975 408 106 73 53>,
				<1922 415 111 74 54>,
				<1984 423 115 76 56>,
				<2087 433 120 77 58>,
				<2257 437 120 77 58>,
				<2628 442 116 78 60>,
				<3171 456 119 83 67>,
				<4176 482 131 93 76>,
				<8352 532 149 109 88>,
				<16704 677 188 132 105>,
				<33409 1355 377 264 211>;
	};
};
