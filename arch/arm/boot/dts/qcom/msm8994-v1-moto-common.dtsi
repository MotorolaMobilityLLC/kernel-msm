/* Copyright (c) 2014, Motorla Mobility LLC. All rights reserved.
 *
 * This program is free software; you can redistribute it and/or modify
 * it under the terms of the GNU General Public License version 2 and
 * only version 2 as published by the Free Software Foundation.
 *
 * This program is distributed in the hope that it will be useful,
 * but WITHOUT ANY WARRANTY; without even the implied warranty of
 * MERCHANTABILITY or FITNESS FOR A PARTICULAR PURPOSE.  See the
 * GNU General Public License for more details.
 */

/* RAM OOPS */
/memreserve/ 0xaf000000 0x80000;

#include "msm8994-v1.dtsi"
#include "msm8994-moto-common.dtsi"

/* Only deltas on Motorola hardware between v1 and v2 chips should go here */

