/* Copyright (c) 2016, Motorola Mobility LLC. All rights reserved.
 *
 * This program is free software; you can redistribute it and/or modify
 * it under the terms of the GNU General Public License version 2 and
 * only version 2 as published by the Free Software Foundation.
 *
 * This program is distributed in the hope that it will be useful,
 * but WITHOUT ANY WARRANTY; without even the implied warranty of
 * MERCHANTABILITY or FITNESS FOR A PARTICULAR PURPOSE.  See the
 * GNU General Public License for more details.
 */

&mdss_mdp {
	mot_boe_499_720p_vid_v0: qcom,mdss_dsi_mot_boe_499_720p_video_v0 {
		#include "dsi-panel-mot-boe-499-720p-video-common.dtsi"
	};

	mot_boe_499_720p_vid_v1: qcom,mdss_dsi_mot_boe_499_720p_video_v1 {
		#include "dsi-panel-mot-boe-499-720p-video-common.dtsi"
	};
};

&mot_boe_499_720p_vid_v0 {
	/delete-property/ qcom,mdss-dsi-on-command;
	qcom,mdss-dsi-on-command = [
		39 00 00 00 00 00 04 b9 ff 83 94
		05 01 00 00 78 00 01 11
		15 00 00 00 00 00 02 CC 07
		15 01 00 00 05 00 02 51 CF
		39 01 00 00 05 00 0A C9 13 00 00 14 B1 1E 00 91 00
		15 01 00 00 05 00 02 55 01
		15 00 00 00 00 00 02 53 2C
		05 01 00 00 0a 00 01 29];		/* Display on */
};
