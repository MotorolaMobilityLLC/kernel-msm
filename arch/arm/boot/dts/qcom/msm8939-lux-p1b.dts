/* Copyright (c) 2014, Motorola Mobility LLC. All rights reserved.
*
* This program is free software; you can redistribute it and/or modify
* it under the terms of the GNU General Public License version 2 and
* only version 2 as published by the Free Software Foundation.
*
* This program is distributed in the hope that it will be useful,
* but WITHOUT ANY WARRANTY; without even the implied warranty of
* MERCHANTABILITY or FITNESS FOR A PARTICULAR PURPOSE.  See the
* GNU General Public License for more details.
*/

/dts-v1/;

#include "msm8939-lux.dtsi"

/ {
	qcom,board-id = <0x47 0x81b0>;
};


&i2c_0 {
	/delete-node/ synaptics_dsx_i2c@20;
};

&i2c_4 {

	synaptics_dsx_i2c@20 {
		compatible = "synaptics,synaptics_dsx_i2c";
		reg = <0x20>;
		interrupt-parent = <&msm_gpio>;
		interrupts = <21 0>;
		gpios = <&msm_gpio 21 0>, /* IRQ */
			<&msm_gpio 20 0>; /* RESET */
		touch_vdd-supply = <&pm8916_l16>;
		synaptics,normal-mode = <1>;
		synaptics,gpio-config;
		pinctrl-names = "default", "active";
		pinctrl-0 = <&touch_reset_default &touch_int_default>;
		pinctrl-1 = <&touch_reset_active &touch_int_active>;
		synaptics,x-flip;
		synaptics,y-flip;
	};
};

