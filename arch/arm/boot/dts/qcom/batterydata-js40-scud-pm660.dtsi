
qcom,js40-scud-pm660 {
	serialnum = "SB18C20118";
	qcom, = <24>;
	/* #3201227_Lenovo_JS40cos_3000mAh_averaged_MasterSlave_Nov20th2017*/
	qcom,max-voltage-uv = <4400000>;
	qcom,fg-cc-cv-threshold-mv = <4390>;
	qcom,nom-batt-capacity-mah = <3000>;
	qcom,batt-id-kohm = <243>;
	qcom,battery-beta = <3380>;
	qcom,battery-type = "JS40-SCUD-3000mah";
	qcom,checksum = <0xB991>;
	qcom,gui-version = "PM660GUI - 0.0.0.45";
	qcom,profile-revision = /bits/ 8 <0x01>;
	qcom,fg-profile-data = [
		 6C 1F B4 05
		 67 0A 5C 06
		 6E 1D 95 F5
		 2E 12 35 14
		 D8 18 D1 22
		 A9 45 A4 52
		 55 00 00 00
		 0E 00 00 00
		 00 00 DF A2
		 D7 CC 0C C3
		 28 00 08 00
		 41 E2 F4 ED
		 56 05 C8 01
		 BB 0D 1B 0B
		 02 EC 3F 23
		 3A 06 09 20
		 27 00 14 00
		 FF 1F 4E 05
		 9F 0A 6D FC
		 16 1D 65 FB
		 7D FC 52 07
		 ED 19 D7 1B
		 4C 3D 8E 4A
		 58 00 00 00
		 11 00 00 00
		 00 00 05 CD
		 17 CA 30 C4
		 1D 00 00 00
		 FA EA F4 ED
		 A3 FC 05 01
		 1E F4 8D FB
		 B6 03 74 2A
		 CE 33 CC FF
		 07 10 00 00
		 DF 0B 66 46
		 1D 00 40 00
		 89 01 0A FA
		 FF 00 00 00
		 00 00 00 00
		 00 00 00 00
		 00 00 00 00
		 00 00 00 00
		 00 00 00 00
		 00 00 00 00
		 00 00 00 00
		 00 00 00 00
		 00 00 00 00
		 00 00 00 00
		 00 00 00 00
		 00 00 00 00
		 00 00 00 00
		 00 00 00 00
		 00 00 00 00
		 00 00 00 00
		 00 00 00 00
		 00 00 00 00
	];
};
