/* Copyright (c) 2016, The Linux Foundation. All rights reserved.
 *
 * This program is free software; you can redistribute it and/or modify
 * it under the terms of the GNU General Public License version 2 and
 * only version 2 as published by the Free Software Foundation.
 *
 * This program is distributed in the hope that it will be useful,
 * but WITHOUT ANY WARRANTY; without even the implied warranty of
 * MERCHANTABILITY or FITNESS FOR A PARTICULAR PURPOSE.  See the
 * GNU General Public License for more details.
 */

qcom,ga40-atl {
	serialnum = "SNN5970";
	/* #2316940_Moto_GA40_3000mAh_averaged_MasterSlave_Feb1st2016*/
	qcom,max-voltage-uv = <4350000>;
	qcom,nom-batt-capacity-mah = <3000>;
	qcom,batt-id-kohm = <243>;
	qcom,battery-beta = <3900>;
	qcom,battery-type = "GA40-ATL-3000mah";
	qcom,chg-rslow-comp-c1 = <2547565>;
	qcom,chg-rslow-comp-c2 = <2942607>;
	qcom,chg-rs-to-rslow = <680441>;
	qcom,chg-rslow-comp-thr = <0x99>;
	qcom,checksum = <0xA926>;
	qcom,gui-version = "PMI8950GUI - 2.0.0.15";
	qcom,fg-profile-data = [
		 E0 83 83 7C
		 91 80 3E 76
		 64 83 5D 6F
		 8D 88 0A 8F
		 03 82 86 99
		 8A B7 EB C2
		 5B 11 FB 83
		 24 7D 02 81
		 1B 77 56 83
		 6F 68 C9 7A
		 A1 87 13 82
		 C4 9A 1F BE
		 D1 CB 5B 0E
		 F3 0B E3 5B
		 CE 6E 64 FC
		 D4 3E BE 3C
		 DE 2B 00 00
		 E5 47 9C 38
		 DE 2B 00 00
		 00 00 00 00
		 00 00 00 00
		 89 6A 7E 69
		 0C 78 03 90
		 68 77 D1 6A
		 57 6F 86 80
		 59 76 44 69
		 87 6D 69 A8
		 1A 24 5B D6
		 5C A0 71 0C
		 28 00 FF 36
		 F0 11 30 03
		 00 00 00 0C
	];
};
