
qcom,jp40-swd {
	serialnum = "SB18C19816";
	qcom,step-chg-steps = <4200 3000 2000>,
				<4400 2000 1600>;
	qcom,stepchg-iterm-ma = <146>;
	qcom,auto-voltage-comp-mv = <150>;
	/* #3012372_Huaqin_JP40sun_3000mAh_averaged_MasterSlave_Jul5th2017*/
	qcom,max-voltage-uv = <4400000>;
	qcom,nom-batt-capacity-mah = <3000>;
	qcom,batt-id-kohm = <100>;
	qcom,battery-beta = <3435>;
	qcom,battery-type = "JP40-SWD-3000mah";
	qcom,chg-rslow-comp-c1 = <4153666>;
	qcom,chg-rslow-comp-c2 = <7468322>;
	qcom,chg-rs-to-rslow = <1946810>;
	qcom,chg-rslow-comp-thr = <0xB8>;
	qcom,checksum = <0x8D5C>;
	qcom,gui-version = "PMI8950GUI - 2.0.0.16";
	qcom,fg-profile-data = [
		 DD 83 D1 7C
		 05 81 F5 76
		 59 83 3A 6F
		 B9 89 2E 95
		 0D 82 FE 9A
		 53 BE D7 CB
		 52 0D 4E 83
		 47 59 AE 71
		 75 56 34 83
		 D6 78 CE 84
		 26 7B 41 82
		 7E 99 9C BC
		 3C C9 70 13
		 F1 0B EE 58
		 14 70 B2 FD
		 BD 36 3E 3E
		 FE 2A 00 00
		 DE 45 23 41
		 C5 3E 00 00
		 00 00 00 00
		 00 00 00 00
		 0D 78 23 72
		 D2 7D FB 7B
		 34 7C F6 70
		 4E 5D C9 78
		 2B 76 09 6A
		 4F 75 90 98
		 4D 04 68 85
		 5F A0 71 0C
		 28 00 FF 36
		 F0 11 30 03
		 00 00 00 0C
	];
};
