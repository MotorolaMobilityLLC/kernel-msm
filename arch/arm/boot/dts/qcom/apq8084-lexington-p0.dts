/* Copyright (c) 2013, The Linux Foundation. All rights reserved.
 * Copyright (c) 2014 Motorola Mobility LLC
 *
 * This program is free software; you can redistribute it and/or modify
 * it under the terms of the GNU General Public License version 2 and
 * only version 2 as published by the Free Software Foundation.
 *
 * This program is distributed in the hope that it will be useful,
 * but WITHOUT ANY WARRANTY; without even the implied warranty of
 * MERCHANTABILITY or FITNESS FOR A PARTICULAR PURPOSE.  See the
 * GNU General Public License for more details.
 */

/dts-v1/;

#include "apq8084-moto-reserve.dtsi"
#include "apq8084.dtsi"
#include "apq8084-lexington.dtsi"

/ {
	qcom,msm-id = <178 0x41 0x8100>;
};

&soc {
	sound {
		qcom,ext_hs_detect = "tpa6165";
	};
};
