/* Copyright (c) 2013, The Linux Foundation. All rights reserved.
 * Copyright (c) 2014 Motorola Mobility LLC
 *
 * This program is free software; you can redistribute it and/or modify
 * it under the terms of the GNU General Public License version 2 and
 * only version 2 as published by the Free Software Foundation.
 *
 * This program is distributed in the hope that it will be useful,
 * but WITHOUT ANY WARRANTY; without even the implied warranty of
 * MERCHANTABILITY or FITNESS FOR A PARTICULAR PURPOSE.  See the
 * GNU General Public License for more details.
 */


/ {
	channel-id-map =
		"acg",		/* 0 - Engineering or ACG */
		"amxbr",	/* 1 - LatAm */
		"amxpr",	/* 2 */
		"amxmx",	/* 3 */
		"amxcl",	/* 4 */
		"amxar",	/* 5 */
		"amxla",	/* 6 */
		"amxpe",	/* 7 */
		"amxco",	/* 8 */
		"tefbr",	/* 9 */
		"tefmx",	/* 10 */
		"tefar",	/* 11 */
		"tefcl",	/* 12 */
		"tefpe",	/* 13 */
		"tefco",	/* 14 */
		"perar",	/* 15 */
		"entcl",	/* 16 */
		"iusmx",	/* 17 */
		"niibr",	/* 18 */
		"niicl",	/* 19 */
		"niimx",	/* 20 */
		"niipe",	/* 21 */
		"oibr",		/* 22 */
		"timbr",	/* 23 */
		"tigco",	/* 24 */
		"retbr",	/* 25 */
		"retar",	/* 26 */
		"retla",	/* 27 */
		"retcl",	/* 28 */
		"tefla",	/* 29 */
		"retla1st",	/* 30 */
		"tefunl",	/* 31 */
		"undefined",	/* 32 */
		"undefined",	/* 33 */
		"undefined",	/* 34 */
		"undefined",	/* 35 */
		"undefined",	/* 36 */
		"undefined",	/* 37 */
		"undefined",	/* 38 */
		"undefined",	/* 39 */
		"undefined",	/* 40 */
		"undefined",	/* 41 */
		"undefined",	/* 42 */
		"undefined",	/* 43 */
		"undefined",	/* 44 */
		"undefined",	/* 45 */
		"undefined",	/* 46 */
		"undefined",	/* 47 */
		"undefined",	/* 48 */
		"undefined",	/* 49 */
		"undefined",	/* 50 */
		"undefined",	/* 51 */
		"undefined",	/* 52 */
		"undefined",	/* 53 */
		"undefined",	/* 54 */
		"undefined",	/* 55 */
		"undefined",	/* 56 */
		"undefined",	/* 57 */
		"undefined",	/* 58 */
		"undefined",	/* 59 */
		"undefined",	/* 60 */
		"undefined",	/* 61 */
		"undefined",	/* 62 */
		"undefined",	/* 63 */
		"reteu",	/* 64 - Europe, Middle East & Africa */
		"retgb",	/* 65 */
		"retfr",	/* 66 */
		"retes",	/* 67 */
		"retie",	/* 68 */
		"retde",	/* 69 */
		"vfgb",		/* 70 */
		"vfde",		/* 71 */
		"vffr",		/* 72 */
		"o2gb",		/* 73 */
		"o2de",		/* 74 */
		"orafr",	/* 75 */
		"bouyfr",	/* 76 */
		"eegb",		/* 77 */
		"tescogb",	/* 78 */
		"yoigo",	/* 79 */
		"oraes",	/* 80 */
		"retapac",	/* 81 */
		"retmea",	/* 82 */
		"undefined",	/* 83 */
		"undefined",	/* 84 */
		"undefined",	/* 85 */
		"undefined",	/* 86 */
		"undefined",	/* 87 */
		"undefined",	/* 88 */
		"undefined",	/* 89 */
		"undefined",	/* 90 */
		"undefined",	/* 91 */
		"undefined",	/* 92 */
		"undefined",	/* 93 */
		"undefined",	/* 94 */
		"undefined",	/* 95 */
		"undefined",	/* 96 */
		"undefined",	/* 97 */
		"undefined",	/* 98 */
		"undefined",	/* 99 */
		"undefined",	/* 100 */
		"undefined",	/* 101 */
		"undefined",	/* 102 */
		"undefined",	/* 103 */
		"undefined",	/* 104 */
		"undefined",	/* 105 */
		"undefined",	/* 106 */
		"undefined",	/* 107 */
		"undefined",	/* 108 */
		"undefined",	/* 109 */
		"undefined",	/* 110 */
		"undefined",	/* 111 */
		"undefined",	/* 112 */
		"undefined",	/* 113 */
		"undefined",	/* 114 */
		"undefined",	/* 115 */
		"undefined",	/* 116 */
		"undefined",	/* 117 */
		"undefined",	/* 118 */
		"undefined",	/* 119 */
		"undefined",	/* 120 */
		"undefined",	/* 121 */
		"undefined",	/* 122 */
		"undefined",	/* 123 */
		"undefined",	/* 124 */
		"undefined",	/* 125 */
		"undefined",	/* 126 */
		"undefined",	/* 127 */
		"retca",	/* 128 - North America */
		"bwaca",	/* 129 */
		"tkpca",	/* 130 */
		"vzw",		/* 131 */
		"att",		/* 132 */
		"tmo",		/* 133 */
		"sprint",	/* 134 */
		"repw",		/* 135 */
		"aio",		/* 136 */
		"???",		/* 137 */
		"cc",		/* 138 */
		"usc",		/* 139 */
		"tracfone",	/* 140 */
		"retus",	/* 141 */
		"???",		/* 142 */
		"rcica",	/* 143 */
		"undefined",	/* 144 */
		"undefined",	/* 145 */
		"undefined",	/* 146 */
		"undefined",	/* 147 */
		"undefined",	/* 148 */
		"undefined",	/* 149 */
		"undefined",	/* 150 */
		"undefined",	/* 151 */
		"undefined",	/* 152 */
		"undefined",	/* 153 */
		"undefined",	/* 154 */
		"undefined",	/* 155 */
		"undefined",	/* 156 */
		"undefined",	/* 157 */
		"undefined",	/* 158 */
		"undefined",	/* 159 */
		"undefined",	/* 160 */
		"undefined",	/* 161 */
		"undefined",	/* 162 */
		"undefined",	/* 163 */
		"undefined",	/* 164 */
		"undefined",	/* 165 */
		"undefined",	/* 166 */
		"undefined",	/* 167 */
		"undefined",	/* 168 */
		"undefined",	/* 169 */
		"undefined",	/* 170 */
		"undefined",	/* 171 */
		"undefined",	/* 172 */
		"undefined",	/* 173 */
		"undefined",	/* 174 */
		"undefined",	/* 175 */
		"undefined",	/* 176 */
		"undefined",	/* 177 */
		"undefined",	/* 178 */
		"undefined",	/* 179 */
		"undefined",	/* 180 */
		"undefined",	/* 181 */
		"undefined",	/* 182 */
		"undefined",	/* 183 */
		"undefined",	/* 184 */
		"undefined",	/* 185 */
		"undefined",	/* 186 */
		"undefined",	/* 187 */
		"undefined",	/* 188 */
		"undefined",	/* 189 */
		"undefined",	/* 190 */
		"undefined",	/* 191 */
		"retin",	/* 192 - Asia & Oceania */
		"undefined",	/* 193 */
		"undefined",	/* 194 */
		"undefined",	/* 195 */
		"undefined",	/* 196 */
		"undefined",	/* 197 */
		"undefined",	/* 198 */
		"undefined",	/* 199 */
		"undefined",	/* 200 */
		"undefined",	/* 201 */
		"undefined",	/* 202 */
		"undefined",	/* 203 */
		"undefined",	/* 204 */
		"undefined",	/* 205 */
		"undefined",	/* 206 */
		"undefined",	/* 207 */
		"undefined",	/* 208 */
		"undefined",	/* 209 */
		"undefined",	/* 210 */
		"undefined",	/* 211 */
		"undefined",	/* 212 */
		"undefined",	/* 213 */
		"undefined",	/* 214 */
		"undefined",	/* 215 */
		"undefined",	/* 216 */
		"undefined",	/* 217 */
		"undefined",	/* 218 */
		"undefined",	/* 219 */
		"undefined",	/* 220 */
		"undefined",	/* 221 */
		"undefined",	/* 222 */
		"undefined",	/* 223 */
		"undefined",	/* 224 */
		"undefined",	/* 225 */
		"undefined",	/* 226 */
		"undefined",	/* 227 */
		"undefined",	/* 228 */
		"undefined",	/* 229 */
		"undefined",	/* 230 */
		"undefined",	/* 231 */
		"undefined",	/* 232 */
		"undefined",	/* 233 */
		"undefined",	/* 234 */
		"undefined",	/* 235 */
		"undefined",	/* 236 */
		"undefined",	/* 237 */
		"undefined",	/* 238 */
		"undefined",	/* 239 */
		"undefined",	/* 240 */
		"undefined",	/* 241 */
		"undefined",	/* 242 */
		"undefined",	/* 243 */
		"undefined",	/* 244 */
		"undefined",	/* 245 */
		"undefined",	/* 246 */
		"undefined",	/* 247 */
		"undefined",	/* 248 */
		"undefined",	/* 249 */
		"undefined",	/* 250 */
		"undefined",	/* 251 */
		"undefined",	/* 252 */
		"undefined",	/* 253 */
		"undefined",	/* 254 */
		"undefined";	/* 255 */
};
