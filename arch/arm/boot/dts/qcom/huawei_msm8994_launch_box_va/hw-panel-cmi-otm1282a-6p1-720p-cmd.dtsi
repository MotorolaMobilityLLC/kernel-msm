/* Copyright (c) 2013, The Linux Foundation. All rights reserved.
 *
 * This program is free software; you can redistribute it and/or modify
 * it under the terms of the GNU General Public License version 2 and
 * only version 2 as published by the Free Software Foundation.
 *
 * This program is distributed in the hope that it will be useful,
 * but WITHOUT ANY WARRANTY; without even the implied warranty of
 * MERCHANTABILITY or FITNESS FOR A PARTICULAR PURPOSE.  See the
 * GNU General Public License for more details.
 */

/*---------------------------------------------------------------------------
 * This file is autogenerated file using gcdb parser. Please do not edit it.
 * Update input XML file to add a new entry or update variable in this file
 * VERSION = "1.0"
 *---------------------------------------------------------------------------*/
&mdss_mdp {
	dsi_cmi_otm1282a_6p1_720p_cmd: qcom,mdss_dsi_cmi_otm1282a_6p1_720p_cmd {
		qcom,mdss-dsi-panel-name = "CMI_OTM1282A_6P1_720P_CMD";
		qcom,cont-splash-enabled;
		qcom,mdss-dsi-panel-controller = <&mdss_dsi0>;
		qcom,mdss-dsi-panel-type = "dsi_cmd_mode";
		qcom,mdss-dsi-panel-destination = "display_1";
		qcom,mdss-dsi-panel-clockrate = <414000000>;
		qcom,mdss-dsi-panel-framerate = <60>;
		qcom,mdss-dsi-virtual-channel-id = <0>;
		qcom,mdss-dsi-stream = <0>;
		qcom,mdss-dsi-panel-width = <720>;
		qcom,mdss-dsi-panel-height = <1280>;
		qcom,mdss-dsi-h-front-porch = <66>;
		qcom,mdss-dsi-h-back-porch = <72>;
		qcom,mdss-dsi-h-pulse-width = <8>;
		qcom,mdss-dsi-h-sync-skew = <0>;
		qcom,mdss-dsi-v-back-porch = <20>;
		qcom,mdss-dsi-v-front-porch = <20>;
		qcom,mdss-dsi-v-pulse-width = <8>;
		qcom,mdss-dsi-h-left-border = <0>;
		qcom,mdss-dsi-h-right-border = <0>;
		qcom,mdss-dsi-v-top-border = <0>;
		qcom,mdss-dsi-v-bottom-border = <0>;
		qcom,mdss-dsi-bpp = <24>;
		qcom,mdss-dsi-underflow-color = <0xff>;
		qcom,mdss-dsi-border-color = <0>;
		qcom,mdss-dsi-color-order = "rgb_swap_rgb";
		qcom,mdss-dsi-pixel-packing = "tight";
		qcom,mdss-dsi-on-command = [29 01 00 00 00 00 04 FF 12 82 01
					29 01 00 00 00 00 02 00 80
					29 01 00 00 00 00 03 FF 12 82
					29 01 00 00 00 00 02 00 B0
					29 01 00 00 00 00 02 CA 02
					29 01 00 00 00 00 02 00 82
					29 01 00 00 00 00 02 A5 02
					29 01 00 00 00 00 02 00 80
					29 01 00 00 00 00 0B C0 00 8B 00 0A 0A 00 8B 0A 0A 00
					29 01 00 00 00 00 02 00 A0
					29 01 00 00 00 00 0D C0 00 00 00 03 00 1E 06 00 00 00 00 00
					29 01 00 00 00 00 02 00 80
					29 01 00 00 00 00 09 C2 82 03 00 00 00 00 00 00
					29 01 00 00 00 00 02 00 90
					29 01 00 00 00 00 10 C2 87 0C 01 07 06 86 0C 01 07 06 85 0D 01 07 06
					29 01 00 00 00 00 02 00 A0
					29 01 00 00 00 00 10 C2 84 0D 01 07 06 87 0B 01 07 06 86 0B 01 07 06
					29 01 00 00 00 00 02 00 B0
					29 01 00 00 00 00 0B C2 85 0D 01 07 06 84 0D 01 07 06
					29 01 00 00 00 00 02 00 EA
					29 01 00 00 00 00 04 C2 22 02 11
					29 01 00 00 00 00 02 00 F9
					29 01 00 00 00 00 05 C2 08 00 0C 01
					29 01 00 00 00 00 02 00 90
					29 01 00 00 00 00 10 CB 00 00 00 00 00 00 00 00 00 00 00 00 00 F0 F0
					29 01 00 00 00 00 02 00 a0
					29 01 00 00 00 00 10 CB F0 00 00 00 00 C0 00 F0 00 00 00 00 00 00 00
					29 01 00 00 00 00 02 00 B0
					29 01 00 00 00 00 10 CB 00 00 00 00 00 00 00 00 50 50 C0 00 00 C0 00
					29 01 00 00 00 00 02 00 A0
					29 01 00 00 00 00 03 C1 00 EE
					29 01 00 00 00 00 02 00 00
					29 01 00 00 00 00 02 1C 00
					29 01 00 00 00 00 02 00 B3
					29 01 00 00 00 00 02 C0 33
					29 01 00 00 00 00 02 00 B4
					29 01 00 00 00 00 02 C0 10
					29 01 00 00 00 00 02 00 C0
					29 01 00 00 00 00 10 CB 14 04 04 04 04 04 04 04 04 14 04 04 14 3B 3B
					29 01 00 00 00 00 02 00 D0
					29 01 00 00 00 00 10 CB 3B 14 04 04 30 35 04 F7 04 14 14 14 14 04 04
					29 01 00 00 00 00 02 00 E0
					29 01 00 00 00 00 10 CB 04 04 04 04 04 04 04 04 15 15 07 14 14 00 00
					29 01 00 00 00 00 02 00 F0
					29 01 00 00 00 00 0D CB 00 00 00 00 C0 00 00 00 00 00 00 00
					29 01 00 00 00 00 02 00 80
					29 01 00 00 00 00 0B CC 0F 03 04 05 06 07 08 09 0A 10
					29 01 00 00 00 00 02 00 B0
					29 01 00 00 00 00 0B CC 0F 0A 09 08 07 06 05 04 03 10
					29 01 00 00 00 00 02 00 8A
					29 01 00 00 00 00 02 CD 0B
					29 01 00 00 00 00 02 00 A0
					29 01 00 00 00 00 10 CD 06 07 08 09 14 2D 14 2D 2D 2D 2D 2D 2D 2D 2D
					29 01 00 00 00 00 02 00 B0
					29 01 00 00 00 00 10 CD 2D 2D 2D 15 12 2C 0C 0B 13 0E 0F 10 2D 2D 2D
					29 01 00 00 00 00 02 00 C0
					29 01 00 00 00 00 0B CD 2D 2D 2D 27 28 29 2A 2B 1D 2D
					29 01 00 00 00 00 02 00 D0
					29 01 00 00 00 00 10 CD 02 03 04 05 14 2D 14 2D 2D 2D 2D 2D 2D 2D 2D
					29 01 00 00 00 00 02 00 E0
					29 01 00 00 00 00 10 CD 2D 2D 2D 15 12 2C 0C 0B 13 0E 0F 10 2D 2D 2D
					29 01 00 00 00 00 02 00 F0
					29 01 00 00 00 00 0B CD 2D 2D 2D 27 28 29 2A 2B 1D 2D
					29 01 00 00 00 00 02 00 D0
					29 01 00 00 00 00 0D C0 00 00 00 03 00 1E 06 00 00 00 00 00
					29 01 00 00 00 00 02 00 80
					29 01 00 00 00 00 09 C3 82 03 00 00 00 00 00 00
					29 01 00 00 00 00 02 00 90
					29 01 00 00 00 00 10 C3 87 0C 01 07 06 86 0C 01 07 06 85 0D 01 07 06
					29 01 00 00 00 00 02 00 A0
					29 01 00 00 00 00 10 C3 84 0C 01 07 06 86 0C 01 07 06 85 0D 01 07 06
					29 01 00 00 00 00 02 00 B0
					29 01 00 00 00 00 0B C3 85 0D 01 07 06 84 0D 01 07 06
					29 01 00 00 00 00 02 00 EA
					29 01 00 00 00 00 04 C3 22 02 11
					29 01 00 00 00 00 02 00 90
					29 01 00 00 00 00 0B C5 92 D6 B5 AF B3 AA 44 44 40 88
					29 01 00 00 00 00 02 00 A0
					29 01 00 00 00 00 0B C5 92 D6 B5 AF B3 AA 44 44 40 88
					29 01 00 00 00 00 02 00 00
					29 01 00 00 00 00 03 D8 38 38
					29 01 00 00 00 00 02 00 00
					29 01 00 00 00 00 02 59 03
					29 01 00 00 00 00 02 00 80
					29 01 00 00 00 00 02 D6 1A
					29 01 00 00 00 00 02 00 00
 					29 01 00 00 00 00 0B D4 00 40 00 40 00 40 00 40 00 40
					29 01 00 00 00 00 0B D4 00 40 00 40 00 40 00 40 00 40
					29 01 00 00 00 00 0B D4 00 40 00 40 00 40 00 40 00 40
					29 01 00 00 00 00 0B D4 00 40 00 40 00 40 00 40 00 40
					29 01 00 00 00 00 0B D4 00 40 00 40 00 40 00 40 00 40
					29 01 00 00 00 00 0B D4 00 40 00 40 00 40 00 40 00 40
					29 01 00 00 00 00 0B D4 00 40 00 40 00 41 00 40 00 42
					29 01 00 00 00 00 0B D4 00 40 00 43 00 40 00 44 00 40
					29 01 00 00 00 00 0B D4 00 45 00 40 00 45 00 40 00 46
					29 01 00 00 00 00 0B D4 00 40 00 47 00 40 00 48 00 40
					29 01 00 00 00 00 0B D4 00 49 00 40 00 4a 00 40 00 4b
					29 01 00 00 00 00 0B D4 00 40 00 4b 00 40 00 4c 00 40
					29 01 00 00 00 00 0B D4 00 4d 00 40 00 4e 00 40 00 4e
					29 01 00 00 00 00 0B D4 00 40 00 4f 00 40 00 50 00 40
					29 01 00 00 00 00 0B D4 00 50 00 40 00 51 00 40 00 52
					29 01 00 00 00 00 0B D4 00 40 00 52 00 40 00 53 00 40
					29 01 00 00 00 00 0B D4 00 54 00 40 00 54 00 40 00 55
					29 01 00 00 00 00 0B D4 00 40 00 55 00 40 00 56 00 40
					29 01 00 00 00 00 0B D4 00 57 00 40 00 57 00 40 00 58
					29 01 00 00 00 00 0B D4 00 40 00 59 00 40 00 59 00 40
					29 01 00 00 00 00 0B D4 00 5a 00 40 00 5b 00 40 00 5b
					29 01 00 00 00 00 0B D4 00 40 00 5c 00 40 00 5c 00 40
					29 01 00 00 00 00 0B D4 00 5d 00 40 00 5e 00 40 00 5e
					29 01 00 00 00 00 0B D4 00 40 00 5f 00 40 00 60 00 40
					29 01 00 00 00 00 0B D4 00 60 00 40 00 5f 00 40 00 5f
					29 01 00 00 00 00 0B D4 00 40 00 5e 00 40 00 5d 00 40
					29 01 00 00 00 00 0B D4 00 5d 00 40 00 5c 00 40 00 5c
					29 01 00 00 00 00 0B D4 00 40 00 5b 00 40 00 5a 00 40
					29 01 00 00 00 00 0B D4 00 5a 00 40 00 59 00 40 00 58
					29 01 00 00 00 00 0B D4 00 40 00 58 00 40 00 57 00 40
					29 01 00 00 00 00 0B D4 00 56 00 40 00 56 00 40 00 55
					29 01 00 00 00 00 0B D4 00 40 00 54 00 40 00 53 00 40
					29 01 00 00 00 00 0B D4 00 52 00 40 00 51 00 40 00 50
					29 01 00 00 00 00 0B D4 00 40 00 4f 00 40 00 4f 00 40
					29 01 00 00 00 00 0B D4 00 4e 00 40 00 4d 00 40 00 4c
					29 01 00 00 00 00 0B D4 00 40 00 4b 00 40 00 4a 00 40
					29 01 00 00 00 00 0B D4 00 4a 00 40 00 4b 00 40 00 4c
					29 01 00 00 00 00 0B D4 00 40 00 4c 00 40 00 4d 00 40
					29 01 00 00 00 00 0B D4 00 4e 00 40 00 4f 00 40 00 50
					29 01 00 00 00 00 0B D4 00 40 00 51 00 40 00 52 00 40
					29 01 00 00 00 00 0B D4 00 53 00 40 00 53 00 40 00 54
					29 01 00 00 00 00 0B D4 00 40 00 55 00 40 00 56 00 40
					29 01 00 00 00 00 0B D4 00 57 00 40 00 57 00 40 00 58
					29 01 00 00 00 00 0B D4 00 40 00 59 00 40 00 59 00 40
					29 01 00 00 00 00 0B D4 00 5a 00 40 00 5b 00 40 00 5b
					29 01 00 00 00 00 0B D4 00 40 00 5c 00 40 00 5c 00 40
					29 01 00 00 00 00 0B D4 00 5d 00 40 00 5e 00 40 00 5e
					29 01 00 00 00 00 0B D4 00 40 00 5f 00 40 00 60 00 40
					29 01 00 00 00 00 0B D4 00 60 00 40 00 5f 00 40 00 5f
					29 01 00 00 00 00 0B D4 00 40 00 5e 00 40 00 5d 00 40
					29 01 00 00 00 00 0B D4 00 5d 00 40 00 5c 00 40 00 5c
					29 01 00 00 00 00 0B D4 00 40 00 5b 00 40 00 5a 00 40
					29 01 00 00 00 00 0B D4 00 5a 00 40 00 59 00 40 00 58
					29 01 00 00 00 00 0B D4 00 40 00 58 00 40 00 57 00 40
					29 01 00 00 00 00 0B D4 00 56 00 40 00 56 00 40 00 55
					29 01 00 00 00 00 0B D4 00 40 00 54 00 40 00 53 00 40
					29 01 00 00 00 00 0B D4 00 52 00 40 00 51 00 40 00 50
					29 01 00 00 00 00 0B D4 00 40 00 4f 00 40 00 4f 00 40
					29 01 00 00 00 00 0B D4 00 4e 00 40 00 4d 00 40 00 4c
					29 01 00 00 00 00 0B D4 00 40 00 4b 00 40 00 4a 00 40
					29 01 00 00 00 00 0B D4 00 4a 00 40 00 4a 00 40 00 4b
					29 01 00 00 00 00 0B D4 00 40 00 4c 00 40 00 4c 00 40
					29 01 00 00 00 00 0B D4 00 4d 00 40 00 4e 00 40 00 4e
					29 01 00 00 00 00 0B D4 00 40 00 4f 00 40 00 50 00 40
					29 01 00 00 00 00 0B D4 00 50 00 40 00 51 00 40 00 52
					29 01 00 00 00 00 0B D4 00 40 00 52 00 40 00 53 00 40
					29 01 00 00 00 00 0B D4 00 53 00 40 00 52 00 40 00 51
					29 01 00 00 00 00 0B D4 00 40 00 4f 00 40 00 4e 00 40
					29 01 00 00 00 00 0B D4 00 4d 00 40 00 4b 00 40 00 4a
					29 01 00 00 00 00 0B D4 00 40 00 49 00 40 00 47 00 40
					29 01 00 00 00 00 0B D4 00 46 00 40 00 45 00 40 00 44
					29 01 00 00 00 00 0B D4 00 40 00 42 00 40 00 41 00 40
					29 01 00 00 00 00 02 00 00
					29 01 00 00 00 00 0B D5 00 55 00 4b 00 54 00 4b 00 52
					29 01 00 00 00 00 0B D5 00 4a 00 51 00 4a 00 4f 00 4a
					29 01 00 00 00 00 0B D5 00 4e 00 49 00 4c 00 49 00 4b
					29 01 00 00 00 00 0B D5 00 49 00 4a 00 49 00 48 00 48
					29 01 00 00 00 00 0B D5 00 47 00 48 00 45 00 48 00 44
					29 01 00 00 00 00 0B D5 00 47 00 43 00 47 00 41 00 47
					29 01 00 00 00 00 0B D5 00 40 00 47 00 41 00 46 00 41
					29 01 00 00 00 00 0B D5 00 46 00 42 00 46 00 43 00 46
					29 01 00 00 00 00 0B D5 00 43 00 46 00 44 00 46 00 44
					29 01 00 00 00 00 0B D5 00 46 00 45 00 45 00 45 00 45
					29 01 00 00 00 00 0B D5 00 46 00 45 00 47 00 45 00 47
					29 01 00 00 00 00 0B D5 00 45 00 48 00 45 00 48 00 44
					29 01 00 00 00 00 0B D5 00 49 00 44 00 49 00 45 00 4a
					29 01 00 00 00 00 0B D5 00 45 00 4a 00 45 00 4a 00 45
					29 01 00 00 00 00 0B D5 00 4b 00 46 00 4b 00 46 00 4c
					29 01 00 00 00 00 0B D5 00 46 00 4c 00 46 00 4d 00 46
					29 01 00 00 00 00 0B D5 00 4d 00 47 00 4e 00 47 00 4e
					29 01 00 00 00 00 0B D5 00 47 00 4e 00 47 00 4f 00 47
					29 01 00 00 00 00 0B D5 00 4f 00 48 00 50 00 48 00 50
					29 01 00 00 00 00 0B D5 00 48 00 50 00 48 00 51 00 49
					29 01 00 00 00 00 0B D5 00 51 00 49 00 52 00 49 00 52
					29 01 00 00 00 00 0B D5 00 49 00 53 00 49 00 53 00 4a
					29 01 00 00 00 00 0B D5 00 53 00 4a 00 54 00 4a 00 54
					29 01 00 00 00 00 0B D5 00 4a 00 55 00 4a 00 55 00 4b
					29 01 00 00 00 00 0B D5 00 55 00 4b 00 55 00 4b 00 54
					29 01 00 00 00 00 0B D5 00 4a 00 54 00 4a 00 54 00 4a
					29 01 00 00 00 00 0B D5 00 53 00 4a 00 53 00 4a 00 52
					29 01 00 00 00 00 0B D5 00 49 00 52 00 49 00 52 00 49
					29 01 00 00 00 00 0B D5 00 51 00 49 00 51 00 48 00 50
					29 01 00 00 00 00 0B D5 00 48 00 50 00 48 00 4f 00 48
					29 01 00 00 00 00 0B D5 00 4f 00 48 00 4e 00 47 00 4e
					29 01 00 00 00 00 0B D5 00 47 00 4d 00 47 00 4d 00 46
					29 01 00 00 00 00 0B D5 00 4c 00 46 00 4c 00 46 00 4b
					29 01 00 00 00 00 0B D5 00 46 00 4a 00 45 00 4a 00 45
					29 01 00 00 00 00 0B D5 00 49 00 45 00 49 00 44 00 48
					29 01 00 00 00 00 0B D5 00 44 00 48 00 44 00 47 00 44
					29 01 00 00 00 00 0B D5 00 47 00 43 00 47 00 44 00 48
					29 01 00 00 00 00 0B D5 00 44 00 48 00 44 00 49 00 45
					29 01 00 00 00 00 0B D5 00 4a 00 45 00 4a 00 45 00 4b
					29 01 00 00 00 00 0B D5 00 45 00 4b 00 46 00 4c 00 46
					29 01 00 00 00 00 0B D5 00 4c 00 46 00 4d 00 47 00 4e
					29 01 00 00 00 00 0B D5 00 47 00 4e 00 47 00 4f 00 47
					29 01 00 00 00 00 0B D5 00 4f 00 48 00 50 00 48 00 50
					29 01 00 00 00 00 0B D5 00 48 00 50 00 48 00 51 00 49
					29 01 00 00 00 00 0B D5 00 51 00 49 00 52 00 49 00 52
					29 01 00 00 00 00 0B D5 00 49 00 53 00 49 00 53 00 4a
					29 01 00 00 00 00 0B D5 00 53 00 4a 00 54 00 4a 00 54
					29 01 00 00 00 00 0B D5 00 4a 00 55 00 4a 00 55 00 4b
					29 01 00 00 00 00 0B D5 00 55 00 4b 00 55 00 4b 00 54
					29 01 00 00 00 00 0B D5 00 4a 00 54 00 4a 00 54 00 4a
					29 01 00 00 00 00 0B D5 00 53 00 4a 00 53 00 4a 00 52
					29 01 00 00 00 00 0B D5 00 49 00 52 00 49 00 52 00 49
					29 01 00 00 00 00 0B D5 00 51 00 49 00 51 00 48 00 50
					29 01 00 00 00 00 0B D5 00 48 00 50 00 48 00 4f 00 48
					29 01 00 00 00 00 0B D5 00 4f 00 48 00 4e 00 47 00 4e
					29 01 00 00 00 00 0B D5 00 47 00 4d 00 47 00 4d 00 46
					29 01 00 00 00 00 0B D5 00 4c 00 46 00 4c 00 46 00 4b
					29 01 00 00 00 00 0B D5 00 46 00 4a 00 45 00 4a 00 45
					29 01 00 00 00 00 0B D5 00 49 00 45 00 49 00 44 00 48
					29 01 00 00 00 00 0B D5 00 44 00 48 00 44 00 47 00 44
					29 01 00 00 00 00 0B D5 00 47 00 43 00 47 00 44 00 48
					29 01 00 00 00 00 0B D5 00 44 00 48 00 44 00 48 00 44
					29 01 00 00 00 00 0B D5 00 49 00 45 00 49 00 45 00 4a
					29 01 00 00 00 00 0B D5 00 45 00 4a 00 45 00 4a 00 45
					29 01 00 00 00 00 0B D5 00 4b 00 46 00 4b 00 46 00 4c
					29 01 00 00 00 00 0B D5 00 46 00 4c 00 46 00 4d 00 46
					29 01 00 00 00 00 0B D5 00 4d 00 47 00 4e 00 47 00 4e
					29 01 00 00 00 00 0B D5 00 47 00 4f 00 48 00 4f 00 48
					29 01 00 00 00 00 0B D5 00 50 00 48 00 50 00 48 00 51
					29 01 00 00 00 00 0B D5 00 49 00 52 00 49 00 52 00 49
					29 01 00 00 00 00 0B D5 00 53 00 4a 00 53 00 4a 00 54
					29 01 00 00 00 00 0B D5 00 4a 00 54 00 4a 00 55 00 4b
					29 01 00 00 00 00 19 E1 78 79 7B 7D 7F 81 86 8F 92 9A 9F A3 5A 56 53 4A 3C 2F 25 22 19 16 13 0F
					29 01 00 00 00 00 19 E2 78 79 7B 7D 7F 81 86 8F 92 9A 9F A3 5A 56 53 4A 3C 2F 25 22 19 16 13 0F
					29 01 00 00 00 00 19 E3 64 66 68 6A 6F 74 7A 85 8A 95 9C A1 5C 59 56 4C 3C 33 2A 25 22 16 13 0F
					29 01 00 00 00 00 19 E4 64 66 68 6A 6F 74 7A 85 8A 95 9C A1 5C 59 56 4C 3C 33 2A 25 22 16 13 0F
					29 01 00 00 00 00 19 E5 01 24 2D 3B 45 4C 5A 6C 78 88 93 9A 60 5B 56 4C 3C 2F 25 22 19 16 13 0F
					29 01 00 00 00 00 19 E6 01 24 2D 3B 45 4C 5A 6C 78 88 93 9A 60 5B 56 4C 3C 2F 25 22 19 16 13 0F
					29 01 00 00 00 00 02 00 00
					29 01 00 00 00 00 04 FF FF FF FF
					29 01 00 00 00 00 02 51 00
					29 01 00 00 00 00 02 53 24
					29 01 00 00 00 00 02 55 01
					29 01 00 00 00 00 02 5E 28
					29 01 00 00 00 00 02 35 00
					05 01 00 00 78 00 02 11 00
					29 01 00 00 16 00 02 29 00];
		qcom,mdss-dsi-off-command = [05 01 00 00 16 00 02 28 00
					05 01 00 00 78 00 02 10 00];
		qcom,mdss-dsi-on-command-state = "dsi_lp_mode";
		qcom,mdss-dsi-off-command-state = "dsi_hs_mode";
		qcom,mdss-dsi-h-sync-pulse = <1>;
		qcom,mdss-dsi-traffic-mode = "burst_mode";
		qcom,mdss-dsi-lane-map = "lane_map_0123";
		qcom,mdss-dsi-bllp-eof-power-mode;
		qcom,mdss-dsi-bllp-power-mode;
		qcom,mdss-dsi-lane-0-state;
		qcom,mdss-dsi-lane-1-state;
		qcom,mdss-dsi-lane-2-state;
		qcom,mdss-dsi-lane-3-state;
		qcom,mdss-dsi-te-pin-select = <1>;
		qcom,mdss-dsi-te-v-sync-rd-ptr-irq-line = <0x2c>;
		qcom,mdss-dsi-wr-mem-start = <0x2c>;
		qcom,mdss-dsi-wr-mem-continue = <0x3c>;
		qcom,mdss-dsi-te-dcs-command = <1>;
		qcom,mdss-dsi-te-check-enable;
		qcom,mdss-dsi-te-using-te-pin;
		qcom,mdss-dsi-panel-timings = [7b 1a 10 00 3e 40 16 2A 15 03 04 00];
		qcom,mdss-dsi-reset-sequence = <1 12>, <0 5>, <1 5>, <0 5>, <1 120>;
		qcom,mdss-dsi-t-clk-post = <0x20>;
		qcom,mdss-dsi-t-clk-pre = <0x2c>;
		qcom,mdss-dsi-bl-min-level = <1>;
		qcom,mdss-dsi-bl-max-level = <4095>;
		qcom,mdss-dsi-dma-trigger = "trigger_sw";
		qcom,mdss-dsi-mdp-trigger = "none";
		qcom,mdss-dsi-bl-pmic-control-type = "bl_ctrl_wled";
		qcom,panel-inverse-off-cmds = [05 01 00 00 00 00 02 20 00];
		qcom,panel-inverse-on-cmds = [05 01 00 00 00 00 02 21 00];
		qcom,inverse-on-cmds-dsi-state = "dsi_lp_mode";
		qcom,inverse-off-cmds-dsi-state = "dsi_lp_mode";
		qcom,panel-dot-inversion-mode-cmds = [29 01 00 00 00 00 02 00 00
			      29 01 00 00 00 00 04 FF 12 82 01
			      29 01 00 00 00 00 02 00 80
			      29 01 00 00 00 00 03 FF 12 82
			      29 01 00 00 00 00 02 00 B4
			      29 01 00 00 00 00 02 C0 00
			      29 01 00 00 00 00 02 00 00
			      29 01 00 00 00 00 04 FF FF FF FF];
		qcom,panel-column-inversion-mode-cmds = [29 01 00 00 00 00 02 00 00
			      29 01 00 00 00 00 04 FF 12 82 01
			      29 01 00 00 00 00 02 00 80
			      29 01 00 00 00 00 03 FF 12 82
			      29 01 00 00 00 00 02 00 B4
			      29 01 00 00 00 00 02 C0 50
			      29 01 00 00 00 00 02 00 00
			      29 01 00 00 00 00 04 FF FF FF FF];
		qcom,dot-inversion-cmds-dsi-state = "dsi_lp_mode";
		qcom,column-inversion-cmds-dsi-state = "dsi_lp_mode";
		qcom,mdss-dsi-panel-esd-cmd = [0a 0b 0c 0d ac];
		qcom,mdss-dsi-panel-esd-cmd-value = [9c 00 07 00 00];
		qcom,mdss-dsi-lp11-init;
	};
};
