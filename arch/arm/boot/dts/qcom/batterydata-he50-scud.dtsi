
qcom,he50-scud {
	serialnum = "SNN5990A";
	/* #2746485_Lenovo_HE50scud_5000mAh_averaged_MasterSlave_Jan16th2017*/
	qcom,max-voltage-uv = <4400000>;
	qcom,nom-batt-capacity-mah = <5000>;
	qcom,batt-id-kohm = <9>;
	qcom,battery-beta = <3435>;
	qcom,battery-type = "HE50-SCUD-5000mah";
	qcom,chg-rslow-comp-c1 = <3389839>;
	qcom,chg-rslow-comp-c2 = <5611163>;
	qcom,chg-rs-to-rslow = <598331>;
	qcom,chg-rslow-comp-thr = <0xB2>;
	qcom,checksum = <0x8039>;
	qcom,gui-version = "PMI8950GUI - 2.0.0.16";
	qcom,fg-profile-data = [
		 EC 83 40 7D
		 59 81 AA 77
		 53 83 FC 5B
		 5D 7B AD 86
		 2F 82 32 9A
		 81 BD A6 CA
		 5A 0E 05 88
		 CF 7D 9A 81
		 E5 77 50 83
		 45 70 9E 6B
		 33 84 5A 82
		 51 99 8B BC
		 3E C9 5B 0E
		 D4 13 CE 59
		 14 70 29 FC
		 37 3E D3 3D
		 1E 32 00 00
		 2F 45 D9 33
		 3E 3D 00 00
		 00 00 00 00
		 00 00 00 00
		 34 69 76 68
		 AE 70 C6 88
		 C5 6E 90 68
		 5C 60 2F 7B
		 0B 6C 04 60
		 79 6D DF A0
		 21 51 60 8B
		 5D A0 71 0C
		 28 00 FF 36
		 F0 11 30 03
		 00 00 00 0C
	];
};
