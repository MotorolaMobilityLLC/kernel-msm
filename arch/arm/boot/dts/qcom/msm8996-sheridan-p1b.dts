/* Copyright (c) 2015, Motorola Mobility Inc. All rights reserved.
 *
 * This program is free software; you can redistribute it and/or modify
 * it under the terms of the GNU General Public License version 2 and
 * only version 2 as published by the Free Software Foundation.
 *
 * This program is distributed in the hope that it will be useful,
 * but WITHOUT ANY WARRANTY; without even the implied warranty of
 * MERCHANTABILITY or FITNESS FOR A PARTICULAR PURPOSE.  See the
 * GNU General Public License for more details.
 */


/dts-v1/;

#include "msm8996-sheridan.dtsi"

/ {
	qcom,board-id = <0x43 0x81B0>;
};

&muc {
	gpios = <&tlmm 73 1>,   /* gpio_muc_det_n,    input */
		<&tlmm 35 0>,   /* gpio_muc_bplus_en, output-low */
		<0>;            /* gpio_muc_ff,       not used */
	mmi,muc-ctrl-gpio-labels = "gpio_muc_det_n",
				"gpio_muc_bplus_en";

	/* v1 CC first, BPLUS second on enable */
	mmi,muc-ctrl-ff-seq-v1 = <0 0 20>, <1 0 100>,
				<0 1 20>, <1 1 100>,
				<0 0 20>;

	/* v2 BPLUS first, v2 CC second on enable */
	mmi,muc-ctrl-ff-seq-v2 = <0 0 100>, <1 0 20>,
				<1 1 100>, <0 1 20>,
				<0 0 20>;

	mmi,muc-det-pin-reconfig;
};

&muc_attach {
	config {
		pins = "gpio73", "gpio35";
		bias-disable;
	};
};
