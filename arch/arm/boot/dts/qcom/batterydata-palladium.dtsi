/* Copyright (c) 2013, The Linux Foundation. All rights reserved.
 *
 * This program is free software; you can redistribute it and/or modify
 * it under the terms of the GNU General Public License version 2 and
 * only version 2 as published by the Free Software Foundation.
 *
 * This program is distributed in the hope that it will be useful,
 * but WITHOUT ANY WARRANTY; without even the implied warranty of
 * MERCHANTABILITY or FITNESS FOR A PARTICULAR PURPOSE.  See the
 * GNU General Public License for more details.
 */

qcom,palladium-batterydata {
	qcom,fcc-mah = <369>;
	qcom,default-rbatt-mohm = <200>;
	qcom,rbatt-capacitive-mohm = <50>;
	qcom,flat-ocv-threshold-uv = <3800000>;
	qcom,max-voltage-uv = <4350000>;
	qcom,v-cutoff-uv = <3400000>;
	qcom,chg-term-ua = <30000>;
	qcom,batt-id-kohm = <75>;
	qcom,battery-type = "palladium_1500mah";

	qcom,fcc-temp-lut {
		qcom,lut-col-legend = <(-20) 0 25 40 60>;
		qcom,lut-data = <369 369 369 369 369>;
	};

	qcom,pc-temp-ocv-lut {
		qcom,lut-col-legend = <(-20) 0 25 40 60>;
		qcom,lut-row-legend = <100 95 90 85 80>,
				<75 70 65 60 55>,
				<50 45 40 35 30>,
				<25 20 16 13 11>,
				<10 9 8 7 6>,
				<5 4 3 2 1>,
				<0>;
		qcom,lut-data = <4284 4284 4284 4284 4284>,
				<4242 4242 4242 4242 4242>,
				<4194 4194 4194 4194 4194>,
				<4144 4144 4144 4144 4144>,
				<4094 4094 4094 4094 4094>,
				<4060 4060 4060 4060 4060>,
				<3988 3988 3988 3988 3988>,
				<3959 3959 3959 3959 3959>,
				<3926 3926 3926 3926 3926>,
				<3886 3886 3886 3886 3886>,
				<3848 3848 3848 3848 3848>,
				<3823 3823 3823 3823 3823>,
				<3804 3804 3804 3804 3804>,
				<3788 3788 3788 3788 3788>,
				<3774 3774 3774 3774 3774>,
				<3759 3759 3759 3759 3759>,
				<3738 3738 3738 3738 3738>,
				<3716 3716 3716 3716 3716>,
				<3692 3692 3692 3692 3692>,
				<3686 3686 3686 3686 3686>,
				<3684 3684 3684 3684 3684>,
				<3683 3683 3683 3683 3683>,
				<3681 3681 3681 3681 3681>,
				<3679 3679 3679 3679 3679>,
				<3674 3674 3674 3674 3674>,
				<3663 3663 3663 3663 3663>,
				<3634 3634 3634 3634 3634>,
				<3595 3595 3595 3595 3595>,
				<3547 3547 3547 3547 3547>,
				<3486 3486 3486 3486 3486>,
				<3400 3400 3400 3400 3400>;
	};

	qcom,rbatt-sf-lut {
		qcom,lut-col-legend = <(-20) 0 25 40 60>;
		qcom,lut-row-legend = <100 95 90 85 80>,
				<75 70 65 60 55>,
				<50 45 40 35 30>,
				<25 20 16 13 11>,
				<10 9 8 7 6>,
				<5 4 3 2 1>,
				<0>;
		qcom,lut-data = <909 216 100 85 84>,
				<859 238 106 88 86>,
				<860 237 105 88 86>,
				<808 239 107 90 88>,
				<801 234 111 94 90>,
				<801 230 118 97 92>,
				<801 224 123 100 95>,
				<807 221 128 106 99>,
				<818 221 111 101 97>,
				<841 225 101 88 87>,
				<870 229 101 88 87>,
				<906 235 103 91 90>,
				<950 243 106 93 93>,
				<998 253 110 93 96>,
				<1051 263 113 94 90>,
				<1116 272 113 91 88>,
				<1200 275 111 91 88>,
				<1312 298 108 90 87>,
				<1430 329 104 88 87>,
				<1484 351 107 91 89>,
				<1446 345 110 93 90>,
				<1398 344 112 94 90>,
				<1466 358 115 96 91>,
				<1490 357 117 96 90>,
				<1589 365 117 94 89>,
				<1828 379 111 91 88>,
				<2151 399 111 93 91>,
				<2621 436 117 98 95>,
				<3404 496 130 106 100>,
				<8212 616 150 1906 134>,
				<135251 124940 59087 49820 29672>;
	};
};
