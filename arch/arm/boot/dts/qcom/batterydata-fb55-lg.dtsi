/* Copyright (c) 2015, The Linux Foundation. All rights reserved.
 *
 * This program is free software; you can redistribute it and/or modify
 * it under the terms of the GNU General Public License version 2 and
 * only version 2 as published by the Free Software Foundation.
 *
 * This program is distributed in the hope that it will be useful,
 * but WITHOUT ANY WARRANTY; without even the implied warranty of
 * MERCHANTABILITY or FITNESS FOR A PARTICULAR PURPOSE.  See the
 * GNU General Public License for more details.
 */

qcom,fb55-lg {
	/* #1921003_Moto_FB55_3760mAh_averaged_MasterSlave_May5th2015*/
	qcom,max-voltage-uv = <4400000>;
	qcom,nom-batt-capacity-mah = <3760>;
	qcom,batt-id-kohm = <100>;
	qcom,battery-beta = <3900>;
	qcom,battery-type = "FB55-LG-3760mah";
	qcom,chg-rslow-comp-c1 = <3503636>;
	qcom,chg-rslow-comp-c2 = <5951056>;
	qcom,chg-rs-to-rslow = <1073290>;
	qcom,chg-rslow-comp-thr = <0xB4>;
	qcom,checksum = <0xF9F3>;
	qcom,gui-version = "PMI8994GUI - 2.1.6.5";
	qcom,fg-profile-data = [
		 1D 83 0D 69
		 D6 70 8E 5E
		 4D 83 34 62
		 63 78 A7 7D
		 E7 81 6A 9A
		 B7 BD F1 CB
		 7D 0E 06 88
		 1F 7E 1D 82
		 AD 7C 70 83
		 98 75 5C 8A
		 27 95 4B 82
		 43 98 7C B5
		 BC C0 58 16
		 0A 0F C5 58
		 14 70 30 FB
		 24 4C 9D 45
		 36 4B 00 00
		 5D 45 FC 3B
		 AE 45 00 00
		 00 00 00 00
		 00 00 00 00
		 B9 70 10 70
		 10 64 26 89
		 35 77 48 6A
		 05 6D A9 79
		 CD 75 9F 63
		 83 7E 09 C9
		 12 B5 60 C7
		 5D A0 71 0C
		 28 00 FF 36
		 F0 11 30 03
		 00 00 00 0C
	];
};
