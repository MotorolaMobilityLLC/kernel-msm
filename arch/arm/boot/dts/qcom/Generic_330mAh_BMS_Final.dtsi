
qcom,generic-4v35-330mAh-data {

	qcom,fcc-mah = <330>;
	qcom,default-rbatt-mohm = <796>;
	qcom,rbatt-capacitive-mohm = <0>;
	qcom,flat-ocv-threshold-uv = <3800000>;
	qcom,max-voltage-uv = <4200000>;
	qcom,v-cutoff-uv = <3400000>;
	qcom,chg-term-ua = <100000>;
	qcom,batt-id-kohm = <10>;
	qcom,batt-name = "Generic_330mAh_BMS";
	qcom,battery-type = "Generic_330mAh_BMS";

	qcom,warm-bat-decidegc = <420>;
	qcom,warm-bat-mv = <4100>;
	qcom,ibatmax-warm-ma = <300>;

	qcom,cool-bat-decidegc = <100>;
	qcom,cool-bat-mv = <4200>;
	qcom,ibatmax-cool-ma = <300>;

	qcom,hot-bat-decidegc = <520>;
	qcom,cold-bat-decidegc = <0>;
    
	qcom,rbatt-sf-lut {
		qcom,lut-col-legend = <(-20) 0 25 40 60>;
		qcom,lut-row-legend = <100 95 90 85 80>,
	                    <75 70 65 60 55>,
				        <50 45 40 35 30>,
				        <25 20 16 13 11>,
				        <10 9 8 7 6>,
				        <5 4 3 2 1>,
				        <0>;
		qcom,lut-data = <3929 455 100 65 51>,
				        <3929 455 100 65 51>,
				        <3913 459 104 68 52>,
				        <3916 474 108 70 54>,
				        <3944 490 112 76 56>,
				        <3823 517 118 80 58>,
				        <3849 526 124 85 61>,
		                <3930 520 136 89 66>,
				        <4029 495 124 83 62>,
				        <4205 485 110 73 56>,
				        <4392 497 108 70 55>,
				        <4596 517 111 71 56>,
				        <4834 536 114 74 57>,
				        <5117 559 116 75 57>,
				        <5430 595 117 73 54>,
		                <5779 647 118 73 54>,
				        <6153 698 122 74 54>,
				        <6443 741 125 76 56>,
				        <6702 784 129 78 57>,
				        <6913 833 134 81 58>,
				        <7013 862 137 84 59>,
				        <7156 901 140 87 61>,
				        <7283 940 143 90 62>,
				        <7461 977 146 94 67>,
				        <7701 1012 155 101 77>,
				        <7981 1051 174 109 77>,
				        <8284 1125 196 112 79>,
				        <8767 1233 211 121 84>,
				        <10566 1420 265 160 113>,
				        <16568 2142 530 319 225>,
				        <16568 2142 530 319 225>;
	};
    
 	qcom,fcc-temp-lut {
		qcom,lut-col-legend = <(-20) 0 25 40 60>;
		qcom,lut-data = <326 324 322 319 315>;
	};   
    
	qcom,pc-temp-ocv-lut {
		qcom,lut-col-legend = <(-20) 0 25 40 60>;
		qcom,lut-row-legend = <100 95 90 85 80>,
	                          <75 70 65 60 55>,
				              <50 45 40 35 30>,
				              <25 20 16 13 11>,
		                      <10 9 8 7 6>,
				              <5 4 3 2 1>,
				              <0>;
		qcom,lut-data = <4336 4334 4329 4323 4316>,
				        <4248 4264 4266 4262 4256>,
				        <4180 4208 4210 4208 4202>,
				        <4122 4154 4156 4154 4150>,
				        <4068 4102 4106 4104 4100>,
				        <4004 4053 4056 4056 4052>,
				        <3952 3998 4008 4008 4006>,
				        <3908 3949 3964 3964 3962>,
				        <3870 3905 3917 3918 3916>,
				        <3842 3870 3876 3878 3877>,
				        <3820 3842 3848 3848 3848>,
				        <3802 3820 3824 3824 3824>,
				        <3786 3800 3804 3804 3803>,
				        <3772 3784 3787 3785 3780>,
				        <3756 3770 3770 3764 3754>,
				        <3738 3754 3751 3742 3729>,
				        <3715 3727 3722 3712 3700>,
				        <3692 3705 3694 3684 3674>,
				        <3671 3694 3685 3676 3665>,
				        <3653 3688 3682 3674 3662>,
				        <3642 3684 3680 3671 3658>,
				        <3630 3678 3676 3668 3652>,
				        <3616 3671 3669 3658 3645>,
				        <3600 3658 3652 3640 3622>,
				        <3578 3634 3622 3611 3594>,
				        <3550 3598 3584 3574 3558>,
				        <3512 3549 3537 3530 3508>,
				        <3460 3483 3474 3466 3444>,
				        <3384 3399 3388 3380 3358>,
				        <3260 3272 3260 3258 3230>,
				        <3000 3000 3000 3000 3000>;
                
    	};

};


