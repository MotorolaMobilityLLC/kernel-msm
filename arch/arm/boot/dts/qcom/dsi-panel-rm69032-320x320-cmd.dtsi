/* Copyright (c) 2013-2014, The Linux Foundation. All rights reserved.
 *
 * This program is free software; you can redistribute it and/or modify
 * it under the terms of the GNU General Public License version 2 and
 * only version 2 as published by the Free Software Foundation.
 *
 * This program is distributed in the hope that it will be useful,
 * but WITHOUT ANY WARRANTY; without even the implied warranty of
 * MERCHANTABILITY or FITNESS FOR A PARTICULAR PURPOSE.  See the
 * GNU General Public License for more details.
 */

/*---------------------------------------------------------------------------
 * This file is autogenerated file using gcdb parser. Please do not edit it.
 * Update input XML file to add a new entry or update variable in this file
 * VERSION = "1.0"
 *---------------------------------------------------------------------------*/
&mdss_mdp {
	dsi_rm69032_320x320_cmd: qcom,mdss_dsi_rm69032_320-cmd {
		qcom,mdss-dsi-panel-name = "rm69032 320x320 command mode dsi panel";
		qcom,mdss-dsi-panel-controller = <&mdss_dsi0>;
		qcom,mdss-dsi-panel-type = "dsi_cmd_mode";
		qcom,mdss-dsi-panel-destination = "display_1";
		qcom,mdss-dsi-panel-framerate = <58>;
		qcom,mdss-dsi-virtual-channel-id = <0>;
		qcom,mdss-dsi-stream = <0>;
		qcom,mdss-dsi-panel-width = <320>;
		qcom,mdss-dsi-panel-height = <320>;
		qcom,mdss-pan-physical-height-dimension = <29>;  
		qcom,mdss-pan-physical-width-dimension = <29>;  
		
		qcom,mdss-dsi-h-front-porch = <4>;
		qcom,mdss-dsi-h-back-porch = <4>;
		qcom,mdss-dsi-h-pulse-width = <4>;
		qcom,mdss-dsi-h-sync-skew = <0>;
		qcom,mdss-dsi-v-back-porch = <2>;
		qcom,mdss-dsi-v-front-porch = <2>;
		qcom,mdss-dsi-v-pulse-width = <2>;
		qcom,mdss-dsi-h-left-border = <0>;
		qcom,mdss-dsi-h-right-border = <160>;
		qcom,mdss-dsi-v-top-border = <0>;
		qcom,mdss-dsi-v-bottom-border = <0>;
		qcom,mdss-dsi-bpp = <24>;
		qcom,mdss-dsi-underflow-color = <0xff>;
		qcom,mdss-dsi-border-color = <0>;
		qcom,mdss-dsi-on-command-V2 = [


			39 01 00 00 00 00 06 F0 55 AA 52 08 00
			39 01 00 00 00 00 06 BD 01 90 14 14 00
			39 01 00 00 00 00 06 BE 01 90 14 14 01
			39 01 00 00 00 00 06 BF 01 90 14 14 00
			39 01 00 00 00 00 04 BB 07 07 07
			39 01 00 00 00 00 02 D0 00
			39 01 00 00 00 00 04 D1 00 00 00
			39 01 00 00 00 00 04 D2 00 00 00
			39 01 00 00 00 00 04 D3 00 00 00
			39 01 00 00 00 00 02 C7 40
			39 01 00 00 00 00 06 F0 55 AA 52 08 02
			15 01 00 00 00 00 02 EB 02
			15 01 00 00 00 00 02 F5 10
			39 01 00 00 00 00 09 ED 48 00 E0 13 08 00 0C 00
			39 01 00 00 00 00 09 C7 0F 05 00 0F 43 00 88 22
			39 01 00 00 00 00 03 FE 08 50
			39 01 00 00 00 00 04 C3 F2 15 04
			39 01 00 00 00 00 04 E9 00 36 38
			15 01 00 00 00 00 02 CA 04
			39 01 00 00 00 00 06 F0 55 AA 52 08 01
			39 01 00 00 00 00 04 B0 00 00 00
			39 01 00 00 00 00 04 B1 05 05 05
			39 01 00 00 00 00 04 B2 01 01 01
			39 01 00 00 00 00 04 B4 07 07 07
			39 01 00 00 00 00 04 B5 03 03 03
			39 01 00 00 00 00 04 B6 55 55 55
			39 01 00 00 00 00 04 B7 35 35 35
			39 01 00 00 00 00 04 B8 23 23 23
			39 01 00 00 00 00 04 B9 03 03 03
			39 01 00 00 00 00 04 BA 03 03 03
			39 01 00 00 00 00 04 BE 32 30 70
			39 01 00 00 00 00 0D C2 0B 0B 0B 0B 0B 0B 0B 0B 0B 0B 0B 0B
			39 01 00 00 00 00 08 CF FF D4 95 EF 4F 00 24
			15 01 00 00 00 00 02 35 00
			15 01 00 00 00 00 02 36 00
			15 01 00 00 00 00 02 C0 28
			32 01 00 00 00 00 02 00 00
			39 01 00 00 00 00 06 F0 55 AA 52 08 02
			39 01 00 00 00 00 09 ED 48 00 FF 13 08 30 0C 00

			15 01 00 00 0A 00 02 51 00
			05 01 00 00 FF 00 02 11 00
			39 01 00 00 00 00 06 F0 55 AA 52 08 02
			39 01 00 00 14 00 09 ED 48 00 FE 13 08 30 0C 00
			39 01 00 00 14 00 09 ED 48 00 E6 13 08 30 0C 00
			39 01 00 00 14 00 09 ED 48 00 E2 13 08 30 0C 00
			39 01 00 00 14 00 09 ED 48 00 E0 13 08 30 0C 00
			39 01 00 00 14 00 09 ED 48 00 E0 13 08 00 0C 00
			05 01 00 00 00 00 02 29 00
			39 01 00 00 00 00 06 F0 55 AA 52 08 00
			];
		qcom,mdss-dsi-on-command-V3 = [



			39 01 00 00 00 00 06 F0 55 AA 52 08 00
			39 01 00 00 00 00 06 BD 03 20 14 4B 00
			39 01 00 00 00 00 06 BE 03 20 14 4B 01
			39 01 00 00 00 00 06 BF 03 20 14 4B 00
			39 01 00 00 00 00 04 BB 07 07 07
			39 01 00 00 00 00 02 D0 00
			39 01 00 00 00 00 04 D1 00 00 00
			39 01 00 00 00 00 04 D2 00 00 00
			39 01 00 00 00 00 04 D3 00 00 00
			39 01 00 00 00 00 02 C7 40
			39 01 00 00 00 00 06 F0 55 AA 52 08 02
			15 01 00 00 00 00 02 EB 02
			15 01 00 00 00 00 02 F5 10
			39 01 00 00 00 00 09 ED 48 00 E0 13 08 00 0C 00
			39 01 00 00 00 00 09 C7 0F 05 00 0F 43 00 88 22
			39 01 00 00 00 00 03 FE 08 50
			39 01 00 00 00 00 04 C3 F2 95 04
			39 01 00 00 00 00 04 E9 00 36 38
			15 01 00 00 00 00 02 CA 04
			39 01 00 00 00 00 06 F0 55 AA 52 08 01
			39 01 00 00 00 00 04 B0 03 03 03
			39 01 00 00 00 00 04 B1 05 05 05
			39 01 00 00 00 00 04 B2 01 01 01
			39 01 00 00 00 00 04 B4 07 07 07
			39 01 00 00 00 00 04 B5 03 03 03
			39 01 00 00 00 00 04 B6 55 55 55
			39 01 00 00 00 00 04 B7 36 36 36
			39 01 00 00 00 00 04 B8 23 23 23
			39 01 00 00 00 00 04 B9 03 03 03
			39 01 00 00 00 00 04 BA 03 03 03
			39 01 00 00 00 00 04 BE 32 30 70
			39 01 00 00 00 00 0D C2 0B 0B 0B 0B 0B 0B 0B 0B 0B 0B 0B 0B
			39 01 00 00 00 00 08 CF FF D4 95 E8 4F 00 24
			15 01 00 00 00 00 02 35 00
			15 01 00 00 00 00 02 36 00
			15 01 00 00 00 00 02 C0 28
			32 01 00 00 00 00 02 00 00
			39 01 00 00 00 00 06 F0 55 AA 52 08 02
			39 01 00 00 00 00 09 ED 48 00 FF 13 08 30 0C 00

			15 01 00 00 0A 00 02 51 00
			05 01 00 00 FF 00 02 11 00
			39 01 00 00 00 00 06 F0 55 AA 52 08 02
			39 01 00 00 14 00 09 ED 48 00 FE 13 08 30 0C 00
			39 01 00 00 14 00 09 ED 48 00 E6 13 08 30 0C 00
			39 01 00 00 14 00 09 ED 48 00 E2 13 08 30 0C 00
			39 01 00 00 14 00 09 ED 48 00 E0 13 08 30 0C 00
			39 01 00 00 14 00 09 ED 48 00 E0 13 08 00 0C 00

			05 01 00 00 00 00 02 29 00
			39 01 00 00 00 00 06 F0 55 AA 52 08 00
			];
		qcom,mdss-dsi-off-command = [
					05 01 00 00 32 00 02 28 00
					05 01 00 00 78 00 02 10 00					

					];

		qcom,mdss-dsi-idle-on-command-V2 = [
					39 01 00 00 00 00 06 F0 55 AA 52 08 02
					39 01 00 00 32 00 04 ED 48 00 F0
					39 01 00 00 00 00 06 F0 55 AA 52 08 01					
					39 01 00 00 55 00 0D C2 02 02 02 02 02 02 02 02 02 02 02 02
 					05 01 00 00 00 00 02 39 00
					15 01 00 00 0A 00 02 B3 89
					15 01 00 00 00 00 02 C0 26
					];
		qcom,mdss-dsi-idle-off-command-V2 = [
					39 01 00 00 00 00 06 F0 55 AA 52 08 01
					15 01 00 00 00 00 02 C0 28
					05 01 00 00 3C 00 02 38 00
					15 01 00 00 0A 00 02 B3 00
					39 01 00 00 00 00 0D C2 0B 0B 0B 0B 0B 0B 0B 0B 0B 0B 0B 0B
					39 01 00 00 00 00 06 F0 55 AA 52 08 02
					39 01 00 00 32 00 04 ED 48 00 E0
					39 01 00 00 00 00 06 F0 55 AA 52 08 01					
					];

		qcom,mdss-dsi-idle-on-command = [
					05 01 00 00 64 00 02 39 00
					];
		qcom,mdss-dsi-idle-off-command = [
					05 01 00 00 64 00 02 38 00
					];

		qcom,mdss-dsi-idle-command-state = "dsi_lp_mode";

		qcom,mdss-dsi-on-command-state = "dsi_lp_mode";
		qcom,mdss-dsi-off-command-state = "dsi_hs_mode";
		qcom,mdss-dsi-bllp-eof-power-mode;
		qcom,mdss-dsi-bllp-power-mode;
		qcom,mdss-dsi-lane-map = "lane_map_3012";		
		qcom,mdss-dsi-lane-0-state;
		qcom,mdss-dsi-te-pin-select = <1>;
		qcom,mdss-dsi-te-dcs-command = <1>;
		qcom,mdss-dsi-te-check-enable;
		qcom,mdss-dsi-te-using-te-pin;

		/* By AUO's suggestion: MIPI Clock rate = ~290Mbps. */
		qcom,mdss-dsi-panel-timings = [5D 12 0C 00 32 38 0E 16 0F 03 04 00];

		
		qcom,mdss-dsi-t-clk-post = <0x04>;
		qcom,mdss-dsi-t-clk-pre = <0x1b>;
		qcom,mdss-dsi-bl-min-level = <1>;
		qcom,mdss-dsi-bl-max-level = <255>;
		qcom,mdss-dsi-dma-trigger = "trigger_sw";
		qcom,mdss-dsi-mdp-trigger = "none";
		qcom,mdss-dsi-bl-pmic-control-type = "bl_ctrl_dcs";
		qcom,mdss-dsi-reset-sequence = <1 20>, <0 1>, <1 20>;

	};
};
