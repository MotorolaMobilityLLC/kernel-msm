/* Copyright (c) 2015, Motorola Mobility Inc. All rights reserved.
 *
 * This program is free software; you can redistribute it and/or modify
 * it under the terms of the GNU General Public License version 2 and
 * only version 2 as published by the Free Software Foundation.
 *
 * This program is distributed in the hope that it will be useful,
 * but WITHOUT ANY WARRANTY; without even the implied warranty of
 * MERCHANTABILITY or FITNESS FOR A PARTICULAR PURPOSE.  See the
 * GNU General Public License for more details.
 */


/dts-v1/;

#include "msm8952-athene.dtsi"
#include "msm8952-moto-dtv.dtsi"
#include "dsi-panel-mot-tdi-546-1080p-cmd.dtsi"

/ {
	qcom,board-id = <0x41 0x800d>;
};

&mdss_dsi0 {
	qcom,dsi-pref-prim-pan = <&mot_tdi_546_1080p_cmd_v0>;
};
