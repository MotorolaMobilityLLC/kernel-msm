
qcom,batterydata_HE50cos_r1_5000mAh {
	/* #3280358_LongCheer_HE50Cos_5000mAH_averaged_MasterSlave_Jan22nd2018*/
	qcom,max-voltage-uv = <4400000>;
	qcom,nom-batt-capacity-mah = <5000>;
	qcom,batt-id-kohm = <0>;
	qcom,battery-beta = <3435>;
	qcom,battery-type = "batterydata_HE50cos_r1_5000mAh";
	qcom,chg-rslow-comp-c1 = <3581417>;
	qcom,chg-rslow-comp-c2 = <6138250>;
	qcom,chg-rs-to-rslow = <682227>;
	qcom,chg-rslow-comp-thr = <0xB5>;
	qcom,fg-cc-cv-threshold-mv = <4390>;
	qcom,thermal-coefficients = [DA 86 F0 50 08 3C];
	qcom,checksum = <0x82A7>;
	qcom,gui-version = "PMI8950GUI - 2.0.0.16";
	qcom,fg-profile-data = [
		C1 83 BE 76
		69 7B 13 74
		3B 83 8F 73
		6E 84 28 81
		F7 81 D5 9B
		A0 BF 12 D1
		70 10 F7 83
		0C 7D FE 80
		AF 76 30 83
		1B 7A 2C 8C
		7D 88 22 82
		E4 9B 7B C4
		0A D3 6B 0D
		A9 13 DA 59
		14 70 29 FC
		7E 45 0B 3F
		8A 43 00 00
		72 4C 4A 3B
		3F 39 00 00
		00 00 00 00
		00 00 00 00
		45 6A F7 68
		BD 70 C0 89
		2F 76 50 70
		41 52 A9 7B
		1C 6F 83 68
		69 74 8A A3
		24 B0 5B 6C
		5C A0 71 0C
		28 00 FF 36
		F0 11 30 03
		00 00 00 0C
	];
};
