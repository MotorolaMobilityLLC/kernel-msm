/* Copyright (c) 2013, The Linux Foundation. All rights reserved.
 *
 * This program is free software; you can redistribute it and/or modify
 * it under the terms of the GNU General Public License version 2 and
 * only version 2 as published by the Free Software Foundation.
 *
 * This program is distributed in the hope that it will be useful,
 * but WITHOUT ANY WARRANTY; without even the implied warranty of
 * MERCHANTABILITY or FITNESS FOR A PARTICULAR PURPOSE.  See the
 * GNU General Public License for more details.
 */

/*---------------------------------------------------------------------------
 * This file is autogenerated file using gcdb parser. Please do not edit it.
 * Update input XML file to add a new entry or update variable in this file
 * VERSION = "1.0"
 *---------------------------------------------------------------------------*/
&mdss_mdp {
	dsi_mot_ota3201a_290p_vid: qcom,mdss_dsi_mot_ota3201a_290p_vid {
		qcom,mdss-dsi-panel-name = "mot 290p video mode dsi panel";
		qcom,mdss-dsi-panel-controller = <&mdss_dsi0>;
		qcom,mdss-dsi-panel-type = "dsi_video_mode";
		qcom,mdss-dsi-panel-destination = "display_1";
		qcom,mdss-dsi-panel-framerate = <60>;
		qcom,mdss-dsi-virtual-channel-id = <0>;
		qcom,mdss-dsi-stream = <0>;
		qcom,mdss-dsi-panel-width = <320>;
		qcom,mdss-dsi-panel-height = <290>;
		qcom,mdss-dsi-h-front-porch = <20>;
		qcom,mdss-dsi-h-back-porch = <42>;
		qcom,mdss-dsi-h-pulse-width = <10>;
		qcom,mdss-dsi-h-sync-skew = <0>;
		qcom,mdss-dsi-v-back-porch = <10>;
		qcom,mdss-dsi-v-front-porch = <32>;
		qcom,mdss-dsi-v-pulse-width = <2>;
		qcom,mdss-dsi-h-left-border = <0>;
		qcom,mdss-dsi-h-right-border = <0>;
		qcom,mdss-dsi-v-top-border = <0>;
		qcom,mdss-dsi-v-bottom-border = <0>;
		qcom,mdss-dsi-bpp = <24>;
		qcom,mdss-dsi-underflow-color = <0xff>;
		qcom,mdss-dsi-border-color = <0>;
		qcom,mdss-dsi-init-command = [39 01 00 00 00 00 03 F0 54 47
		15 01 00 00 00 00 02 A0 00
		39 01 00 00 00 00 04 BD 00 11 31
		15 01 00 00 00 00 02 E9 46
		15 01 00 00 00 00 02 B1 12
		15 01 00 00 00 00 02 E2 F5
		39 01 00 00 00 00 05 BA 06 15 2B 01
		39 01 00 00 00 00 06 B3 02 0A 14 2A 2A
		39 01 00 00 00 00 05 B5 78 78 76 F6
		39 01 00 00 00 00 12 C0 00 06 17 11 16 25 0E 0C 0C 0E 0C 2F 07 0A 3F 3F 3F
		39 01 00 00 00 00 12 C1 00 06 17 11 16 25 0E 0C 0C 0E 0C 2F 07 0A 3F 3F 3F
		39 01 00 00 00 00 12 C2 00 06 17 11 16 25 0E 0C 0C 0E 0C 2F 07 0A 3F 3F 3F
		39 01 00 00 00 00 12 C3 00 06 17 11 16 25 0E 0C 0C 0E 0C 2F 07 0A 3F 3F 3F
		39 01 00 00 00 00 12 C4 00 06 17 11 16 25 0E 0C 0C 0E 0C 2F 07 0A 3F 3F 3F
		39 01 00 00 00 00 12 C5 00 06 17 11 16 25 0E 0C 0C 0E 0C 2F 07 0A 3F 3F 3F
		15 01 00 00 00 00 02 A0 80
		39 01 00 00 00 00 03 F0 00 00];
		qcom,mdss-dsi-on-command = [05 01 00 00 78 00 01 11
		05 01 00 00 00 00 01 29];
		qcom,mdss-dsi-off-command = [05 01 00 00 32 00 01 28
		05 01 00 00 14 00 01 10];
		qcom,mdss-dsi-on-command-state = "dsi_lp_mode";
		qcom,mdss-dsi-off-command-state = "dsi_hs_mode";
		qcom,mdss-dsi-h-sync-pulse = <0>;
		qcom,mdss-dsi-traffic-mode = "burst_mode";
		qcom,mdss-dsi-bllp-eof-power-mode;
		qcom,mdss-dsi-bllp-power-mode;
		qcom,mdss-dsi-lane-0-state;
		qcom,mdss-dsi-te-pin-select = <1>;
		qcom,mdss-dsi-te-dcs-command = <1>;
		qcom,mdss-dsi-te-check-enable;
		qcom,mdss-dsi-te-using-te-pin;
		qcom,mdss-dsi-panel-timings = [31 0C 06 00 28 2E 0A 10 09 03 04 00];
		qcom,mdss-dsi-t-clk-post = <0x05>;
		qcom,mdss-dsi-t-clk-pre = <0x0F>;
		qcom,mdss-dsi-dma-trigger = "trigger_sw";
		qcom,mdss-dsi-mdp-trigger = "none";
		qcom,mdss-pan-physical-width-dimension = <40>;
		qcom,mdss-pan-physical-height-dimension = <36>;
		qcom,mdss-dsi-reset-sequence = <0 5>, <1 1>;
		qcom,mdss-dsi-tx-eot-append;
		qcom,cont-splash-enabled;
		qcom,mdss-backlight-disabled;
	};
};
