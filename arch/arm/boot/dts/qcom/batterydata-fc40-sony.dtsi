/* Copyright (c) 2014-2015, The Linux Foundation. All rights reserved.
 *
 * This program is free software; you can redistribute it and/or modify
 * it under the terms of the GNU General Public License version 2 and
 * only version 2 as published by the Free Software Foundation.
 *
 * This program is distributed in the hope that it will be useful,
 * but WITHOUT ANY WARRANTY; without even the implied warranty of
 * MERCHANTABILITY or FITNESS FOR A PARTICULAR PURPOSE.  See the
 * GNU General Public License for more details.
 */

maxim,fc40-sony-batterydata {
	/* Required properties */
	serialnum	= "SNN5959";

	/* Table from Maxim for FC40 Sony 2418 mAhr Battery */
	config		= /bits/ 16 <0x0254>;
	full_soc_thresh	= /bits/ 16 <0x5F00>;	/* app note constant */
	design_cap	= /bits/ 16 <4836>;	/* mAh times 2 */
	ichgt_term	= /bits/ 16 <0x0319>;	/* battery attribute */
	learn_cfg	= /bits/ 16 <0x2607>;	/* app note constant */
	filter_cfg	= /bits/ 16 <0x87A4>;	/* app note constant */
	relax_cfg	= /bits/ 16 <0x203B>;
	fullcap		= /bits/ 16 <4836>;	/* mAh times 2 */
	fullcapnom	= /bits/ 16 <4836>;	/* mAh times 2 */
	lavg_empty	= /bits/ 16 <0x0F1D>;   /* (2418mA/4/0.15625mA) */
	qrtbl00		= /bits/ 16 <0x2302>;	/* battery attribute */
	qrtbl10		= /bits/ 16 <0x0F82>;	/* battery attribute */
	qrtbl20		= /bits/ 16 <0x0586>;	/* battery attribute */
	qrtbl30		= /bits/ 16 <0x0585>;	/* battery attribute */
	rcomp0 		= /bits/ 16 <0x0076>;	/* battery attribute */
	tcompc0		= /bits/ 16 <0x1A2E>;	/* battery attribute */
	maxim,cell-char-tbl = /bits/ 16 <	/* battery attribute */
		0x7d00 0xa6e0 0xb6f0 0xb920 0xbae0 0xbca0
		0xbd60 0xbe20 0xbfc0 0xc2c0 0xc550 0xc7a0
		0xca00 0xcce0 0xd1f0 0xd730 0x0020 0x01b0
		0x0f70 0x0c70 0x14a0 0x1c00 0x1c00 0x15e0
		0x0cf0 0x0980 0x0890 0x09a0 0x07f0 0x07b0
		0x06a0 0x06a0 0x0100 0x0100 0x0100 0x0100
		0x0100 0x0100 0x0100 0x0100 0x0100 0x0100
		0x0100 0x0100 0x0100 0x0100 0x0100 0x0100
	>;
	/* Optional properties */
	tgain		= /bits/ 16 <0xE71C>;	/* thermistor attribute */
	toff		= /bits/ 16 <0x251A>;	/* thermistor attribute */
	cgain		= /bits/ 16 <0x4000>;	/* current sense attribute */
	misc_cfg	= /bits/ 16 <0x0170>;
	rev		= /bits/ 16 <0x0003>;
};
