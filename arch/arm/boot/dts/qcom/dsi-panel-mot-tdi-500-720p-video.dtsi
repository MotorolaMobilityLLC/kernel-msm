/* Copyright (c) 2015, Motorola Mobility LLC. All rights reserved.
 *
 * This program is free software; you can redistribute it and/or modify
 * it under the terms of the GNU General Public License version 2 and
 * only version 2 as published by the Free Software Foundation.
 *
 * This program is distributed in the hope that it will be useful,
 * but WITHOUT ANY WARRANTY; without even the implied warranty of
 * MERCHANTABILITY or FITNESS FOR A PARTICULAR PURPOSE.  See the
 * GNU General Public License for more details.
 */

&mdss_mdp {
	mot_tdi_500_720p_vid_v0: qcom,mdss_dsi_mot_tdi_500_720p_video_v0 {
		#include "dsi-panel-mot-tdi-500-720p-video-common.dtsi"
	};
};

&mot_tdi_500_720p_vid_v0 {
	qcom,mdss-dsi-panel-name = "mipi_mot_video_tdi_720p_500_v0";
};
