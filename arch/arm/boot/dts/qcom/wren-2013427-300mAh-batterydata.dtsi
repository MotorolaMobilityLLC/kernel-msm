/* Copyright (c) 2013-2014, The Linux Foundation. All rights reserved.
 *
 * This program is free software; you can redistribute it and/or modify
 * it under the terms of the GNU General Public License version 2 and
 * only version 2 as published by the Free Software Foundation.
 *
 * This program is distributed in the hope that it will be useful,
 * but WITHOUT ANY WARRANTY; without even the implied warranty of
 * MERCHANTABILITY or FITNESS FOR A PARTICULAR PURPOSE.  See the
 * GNU General Public License for more details.
 */

qcom,palladium-batterydata {
	qcom,fcc-mah = <300>;
	qcom,default-rbatt-mohm = <594>;
	qcom,rbatt-capacitive-mohm = <50>;
	qcom,flat-ocv-threshold-uv = <3800000>;
	qcom,max-voltage-uv = <4400000>;
	qcom,v-cutoff-uv = <3400000>;
	qcom,chg-term-ua = <20000>;
	qcom,batt-id-kohm = <75>;
	qcom,battery-type = "palladium_1500mah";

	qcom,fcc-temp-lut {
		qcom,lut-col-legend = <(-20) 0 10 25 40 60>;
		qcom,lut-data = <298 298 298 299 299 298>;
	};

	qcom,pc-temp-ocv-lut {
		qcom,lut-col-legend = <(-20) 0 10 25 40 60>;
		qcom,lut-row-legend = <100 95 90 85 80>,
				<75 70 65 60 55>,
				<50 45 40 35 30>,
				<25 20 16 13 11>,
				<10 9 8 7 6>,
				<5 4 3 2 1>,
				<0>;
		qcom,lut-data = <4397 4394 4390 4384 4380 4372>,
				<4296 4316 4316 4316 4314 4310>,
				<4224 4255 4256 4256 4255 4250>,
				<4164 4196 4198 4200 4198 4194>,
				<4108 4139 4144 4144 4142 4138>,
				<4072 4085 4090 4092 4088 4086>,
				<3968 4030 4037 4044 4042 4035>,
				<3915 3950 3957 3978 3988 3988>,
				<3876 3921 3926 3933 3941 3941>,
				<3841 3889 3890 3892 3893 3893>,
				<3815 3855 3858 3859 3859 3858>,
				<3795 3826 3830 3832 3832 3831>,
				<3778 3802 3807 3810 3810 3809>,
				<3763 3780 3786 3792 3790 3789>,
				<3750 3759 3774 3776 3773 3764>,
				<3736 3744 3762 3758 3750 3736>,
				<3720 3734 3742 3736 3726 3714>,
				<3704 3724 3719 3712 3702 3689>,
				<3687 3714 3707 3698 3688 3676>,
				<3673 3706 3700 3692 3684 3672>,
				<3665 3702 3696 3690 3682 3670>,
				<3654 3696 3693 3686 3678 3666>,
				<3642 3688 3688 3680 3671 3654>,
				<3626 3673 3675 3660 3648 3629>,
				<3602 3644 3646 3624 3612 3595>,
				<3568 3599 3603 3580 3573 3558>,
				<3519 3540 3550 3534 3530 3514>,
				<3447 3472 3492 3481 3474 3453>,
				<3340 3396 3422 3406 3392 3364>,
				<3204 3286 3308 3282 3260 3222>,
				<3000 3000 3000 3000 3000 3000>;
	};

	qcom,rbatt-sf-lut {
		qcom,lut-col-legend = <(-20) 0 10 25 40 60>;
		qcom,lut-row-legend = <100 95 90 85 80>,
				<75 70 65 60 55>,
				<50 45 40 35 30>,
				<25 20 16 13 11>,
				<10 9 8 7 6>,
				<5 4 3 2 1>;
		qcom,lut-data = <632 280 217 100 74 60>,
				<632 280 217 100 74 60>,
				<636 282 222 102 77 62>,
				<635 277 214 105 79 64>,
				<655 273 213 106 80 67>,
				<692 271 209 106 81 68>,
				<689 273 206 109 84 69>,
				<733 262 197 104 83 69>,
				<800 269 207 100 79 67>,
				<874 267 201 97 74 63>,
				<976 266 200 98 75 64>,
				<1097 269 202 99 78 67>,
				<1239 273 206 101 79 69>,
				<1398 282 212 102 80 70>,
				<1582 307 227 103 80 67>,
				<1798 364 251 103 78 64>,
				<2061 462 280 105 79 65>,
				<2227 536 298 106 78 64>,
				<2296 562 319 109 80 65>,
				<2177 502 298 112 83 68>,
				<1866 355 244 103 78 67>,
				<1467 274 197 100 78 66>,
				<1623 285 199 100 78 65>,
				<1782 290 201 98 75 64>,
				<1979 301 204 97 75 65>,
				<2292 322 213 101 79 69>,
				<2732 365 226 107 84 71>,
				<3454 427 239 113 87 72>,
				<5426 474 307 120 90 76>,
				<10851 947 615 143 110 101>;
	};
};
