/*
 * Copyright (c) 2015, The Linux Foundation. All rights reserved.
 *
 * This program is free software; you can redistribute it and/or modify
 * it under the terms of the GNU General Public License version 2 and
 * only version 2 as published by the Free Software Foundation.
 *
 * This program is distributed in the hope that it will be useful,
 * but WITHOUT ANY WARRANTY; without even the implied warranty of
 * MERCHANTABILITY or FITNESS FOR A PARTICULAR PURPOSE.  See the
 * GNU General Public License for more details.
 */

/dts-v1/;

#include "msm8909-mtp.dtsi"
#include "msm8909-pm8916.dtsi"
#include "msm8909-pm8916-mtp.dtsi"

/ {
	model = "Qualcomm Technologies, Inc. MSM8909W-PM8916 MTP";
	compatible = "qcom,msm8909-mtp", "qcom,msm8909", "qcom,mtp";
	qcom,msm-id =   <245 0>,
			<258 0>,
			<275 0>;
	qcom,board-id= <8 0x105>;
};

&mdss_dsi0 {
	qcom,dsi-pref-prim-pan = <&dsi_hx8394d_480_vid>;
};
