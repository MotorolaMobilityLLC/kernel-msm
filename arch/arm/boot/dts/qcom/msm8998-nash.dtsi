/* Copyright (c) 2016, Motorola Mobility Inc. All rights reserved.
 *
 * This program is free software; you can redistribute it and/or modify
 * it under the terms of the GNU General Public License version 2 and
 * only version 2 as published by the Free Software Foundation.
 *
 * This program is distributed in the hope that it will be useful,
 * but WITHOUT ANY WARRANTY; without even the implied warranty of
 * MERCHANTABILITY or FITNESS FOR A PARTICULAR PURPOSE.  See the
 * GNU General Public License for more details.
 */

/*
 * Assuming there will be NO more Nash boards built with V1 MSM parts
 * beyond the small amount of early EVT1 boards, all future Nash dts
 * should directly include this file instead of msm8998-nash-common.dtsi,
 * though common dt changes could go to msm8998-nash-common.dtsi
 */

#include "msm8998-v2.dtsi"
#include "msm8998-nash-common.dtsi"

&ssphy {
	qcom,qmp-phy-init-seq =
		/* <reg_offset, value, delay> */
		<0x138 0x30 0x00
		 0x034 0x04 0x01
		 0x080 0x14 0x00
		 0x03c 0x06 0x00
		 0x08c 0x08 0x00
		 0x15c 0x06 0x00
		 0x164 0x01 0x00
		 0x13c 0x80 0x00
		 0x0b0 0x82 0x00
		 0x0b8 0xab 0x00
		 0x0bc 0xea 0x00
		 0x0c0 0x02 0x00
		 0x060 0x06 0x00
		 0x068 0x16 0x00
		 0x070 0x36 0x00
		 0x0dc 0x00 0x00
		 0x0d8 0x3f 0x00
		 0x0f8 0x01 0x00
		 0x0f4 0xc9 0x00
		 0x148 0x0a 0x00
		 0x0a0 0x00 0x00
		 0x09c 0x34 0x00
		 0x098 0x15 0x00
		 0x090 0x04 0x00
		 0x154 0x00 0x00
		 0x094 0x00 0x00
		 0x0f0 0x00 0x00
		 0x00c 0x0a 0x00
		 0x048 0x07 0x00
		 0x0d0 0x80 0x00
		 0x184 0x01 0x00
		 0x010 0x01 0x00
		 0x01c 0x31 0x00
		 0x020 0x01 0x00
		 0x014 0x00 0x00
		 0x018 0x00 0x00
		 0x024 0x85 0x00
		 0x028 0x07 0x00
		 0x430 0x0b 0x00
		 0x4d4 0x0f 0x00
		 0x4d8 0x4e 0x00
		 0x4dc 0x18 0x00
		 0x4f8 0x07 0x00
		 0x4fc 0x80 0x00
		 0x504 0x43 0x00
		 0x50c 0x1c 0x00
		 0x434 0x75 0x00
		 0x43c 0x00 0x00
		 0x440 0x00 0x00
		 0x444 0x80 0x00
		 0x408 0x0a 0x00
		 0x414 0x06 0x00
		 0x500 0x00 0x00
		 0x4c0 0x03 0x00
		 0x564 0x05 0x00
		 0x830 0x0b 0x00
		 0x8d4 0x0f 0x00
		 0x8d8 0x4e 0x00
		 0x8dc 0x18 0x00
		 0x8f8 0x07 0x00
		 0x8fc 0x80 0x00
		 0x904 0x43 0x00
		 0x90c 0x1c 0x00
		 0x834 0x75 0x00
		 0x83c 0x00 0x00
		 0x840 0x00 0x00
		 0x844 0x80 0x00
		 0x808 0x0a 0x00
		 0x814 0x06 0x00
		 0x900 0x00 0x00
		 0x8c0 0x03 0x00
		 0x964 0x05 0x00
		 0x260 0x10 0x00
		 0x2a4 0x12 0x00
		 0x28c 0x16 0x00
		 0x244 0x00 0x00
		 0x660 0x10 0x00
		 0x6a4 0x12 0x00
		 0x68c 0x16 0x00
		 0x644 0x00 0x00
		 0xcc8 0x83 0x00
		 0xccc 0x09 0x00
		 0xcd0 0xa2 0x00
		 0xcd4 0x40 0x00
		 0xcc4 0x02 0x00
		 0xc80 0xd1 0x00
		 0xc84 0x1f 0x00
		 0xc88 0x47 0x00
		 0xc64 0x1b 0x00
		 0xc0c 0x9f 0x00
		 0xc10 0x9f 0x00
		 0xc14 0xb7 0x00
		 0xc18 0x4e 0x00
		 0xc1c 0x65 0x00
		 0xc20 0x6b 0x00
		 0xc24 0x15 0x00
		 0xc28 0x0d 0x00
		 0xc2c 0x15 0x00
		 0xc30 0x0d 0x00
		 0xc34 0x15 0x00
		 0xc38 0x0d 0x00
		 0xc3c 0x15 0x00
		 0xc40 0x0d 0x00
		 0xc44 0x15 0x00
		 0xc48 0x0d 0x00
		 0xc4c 0x15 0x00
		 0xc50 0x0d 0x00
		 0xc5c 0x02 0x00
		 0xca0 0x04 0x00
		 0xc8c 0x44 0x00
		 0xc70 0xe7 0x00
		 0xc74 0x03 0x00
		 0xc78 0x40 0x00
		 0xc7c 0x00 0x00
		 0xdd8 0x8a 0x00
		 0xcb8 0x75 0x00
		 0xcb0 0x86 0x00
		 0xcbc 0x13 0x00
		 0x61c 0x22 0x00
		 0xffffffff 0xffffffff 0x00>;
};
