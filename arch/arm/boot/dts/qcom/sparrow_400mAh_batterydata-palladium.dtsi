/* Copyright (c) 2013-2014, The Linux Foundation. All rights reserved.
 *
 * This program is free software; you can redistribute it and/or modify
 * it under the terms of the GNU General Public License version 2 and
 * only version 2 as published by the Free Software Foundation.
 *
 * This program is distributed in the hope that it will be useful,
 * but WITHOUT ANY WARRANTY; without even the implied warranty of
 * MERCHANTABILITY or FITNESS FOR A PARTICULAR PURPOSE.  See the
 * GNU General Public License for more details.
 */

qcom,palladium-batterydata {
	qcom,fcc-mah = <400>;
	qcom,default-rbatt-mohm = <474>;
	qcom,rbatt-capacitive-mohm = <50>;
	qcom,flat-ocv-threshold-uv = <3800000>;
	qcom,max-voltage-uv = <4400000>;
	qcom,v-cutoff-uv = <3400000>;
	qcom,chg-term-ua = <35000>;
	qcom,batt-id-kohm = <75>;
	qcom,battery-type = "palladium_1500mah";

	qcom,fcc-temp-lut {
		qcom,lut-col-legend = <(-20) (-10) 0 25 40 60>;
		qcom,lut-data = <403 404 404 404 404 404>;
	};

	qcom,pc-temp-ocv-lut {
		qcom,lut-col-legend = <(-20) (-10) 0 25 40 60>;
		qcom,lut-row-legend = <100 95 90 85 80>,
				<75 70 65 60 55>,
				<50 45 40 35 30>,
				<25 20 16 13 11>,
				<10 9 8 7 6>,
				<5 4 3 2 1>,
				<0>;
		qcom,lut-data = <4396 4394 4392 4384 4378 4372>,
				<4288 4308 4314 4318 4315 4310>,
				<4220 4246 4254 4258 4256 4250>,
				<4163 4190 4199 4202 4200 4194>,
				<4108 4137 4147 4147 4144 4140>,
				<4071 4089 4096 4094 4092 4088>,
				<3964 4031 4050 4052 4048 4038>,
				<3916 3940 3958 3980 3990 3990>,
				<3878 3907 3920 3944 3947 3945>,
				<3844 3875 3888 3897 3898 3896>,
				<3824 3844 3856 3862 3862 3860>,
				<3809 3818 3828 3834 3836 3834>,
				<3796 3800 3807 3814 3813 3811>,
				<3782 3788 3790 3794 3794 3791>,
				<3768 3776 3778 3777 3774 3766>,
				<3752 3760 3765 3758 3749 3737>,
				<3735 3742 3746 3736 3726 3714>,
				<3718 3725 3724 3713 3703 3690>,
				<3702 3712 3708 3694 3686 3674>,
				<3689 3704 3701 3690 3682 3670>,
				<3680 3699 3698 3690 3682 3670>,
				<3670 3694 3696 3688 3680 3667>,
				<3655 3688 3692 3684 3676 3662>,
				<3635 3676 3684 3674 3663 3646>,
				<3604 3654 3662 3649 3635 3614>,
				<3562 3618 3624 3608 3594 3573>,
				<3502 3566 3574 3560 3546 3524>,
				<3424 3501 3511 3500 3485 3461>,
				<3328 3418 3432 3418 3399 3370>,
				<3216 3298 3310 3283 3258 3224>,
				<3000 3000 3000 3000 3000 3000>;
	};

	qcom,rbatt-sf-lut {
		qcom,lut-col-legend = <(-20) 0 25 40 60>;
		qcom,lut-row-legend = <100 95 90 85 80>,
				<75 70 65 60 55>,
				<50 45 40 35 30>,
				<25 20 16 13 11>,
				<10 9 8 7 6>,
				<5 4 3 2 1>,
				<0>;
		qcom,lut-data = <1859 726 327 100 74 61>,
				<1859 726 327 100 74 61>,
				<1715 718 328 101 74 61>,
				<1621 709 330 103 76 62>,
				<1560 713 340 107 78 65>,
				<1565 725 341 112 84 67>,
				<1406 722 378 124 92 70>,
				<1401 627 317 126 96 73>,
				<1403 642 309 128 95 75>,
				<1404 650 306 106 82 67>,
				<1441 650 301 99 75 63>,
				<1495 660 303 100 77 64>,
				<1557 688 307 103 79 67>,
				<1620 732 313 106 83 70>,
				<1695 783 335 107 82 68>,
				<1778 845 357 102 75 63>,
				<1877 914 377 101 74 62>,
				<1965 981 399 101 75 62>,
				<2030 1039 414 100 74 62>,
				<1966 1018 411 101 76 64>,
				<1946 1008 417 103 77 65>,
				<1997 1043 425 105 80 66>,
				<2062 1077 438 109 81 66>,
				<2174 1110 454 110 80 66>,
				<2451 1146 461 108 80 67>,
				<2837 1188 472 112 86 74>,
				<3360 1257 503 123 98 84>,
				<4207 1350 541 138 109 92>,
				<6984 1538 592 154 119 101>,
				<13968 2859 726 211 175 192>;
	};
};
