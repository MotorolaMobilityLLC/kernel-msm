/* Copyright (c) 2015, Motorola Mobility Inc. All rights reserved.
 *
 * This program is free software; you can redistribute it and/or modify
 * it under the terms of the GNU General Public License version 2 and
 * only version 2 as published by the Free Software Foundation.
 *
 * This program is distributed in the hope that it will be useful,
 * but WITHOUT ANY WARRANTY; without even the implied warranty of
 * MERCHANTABILITY or FITNESS FOR A PARTICULAR PURPOSE.  See the
 * GNU General Public License for more details.
 */

/dts-v1/;

#include "msm8937-cedric.dtsi"

/ {
	qcom,board-id = <0x41 0x8200>;
};

&i2c_2 {
	sx9310@28 {
		cap_vdd-supply = <&pm8937_l10>;
	};
};

&pm8937_l22 {
	regulator-always-on;
	regulator-boot-on;
};
