/* Copyright (c) 2012-2014, The Linux Foundation. All rights reserved.
 * Copyright (c) 2014 Motorola Mobility LLC
 *
 * This program is free software; you can redistribute it and/or modify
 * it under the terms of the GNU General Public License version 2 and
 * only version 2 as published by the Free Software Foundation.
 *
 * This program is distributed in the hope that it will be useful,
 * but WITHOUT ANY WARRANTY; without even the implied warranty of
 * MERCHANTABILITY or FITNESS FOR A PARTICULAR PURPOSE.  See the
 * GNU General Public License for more details.
 */

&mdss_mdp {
	mot_smd_598_1080p_cmd_v0: qcom,mdss_dsi_mot_smd_598_1080p_cmd_v0 {
		compatible = "qcom,mdss-dsi-panel";

		qcom,mdss-dsi-te-pin-select = <1>;
		qcom,mdss-dsi-te-check-enable;
		qcom,mdss-dsi-te-using-te-pin;
		qcom,mdss-dsi-te-dcs-command = <1>;

		/* Disable ESD for now, reading fails while in command mode */
		qcom,panel-esd-detect-disable;
		qcom,panel-esd-power-mode-chk = <0x94>;

		qcom,mdss-dsi-panel-name = "mipi_mot_cmd_smd_598_1080_v0";
		qcom,mdss-dsi-panel-controller = <&mdss_dsi0>;
		qcom,mdss-dsi-panel-type = "dsi_cmd_mode";
		qcom,mdss-dsi-panel-destination = "display_1";
		qcom,mdss-dsi-panel-framerate = <60>;
		qcom,mdss-dsi-virtual-channel-id = <0>;
		qcom,mdss-dsi-stream = <0>;
		qcom,mdss-dsi-panel-width = <1080>;
		qcom,mdss-dsi-panel-height = <1920>;
		qcom,mdss-pan-physical-width-dimension = <75>;
		qcom,mdss-pan-physical-height-dimension = <132>;

		qcom,mdss-dsi-h-front-porch = <144>;
		qcom,mdss-dsi-h-back-porch = <32>;
		qcom,mdss-dsi-h-pulse-width = <12>;
		qcom,mdss-dsi-h-sync-skew = <0>;
		qcom,mdss-dsi-v-back-porch = <3>;
		qcom,mdss-dsi-v-front-porch = <9>;
		qcom,mdss-dsi-v-pulse-width = <4>;
		qcom,mdss-dsi-h-left-border = <0>;
		qcom,mdss-dsi-h-right-border = <0>;
		qcom,mdss-dsi-v-top-border = <0>;
		qcom,mdss-dsi-v-bottom-border = <0>;
		qcom,mdss-dsi-bpp = <24>;
		qcom,mdss-dsi-underflow-color = <0xff>;
		qcom,mdss-dsi-border-color = <0>;

		qcom,mdss-dsi-on-command = [
				05 01 00 00 78 00 01 11		/* exit sleep mode */
				29 01 00 00 00 00 03 f0 5a 5a   /* Level 2*/
				29 01 00 00 00 00 03 fc 5a 5a   /* Level 3 */
				15 01 00 00 00 00 02 b0 04      /* Sleep-in mem retention offset */
				15 01 00 00 00 00 02 fd 0c      /* Sleep-in mem retention en */
				15 01 00 00 00 00 02 b0 03      /* porch offset */
				29 01 00 00 00 00 03 f2 05 0b   /* vertical porch fix */
				15 01 00 00 01 00 02 35 00	/* enable_te */
				15 01 00 00 01 00 02 51 00	/* brightness_ctrl */
				15 01 00 00 01 00 02 55 03	/* acl_enable_disable_settings */
				15 01 00 00 01 00 02 53 20	/* disp_ctrl */
				39 01 00 00 00 00 05 2a 00 00 04 37 /* normal col */
				39 01 00 00 00 00 05 2b 00 00 07 7f /* normal row */
				39 01 00 00 00 00 05 30 00 00 07 7f /* viewable region */
				05 01 00 00 00 00 01 29];	/* display on */

		qcom,mdss-dsi-off-command = [
				05 01 00 00 0a 00 01 28		/* display_off */
				05 01 00 00 78 00 01 10];	/* enter sleep mode */

		qcom,mdss-dsi-on-command-state = "dsi_lp_mode";
		qcom,mdss-dsi-off-command-state = "dsi_hs_mode";
		qcom,mdss-dsi-h-sync-pulse = <0>;
		qcom,mdss-dsi-traffic-mode = "non_burst_sync_event";
		qcom,mdss-dsi-bllp-eof-power-mode;
		qcom,mdss-dsi-bllp-power-mode;
		qcom,mdss-dsi-lane-0-state;
		qcom,mdss-dsi-lane-1-state;
		qcom,mdss-dsi-lane-2-state;
		qcom,mdss-dsi-lane-3-state;
		qcom,mdss-dsi-tx-eot-append;
		qcom,mdss-dsi-panel-timings = [b0 23 1b 00 94 93 1e 25 15 03 04 00];
		qcom,mdss-dsi-lp11-init;
		qcom,mdss-dsi-t-clk-post = <0x04>;
		qcom,mdss-dsi-t-clk-pre = <0x1b>;
		qcom,mdss-dsi-bl-min-level = <1>;
		qcom,mdss-dsi-bl-max-level = <255>;
		qcom,mdss-dsi-dma-trigger = "trigger_sw";
		qcom,mdss-dsi-mdp-trigger = "none";
		qcom,mdss-dsi-bl-pmic-control-type = "bl_ctrl_dcs";

		qcom,mdss-dsi-hbm-on-command = [
				15 01 00 00 00 00 02 53 e0];
		qcom,mdss-dsi-hbm-off-command = [
				15 01 00 00 00 00 02 53 20];

		qcom,panel-en-reset-sequence = <1 11>;
		qcom,panel-dis-reset-sequence = <0 1>;
	};
};
