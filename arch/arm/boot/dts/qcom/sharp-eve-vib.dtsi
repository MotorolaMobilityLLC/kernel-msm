/* Copyright (c) 2016, The Linux Foundation. All rights reserved.
 *
 * This program is free software; you can redistribute it and/or modify
 * it under the terms of the GNU General Public License version 2 and
 * only version 2 as published by the Free Software Foundation.
 *
 * This program is distributed in the hope that it will be useful,
 * but WITHOUT ANY WARRANTY; without even the implied warranty of
 * MERCHANTABILITY or FITNESS FOR A PARTICULAR PURPOSE.  See the
 * GNU General Public License for more details.
 */

&spmi_bus {
	qcom,pmi8950@3 {
		pmi8950_haptic: qcom,haptic@c000 {
			qcom,wave-play-rate-us = <4255>;
			qcom,actuator-type = "lra";
			qcom,wave-shape = "sine";
			qcom,vmax-mv = <2204>;
			qcom,brake-pattern = [03 02 01 00];
			qcom,lra-high-z = "opt1";
			qcom,lra-auto-res-mode = "qwd";
			qcom,lra-res-cal-period = <4>;
			qcom,correct-lra-drive-freq;
		};
	};
};
