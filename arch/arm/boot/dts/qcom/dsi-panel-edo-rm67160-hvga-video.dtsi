/* Copyright (c) 2013, The Linux Foundation. All rights reserved.
 *
 * This program is free software; you can redistribute it and/or modify
 * it under the terms of the GNU General Public License version 2 and
 * only version 2 as published by the Free Software Foundation.
 *
 * This program is distributed in the hope that it will be useful,
 * but WITHOUT ANY WARRANTY; without even the implied warranty of
 * MERCHANTABILITY or FITNESS FOR A PARTICULAR PURPOSE.  See the
 * GNU General Public License for more details.
 */

/*---------------------------------------------------------------------------
 * This file is autogenerated file using gcdb parser. Please do not edit it.
 * Update input XML file to add a new entry or update variable in this file
 * VERSION = "1.0"
 *---------------------------------------------------------------------------*/
&mdss_mdp {
	dsi_edo_rm67160_hvga_video: qcom,mdss_dsi_edo_rm67160_hvga_video {
		qcom,mdss-dsi-panel-name = "edo rm67160 hvga video mode dsi panel";
		qcom,mdss-dsi-panel-controller = <&mdss_dsi0>;
		qcom,mdss-dsi-panel-type = "dsi_cmd_mode";
		qcom,mdss-dsi-panel-destination = "display_1";
		qcom,mdss-dsi-panel-framerate = <60>;
		qcom,mdss-dsi-virtual-channel-id = <0>;
		qcom,mdss-dsi-stream = <0>;
		qcom,mdss-dsi-panel-width = <400>;
		qcom,mdss-dsi-panel-height = <400>;
		qcom,mdss-dsi-h-front-porch = <40>;
		qcom,mdss-dsi-h-back-porch = <40>;
		qcom,mdss-dsi-h-pulse-width = <20>;
		qcom,mdss-dsi-h-sync-skew = <0>;
		qcom,mdss-dsi-v-back-porch = <18>;
		qcom,mdss-dsi-v-front-porch = <18>;
		qcom,mdss-dsi-v-pulse-width = <2>;
		qcom,mdss-dsi-h-left-border = <0>;
		qcom,mdss-dsi-h-right-border = <0>;
		qcom,mdss-dsi-v-top-border = <0>;
		qcom,mdss-dsi-v-bottom-border = <0>;
		qcom,mdss-dsi-bpp = <24>;
		qcom,mdss-dsi-color-order = "rgb_swap_rgb";
		qcom,mdss-dsi-underflow-color = <0xff>;
		qcom,mdss-dsi-border-color = <0>;
		qcom,mdss-dsi-panel-orientation = "vflip";
		qcom,mdss-dsi-on-command = [15 01 00 00 01 00 02 00 00
			15 01 00 00 00 00 02 FE 04
			15 01 00 00 00 00 02 00 DC
			15 01 00 00 00 00 02 01 00
			15 01 00 00 00 00 02 02 02
			15 01 00 00 00 00 02 03 00
			15 01 00 00 00 00 02 04 00
			15 01 00 00 00 00 02 05 03
			15 01 00 00 00 00 02 06 16
			15 01 00 00 00 00 02 07 13
			15 01 00 00 00 00 02 08 08
			15 01 00 00 00 00 02 09 DC
  		15 01 00 00 00 00 02 0A 00
			15 01 00 00 00 00 02 0B 02
			15 01 00 00 00 00 02 0C 00
			15 01 00 00 00 00 02 0D 00
			15 01 00 00 00 00 02 0E 02
			15 01 00 00 00 00 02 0F 16
			15 01 00 00 00 00 02 10 18
			15 01 00 00 00 00 02 11 08
			15 01 00 00 00 00 02 12 92
			15 01 00 00 00 00 02 13 00
			15 01 00 00 00 00 02 14 02
			15 01 00 00 00 00 02 15 05
			15 01 00 00 00 00 02 16 40
			15 01 00 00 00 00 02 17 03
			15 01 00 00 00 00 02 18 16
			15 01 00 00 00 00 02 19 D7
			15 01 00 00 00 00 02 1A 01
			15 01 00 00 00 00 02 1B DC
			15 01 00 00 00 00 02 1C 00
			15 01 00 00 00 00 02 1D 04
			15 01 00 00 00 00 02 1E 00
			15 01 00 00 00 00 02 1F 00
			15 01 00 00 00 00 02 20 03
			15 01 00 00 00 00 02 21 16
			15 01 00 00 00 00 02 22 18
			15 01 00 00 00 00 02 23 08
			15 01 00 00 00 00 02 24 DC
			15 01 00 00 00 00 02 25 00
			15 01 00 00 00 00 02 26 04
			15 01 00 00 00 00 02 27 00
			15 01 00 00 00 00 02 28 00
			15 01 00 00 00 00 02 29 01
			15 01 00 00 00 00 02 2A 16
			15 01 00 00 00 00 02 2B 18
			15 01 00 00 00 00 02 2D 08
			15 01 00 00 00 00 02 4C 99
			15 01 00 00 00 00 02 4D 00
			15 01 00 00 00 00 02 4E 00
			15 01 00 00 00 00 02 4F 00
			15 01 00 00 00 00 02 50 01
			15 01 00 00 00 00 02 51 0A
			15 01 00 00 00 00 02 52 00
			15 01 00 00 00 00 02 5A E4
			15 01 00 00 00 00 02 5E 77
			15 01 00 00 00 00 02 5F 77
			15 01 00 00 00 00 02 60 34
			15 01 00 00 00 00 02 61 02
			15 01 00 00 00 00 02 62 81
			15 01 00 00 00 00 02 FE 07
			15 01 00 00 00 00 02 07 4F
			15 01 00 00 00 00 02 FE 01
			15 01 00 00 00 00 02 05 15
			15 01 00 00 00 00 02 0E 84
			15 01 00 00 00 00 02 10 51
			15 01 00 00 00 00 02 15 82
			15 01 00 00 00 00 02 18 66
			15 01 00 00 00 00 02 19 36
			15 01 00 00 00 00 02 1A 10
			15 01 00 00 00 00 02 1C 44
			15 01 00 00 00 00 02 21 38
			15 01 00 00 00 00 02 22 90
			15 01 00 00 00 00 02 23 20
			15 01 00 00 00 00 02 25 03
			15 01 00 00 00 00 02 26 4A
			15 01 00 00 00 00 02 37 00
			15 01 00 00 00 00 02 3A 00
			15 01 00 00 00 00 02 3B 00
			15 01 00 00 00 00 02 3D 21
			15 01 00 00 00 00 02 3F 67
			15 01 00 00 00 00 02 40 20
			15 01 00 00 00 00 02 41 0D
			15 01 00 00 00 00 02 42 33
			15 01 00 00 00 00 02 43 11
			15 01 00 00 00 00 02 44 22
			15 01 00 00 00 00 02 45 66
			15 01 00 00 00 00 02 46 44
			15 01 00 00 00 00 02 47 55
			15 01 00 00 00 00 02 4C 33
			15 01 00 00 00 00 02 4D 11
			15 01 00 00 00 00 02 4E 22
			15 01 00 00 00 00 02 4F 66
			15 01 00 00 00 00 02 50 44
			15 01 00 00 00 00 02 51 55
			15 01 00 00 00 00 02 56 11
			15 01 00 00 00 00 02 58 22
			15 01 00 00 00 00 02 59 33
			15 01 00 00 00 00 02 5A 44
			15 01 00 00 00 00 02 5B 55
			15 01 00 00 00 00 02 5C 66
			15 01 00 00 00 00 02 61 11
			15 01 00 00 00 00 02 62 22
			15 01 00 00 00 00 02 63 33
			15 01 00 00 00 00 02 64 44
			15 01 00 00 00 00 02 65 55
			15 01 00 00 00 00 02 66 66
			15 01 00 00 00 00 02 70 05
			15 01 00 00 00 00 02 FE 05
			15 01 00 00 00 00 02 05 0A
			15 01 00 00 00 00 02 FE 00
			15 01 00 00 00 00 02 35 00
			15 01 00 00 78 00 02 11 00
			15 01 00 00 00 00 02 36 40
			15 01 00 00 00 00 02 29 00];
		qcom,mdss-dsi-off-command = [05 01 00 00 00 00 02 28 00
					05 01 00 00 78 00 02 10 00];
		qcom,mdss-dsi-on-command-state = "dsi_lp_mode";
		qcom,mdss-dsi-off-command-state = "dsi_hs_mode";
		qcom,mdss-dsi-h-sync-pulse = <1>;
		qcom,mdss-dsi-traffic-mode = "burst_mode";
		qcom,mdss-dsi-lane-map = "lane_map_3012";
		qcom,mdss-dsi-bllp-eof-power-mode;
		qcom,mdss-dsi-bllp-power-mode;
		qcom,mdss-dsi-lane-0-state;
		qcom,mdss-dsi-te-pin-select = <1>;
		qcom,mdss-dsi-wr-mem-start = <0x2c>;
		qcom,mdss-dsi-wr-mem-continue = <0x3c>;
		qcom,mdss-dsi-te-dcs-command = <1>;
		qcom,mdss-dsi-te-check-enable;
		qcom,mdss-dsi-te-using-te-pin;
                qcom,mdss-dsi-panel-timings = [6A 16 0E 00 38 3C 12 18 2A 03 04 00];
		qcom,mdss-dsi-t-clk-post = <0x3c>;
		qcom,mdss-dsi-t-clk-pre = <0x08>;
		qcom,mdss-dsi-bl-min-level = <1>;
		qcom,mdss-dsi-bl-max-level = <4095>;
		qcom,mdss-dsi-dma-trigger = "trigger_sw";
		qcom,mdss-dsi-mdp-trigger = "none";
		qcom,mdss-dsi-bl-pmic-control-type = "bl_ctrl_dcs";
		qcom,mdss-dsi-reset-sequence = <1 150>, <0 20>, <1 10>;
	};
};
