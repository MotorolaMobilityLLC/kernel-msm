/* Copyright (c) 2014 Motorola Mobility LLC
 *
 * This program is free software; you can redistribute it and/or modify
 * it under the terms of the GNU General Public License version 2 and
 * only version 2 as published by the Free Software Foundation.
 *
 * This program is distributed in the hope that it will be useful,
 * but WITHOUT ANY WARRANTY; without even the implied warranty of
 * MERCHANTABILITY or FITNESS FOR A PARTICULAR PURPOSE.  See the
 * GNU General Public License for more details.
 */

/dts-v1/;

#include "apq8084.dtsi"
#include "apq8084-quark.dtsi"

/ {
	qcom,msm-id = <178 0x45 0x8400>;
};

&i2c_8 {
	tpa6165xx@40 {
		ti,tpa6165-jack-detect-config = <0xC0>;
	};
};
