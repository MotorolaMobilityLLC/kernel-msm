
qcom,je40-atl {
	serialnum = "SB18C30734";
	/* #3403234_Lenovo_JE40atl_3000mAh_averaged_MasterSlave_Apr10th2018*/
	qcom,max-voltage-uv = <4400000>;
	qcom,nom-batt-capacity-mah = <3000>;
	qcom,batt-id-kohm = <0>;
	qcom,battery-beta = <3435>;
	qcom,battery-type = "JE40-ATL-3000mAh";
	qcom,chg-rslow-comp-c1 = <3246332>;
	qcom,chg-rslow-comp-c2 = <4232725>;
	qcom,chg-rs-to-rslow = <1013229>;
	qcom,chg-rslow-comp-thr = <0x9D>;
	qcom,fg-cc-cv-threshold-mv = <4390>;
	qcom,checksum = <0x53F4>;
	qcom,gui-version = "PMI8950GUI - 2.0.0.16";
	qcom,fg-profile-data = [
		 CB 83 7E 77
		 1C 80 0F 75
		 3C 83 48 73
		 0B 84 BC 80
		 F0 81 C5 9B
		 57 BF BC D0
		 74 10 06 88
		 E1 7D C1 81
		 2C 7C 36 83
		 7D 79 20 87
		 A4 83 26 82
		 63 9B D3 BF
		 BA D1 71 0E
		 BC 0B BB 5A
		 14 70 B2 FD
		 3F 37 42 44
		 43 38 00 00
		 96 47 44 3B
		 1E 32 00 00
		 00 00 00 00
		 00 00 00 00
		 28 70 93 6A
		 3A 84 D8 81
		 AB 75 0F 6A
		 A4 6C AC 78
		 73 6F 6A 62
		 94 3F 4D A8
		 1E 22 63 7F
		 64 A0 71 0C
		 28 00 FF 36
		 F0 11 30 03
		 00 00 00 0C
	];
};
