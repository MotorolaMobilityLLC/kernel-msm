/* Copyright (c) 2013-2014, The Linux Foundation. All rights reserved.
 *
 * This program is free software; you can redistribute it and/or modify
 * it under the terms of the GNU General Public License version 2 and
 * only version 2 as published by the Free Software Foundation.
 *
 * This program is distributed in the hope that it will be useful,
 * but WITHOUT ANY WARRANTY; without even the implied warranty of
 * MERCHANTABILITY or FITNESS FOR A PARTICULAR PURPOSE.  See the
 * GNU General Public License for more details.
 */

qcom,palladium-batterydata {
	qcom,fcc-mah = <290>;
	qcom,default-rbatt-mohm = <524>;
	qcom,rbatt-capacitive-mohm = <50>;
	qcom,flat-ocv-threshold-uv = <3800000>;
	qcom,max-voltage-uv = <4350000>;
	qcom,v-cutoff-uv = <3400000>;
	qcom,chg-term-ua = <20000>;
	qcom,batt-id-kohm = <75>;
	qcom,battery-type = "palladium_1500mah";

	qcom,fcc-temp-lut {
		qcom,lut-col-legend = <(-20) 0 25 40 60>;
		qcom,lut-data = <284 286 286 286 286>;
	};

	qcom,pc-temp-ocv-lut {
		qcom,lut-col-legend = <(-20) 0 25 40 60>;
		qcom,lut-row-legend = <100 95 90 85 80>,
				<75 70 65 60 55>,
				<50 45 40 35 30>,
				<25 20 16 13 11>,
				<10 9 8 7 6>,
				<5 4 3 2 1>,
				<0>;
		qcom,lut-data = <4342 4342 4336 4330 4324>,
				<4248 4266 4268 4266 4262>,
				<4180 4210 4214 4212 4208>,
				<4128 4160 4161 4160 4156>,
				<4083 4108 4111 4109 4106>,
				<3992 4069 4071 4063 4058>,
				<3942 3980 4004 4008 4013>,
				<3903 3935 3968 3972 3972>,
				<3870 3905 3922 3927 3928>,
				<3844 3874 3882 3883 3883>,
				<3822 3845 3852 3852 3852>,
				<3805 3820 3828 3828 3828>,
				<3790 3799 3808 3808 3807>,
				<3775 3784 3791 3790 3789>,
				<3761 3770 3775 3772 3763>,
				<3746 3752 3758 3749 3736>,
				<3728 3736 3735 3726 3712>,
				<3711 3724 3712 3703 3689>,
				<3693 3714 3698 3689 3676>,
				<3678 3706 3692 3684 3672>,
				<3667 3700 3690 3682 3670>,
				<3658 3694 3687 3680 3666>,
				<3644 3684 3680 3672 3656>,
				<3626 3665 3661 3650 3632>,
				<3601 3631 3626 3617 3600>,
				<3566 3584 3586 3580 3564>,
				<3514 3525 3539 3536 3518>,
				<3442 3458 3483 3478 3456>,
				<3347 3378 3402 3394 3368>,
				<3232 3254 3270 3259 3232>,
				<3000 3000 3000 3000 3000>;
	};

	qcom,rbatt-sf-lut {
		qcom,lut-col-legend = <(-20) 0 25 40 60>;
		qcom,lut-row-legend = <100 95 90 85 80>,
				<75 70 65 60 55>,
				<50 45 40 35 30>,
				<25 20 16 13 11>,
				<10 9 8 7 6>,
				<5 4 3 2 1>;
		qcom,lut-data = <1063 339 100 66 50>,
				<1063 339 100 66 50>,
				<1091 332 102 68 52>,
				<1150 325 104 71 53>,
				<1156 320 105 73 56>,
				<1138 324 109 75 58>,
				<1187 310 104 74 59>,
				<1235 310 108 76 60>,
				<1285 312 100 71 56>,
				<1340 307 96 65 51>,
				<1409 306 96 66 52>,
				<1495 307 97 68 54>,
				<1605 309 99 70 57>,
				<1783 315 102 72 58>,
				<1988 326 103 72 55>,
				<2268 338 103 69 52>,
				<2667 365 103 69 52>,
				<3075 411 102 67 51>,
				<3420 447 105 68 51>,
				<3666 455 109 71 54>,
				<3775 434 111 73 56>,
				<3775 386 108 72 56>,
				<3563 370 106 71 54>,
				<3832 390 104 69 52>,
				<4278 420 105 69 54>,
				<4806 469 108 72 57>,
				<5555 539 114 76 58>,
				<6825 645 119 77 58>,
				<10070 875 124 80 62>,
				<20140 1751 248 160 124>;
	};
};
