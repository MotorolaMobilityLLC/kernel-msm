/* Copyright (c) 2013-2015, The Linux Foundation. All rights reserved.
 *
 * This program is free software; you can redistribute it and/or modify
 * it under the terms of the GNU General Public License version 2 and
 * only version 2 as published by the Free Software Foundation.
 *
 * This program is distributed in the hope that it will be useful,
 * but WITHOUT ANY WARRANTY; without even the implied warranty of
 * MERCHANTABILITY or FITNESS FOR A PARTICULAR PURPOSE.  See the
 * GNU General Public License for more details.
 */

/*---------------------------------------------------------------------------
 * This file is autogenerated file using gcdb parser. Please do not edit it.
 * Update input XML file to add a new entry or update variable in this file
 * VERSION = "1.0"
 *---------------------------------------------------------------------------*/
&mdss_mdp {
	dsi_dijingILI9881C_720p_vid: qcom,mdss_dsi_dijing_ILI9881C_720p_video {
	qcom,mdss-dsi-panel-name = "dijing ILI9881C 720p video mode dsi panel";
		qcom,mdss-dsi-panel-controller = <&mdss_dsi0>;
		qcom,mdss-dsi-panel-type = "dsi_video_mode";
		qcom,mdss-dsi-panel-destination = "display_1";
		qcom,cont-splash-enabled;
		qcom,mdss-dsi-panel-framerate = <60>;
		qcom,mdss-dsi-virtual-channel-id = <0>;
		qcom,mdss-dsi-stream = <0>;
		qcom,mdss-dsi-panel-width = <720>;
		qcom,mdss-dsi-panel-height = <1280>;
		qcom,mdss-dsi-h-front-porch = <150>;
		qcom,mdss-dsi-h-back-porch = <150>;
		qcom,mdss-dsi-h-pulse-width = <10>;
		qcom,mdss-dsi-h-sync-skew = <0>;
		qcom,mdss-dsi-v-front-porch = <20>;
		qcom,mdss-dsi-v-back-porch = <19>;
		qcom,mdss-dsi-v-pulse-width = <2>;
		qcom,mdss-dsi-h-left-border = <0>;
		qcom,mdss-dsi-h-right-border = <0>;
		qcom,mdss-dsi-v-top-border = <0>;
		qcom,mdss-dsi-v-bottom-border = <0>;
		qcom,mdss-dsi-bpp = <24>;
		qcom,mdss-dsi-color-order = "rgb_swap_rgb";
		qcom,mdss-dsi-underflow-color = <0xff>;
		qcom,mdss-dsi-border-color = <0>;
		qcom,mdss-pan-physical-width-dimension = <62>;
		qcom,mdss-pan-physical-height-dimension = <110>;
		qcom,mdss-dsi-on-command = [
			29 01 00 00 01 00 04
			FF 98 81 03
			23 01 00 00 01 00 02
			01 00
			23 01 00 00 01 00 02
			02 00
			23 01 00 00 01 00 02
			03 73
			23 01 00 00 01 00 02
			04 00
			23 01 00 00 01 00 02
			05 00
			23 01 00 00 01 00 02
			06 0A
			23 01 00 00 01 00 02
			07 00
			23 01 00 00 01 00 02
			08 00
			23 01 00 00 01 00 02
			09 01
			23 01 00 00 01 00 02
			0A 00
			23 01 00 00 01 00 02
			0B 00
			23 01 00 00 01 00 02
			0C 01
			23 01 00 00 01 00 02
			0D 00
			23 01 00 00 01 00 02
			0E 00
			23 01 00 00 01 00 02
			0F 14
			23 01 00 00 01 00 02
			10 14
			23 01 00 00 01 00 02
			11 00
			23 01 00 00 01 00 02
			12 00
			23 01 00 00 01 00 02
			13 00
			23 01 00 00 01 00 02
			14 00
			23 01 00 00 01 00 02
			15 00
			23 01 00 00 01 00 02
			16 00
			23 01 00 00 01 00 02
			17 00
			23 01 00 00 01 00 02
			18 00
			23 01 00 00 01 00 02
			19 00
			23 01 00 00 01 00 02
			1A 00
			23 01 00 00 01 00 02
			1B 00
			23 01 00 00 01 00 02
			1C 00
			23 01 00 00 01 00 02
			1D 00
			23 01 00 00 01 00 02
			1E 40
			23 01 00 00 01 00 02
			1F 80
			23 01 00 00 01 00 02
			20 06
			23 01 00 00 01 00 02
			21 01
			23 01 00 00 01 00 02
			22 00
			23 01 00 00 01 00 02
			23 00
			23 01 00 00 01 00 02
			24 00
			23 01 00 00 01 00 02
			25 00
			23 01 00 00 01 00 02
			26 00
			23 01 00 00 01 00 02
			27 00
			23 01 00 00 01 00 02
			28 33
			23 01 00 00 01 00 02
			29 03
			23 01 00 00 01 00 02
			2A 00
			23 01 00 00 01 00 02
			2B 00
			23 01 00 00 01 00 02
			2C 00
			23 01 00 00 01 00 02
			2D 00
			23 01 00 00 01 00 02
			2E 00
			23 01 00 00 01 00 02
			2F 00
			23 01 00 00 01 00 02
			30 00
			23 01 00 00 01 00 02
			31 00
			23 01 00 00 01 00 02
			32 00
			23 01 00 00 01 00 02
			33 00
			23 01 00 00 01 00 02
			34 04
			23 01 00 00 01 00 02
			35 00
			23 01 00 00 01 00 02
			36 00
			23 01 00 00 01 00 02
			37 00
			23 01 00 00 01 00 02
			38 78
			23 01 00 00 01 00 02
			39 00
			23 01 00 00 01 00 02
			3A 40
			23 01 00 00 01 00 02
			3B 40
			23 01 00 00 01 00 02
			3C 00
			23 01 00 00 01 00 02
			3D 00
			23 01 00 00 01 00 02
			3E 00
			23 01 00 00 01 00 02
			3F 00
			23 01 00 00 01 00 02
			40 00
			23 01 00 00 01 00 02
			41 00
			23 01 00 00 01 00 02
			42 00
			23 01 00 00 01 00 02
			43 00
			23 01 00 00 01 00 02
			44 00
			23 01 00 00 01 00 02
			50 01
			23 01 00 00 01 00 02
			51 23
			23 01 00 00 01 00 02
			52 45
			23 01 00 00 01 00 02
			53 67
			23 01 00 00 01 00 02
			54 89
			23 01 00 00 01 00 02
			55 AB
			23 01 00 00 01 00 02
			56 01
			23 01 00 00 01 00 02
			57 23
			23 01 00 00 01 00 02
			58 45
			23 01 00 00 01 00 02
			59 67
			23 01 00 00 01 00 02
			5A 89
			23 01 00 00 01 00 02
			5B AB
			23 01 00 00 01 00 02
			5C CD
			23 01 00 00 01 00 02
			5D EF
			23 01 00 00 01 00 02
			5E 11
			23 01 00 00 01 00 02
			5F 01
			23 01 00 00 01 00 02
			60 00
			23 01 00 00 01 00 02
			61 15
			23 01 00 00 01 00 02
			62 14
			23 01 00 00 01 00 02
			63 0E
			23 01 00 00 01 00 02
			64 0F
			23 01 00 00 01 00 02
			65 0C
			23 01 00 00 01 00 02
			66 0D
			23 01 00 00 01 00 02
			67 06
			23 01 00 00 01 00 02
			68 02
			23 01 00 00 01 00 02
			69 07
			23 01 00 00 01 00 02
			6A 02
			23 01 00 00 01 00 02
			6B 02
			23 01 00 00 01 00 02
			6C 02
			23 01 00 00 01 00 02
			6D 02
			23 01 00 00 01 00 02
			6E 02
			23 01 00 00 01 00 02
			6F 02
			23 01 00 00 01 00 02
			70 02
			23 01 00 00 01 00 02
			71 02
			23 01 00 00 01 00 02
			72 02
			23 01 00 00 01 00 02
			73 02
			23 01 00 00 01 00 02
			74 02
			23 01 00 00 01 00 02
			75 01
			23 01 00 00 01 00 02
			76 00
			23 01 00 00 01 00 02
			77 14
			23 01 00 00 01 00 02
			78 15
			23 01 00 00 01 00 02
			79 0E
			23 01 00 00 01 00 02
			7A 0F
			23 01 00 00 01 00 02
			7B 0C
			23 01 00 00 01 00 02
			7C 0D
			23 01 00 00 01 00 02
			7D 06
			23 01 00 00 01 00 02
			7E 02
			23 01 00 00 01 00 02
			7F 07
			23 01 00 00 01 00 02
			80 02
			23 01 00 00 01 00 02
			81 02
			23 01 00 00 01 00 02
			82 02
			23 01 00 00 01 00 02
			83 02
			23 01 00 00 01 00 02
			84 02
			23 01 00 00 01 00 02
			85 02
			23 01 00 00 01 00 02
			86 02
			23 01 00 00 01 00 02
			87 02
			23 01 00 00 01 00 02
			88 02
			23 01 00 00 01 00 02
			89 02
			23 01 00 00 01 00 02
			8A 02
			29 01 00 00 01 00 04
			FF 98 81 04
			23 01 00 00 01 00 02
			00 80
			23 01 00 00 01 00 02
			6C 15
			23 01 00 00 01 00 02
			6E 2A
			23 01 00 00 01 00 02
			6F 33
			23 01 00 00 01 00 02
			3A 94
			23 01 00 00 01 00 02
			8D 1A
			23 01 00 00 01 00 02
			87 BA
			23 01 00 00 01 00 02
			26 76
			23 01 00 00 01 00 02
			B2 D1
			23 01 00 00 01 00 02
			B5 06
			29 01 00 00 01 00 04
			FF 98 81 01
			23 01 00 00 01 00 02
			22 0A
			23 01 00 00 01 00 02
			31 00
			23 01 00 00 01 00 02
			53 81
			23 01 00 00 01 00 02
			55 8F
			23 01 00 00 01 00 02
			50 C0
			23 01 00 00 01 00 02
			51 C0
			23 01 00 00 01 00 02
			60 08
			23 01 00 00 01 00 02
			A0 08
			23 01 00 00 01 00 02
			A1 10
			23 01 00 00 01 00 02
			A2 25
			23 01 00 00 01 00 02
			A3 00
			23 01 00 00 01 00 02
			A4 24
			23 01 00 00 01 00 02
			A5 19
			23 01 00 00 01 00 02
			A6 12
			23 01 00 00 01 00 02
			A7 1B
			23 01 00 00 01 00 02
			A8 77
			23 01 00 00 01 00 02
			A9 19
			23 01 00 00 01 00 02
			AA 25
			23 01 00 00 01 00 02
			AB 6E
			23 01 00 00 01 00 02
			AC 20
			23 01 00 00 01 00 02
			AD 17
			23 01 00 00 01 00 02
			AE 54
			23 01 00 00 01 00 02
			AF 24
			23 01 00 00 01 00 02
			B0 27
			23 01 00 00 01 00 02
			B1 52
			23 01 00 00 01 00 02
			B2 63
			23 01 00 00 01 00 02
			B3 39
			23 01 00 00 01 00 02
			C0 08
			23 01 00 00 01 00 02
			C1 20
			23 01 00 00 01 00 02
			C2 23
			23 01 00 00 01 00 02
			C3 22
			23 01 00 00 01 00 02
			C4 06
			23 01 00 00 01 00 02
			C5 34
			23 01 00 00 01 00 02
			C6 25
			23 01 00 00 01 00 02
			C7 20
			23 01 00 00 01 00 02
			C8 86
			23 01 00 00 01 00 02
			C9 1F
			23 01 00 00 01 00 02
			CA 2B
			23 01 00 00 01 00 02
			CB 74
			23 01 00 00 01 00 02
			CC 16
			23 01 00 00 01 00 02
			CD 1B
			23 01 00 00 01 00 02
			CE 46
			23 01 00 00 01 00 02
			CF 21
			23 01 00 00 01 00 02
			D0 29
			23 01 00 00 01 00 02
			D1 54
			23 01 00 00 01 00 02
			D2 65
			23 01 00 00 01 00 02
			D3 39
			29 01 00 00 01 00 04
			FF 98 81 00
			23 01 00 00 01 00 02
			35 00

			05 01 00 00 78 00 02
			11 00
			05 01 00 00 00 00 02
			29 00
			];
		qcom,mdss-dsi-off-command = [
			05 01 00 00 32 00 02
			28 00
			05 01 00 00 78 00 02
			10 00
			];
		qcom,mdss-dsi-on-command-state = "dsi_lp_mode";
		qcom,mdss-dsi-off-command-state = "dsi_lp_mode";
		qcom,mdss-dsi-h-sync-pulse = <0>;
		qcom,mdss-dsi-traffic-mode = "non_burst_sync_pulse";
		qcom,mdss-dsi-lane-map = "lane_map_0123";
		qcom,mdss-dsi-bllp-eof-power-mode;
		qcom,mdss-dsi-bllp-power-mode;
		qcom,mdss-dsi-lane-0-state;
		qcom,mdss-dsi-lane-1-state;
		qcom,mdss-dsi-lane-2-state;
		qcom,mdss-dsi-lane-3-state;
		qcom,mdss-dsi-panel-timings = [8b 1e 14 00 44 48 18 4a 19 03 04 00];
		qcom,mdss-dsi-t-clk-post = <0x04>;
		qcom,mdss-dsi-t-clk-pre = <0x1b>;
		qcom,mdss-dsi-bl-min-level = <1>;
		qcom,mdss-dsi-bl-max-level = <4095>;
		qcom,mdss-dsi-dma-trigger = "trigger_sw";
		qcom,mdss-dsi-mdp-trigger = "none";
		qcom,mdss-dsi-bl-pmic-control-type = "bl_ctrl_pwm";
		qcom,mdss-dsi-bl-pmic-pwm-frequency = <100>;
		qcom,mdss-dsi-bl-pmic-bank-select = <0>;
		qcom,mdss-dsi-pwm-gpio = <&pm8916_mpps 4 0>;
		qcom,mdss-dsi-reset-sequence = <1 20>, <0 10>, <1 20>;

		qcom,mdss-dsi-panel-status-command = [06 01 00 01 05 00 02 0A 08];
		qcom,mdss-dsi-panel-status-command-state = "dsi_lp_mode";
		qcom,mdss-dsi-panel-status-check-mode = "reg_read";
		qcom,mdss-dsi-panel-status-value = <0x9c>;
		qcom,esd-check-enabled;
	};
};

