/* Copyright (c) 2012-2013, The Linux Foundation. All rights reserved.
 * Copyright (c) 2014 Motorola Mobility LLC
 *
 * This program is free software; you can redistribute it and/or modify
 * it under the terms of the GNU General Public License version 2 and
 * only version 2 as published by the Free Software Foundation.
 *
 * This program is distributed in the hope that it will be useful,
 * but WITHOUT ANY WARRANTY; without even the implied warranty of
 * MERCHANTABILITY or FITNESS FOR A PARTICULAR PURPOSE.  See the
 * GNU General Public License for more details.
 */

&mdss_mdp {
	mot_inx_570_QHD_0_cmd_v0: qcom,mdss_dsi_mot_inx_570_QHD_dualmipi0_cmd_v0 {
		qcom,mdss-dsi-panel-name = "mipi_mot_cmd_inx_QHD_0_570_v0";
		qcom,mdss-dsi-panel-controller = <&mdss_dsi0>;
		qcom,mdss-dsi-panel-type = "dsi_cmd_mode";
		mmi,sh-control-enabled;
		mmi,quickdraw-enabled;
		qcom,dcs-cmd-by-left;
		qcom,mdss-dsi-panel-destination = "display_1";
		qcom,mdss-dsi-panel-framerate = <60>;
		qcom,mdss-dsi-virtual-channel-id = <0>;
		qcom,mdss-dsi-stream = <0>;
		qcom,mdss-dsi-panel-width = <720>;
		qcom,mdss-dsi-panel-height = <2560>;
		qcom,mdss-pan-physical-width-dimension = <70>;
		qcom,mdss-pan-physical-height-dimension = <125>;
		qcom,mdss-dsi-panel-clockrate = <902000000>;
		qcom,mdss-dsi-h-front-porch = <120>;
		qcom,mdss-dsi-h-back-porch = <44>;
		qcom,mdss-dsi-h-pulse-width = <16>;
		qcom,mdss-dsi-h-sync-skew = <0>;
		qcom,mdss-dsi-v-back-porch = <4>;
		qcom,mdss-dsi-v-front-porch = <8>;
		qcom,mdss-dsi-v-pulse-width = <4>;
		qcom,mdss-dsi-h-left-border = <0>;
		qcom,mdss-dsi-h-right-border = <0>;
		qcom,mdss-dsi-v-top-border = <0>;
		qcom,mdss-dsi-v-bottom-border = <0>;
		qcom,mdss-dsi-bpp = <24>;
		qcom,mdss-dsi-underflow-color = <0xff>;
		qcom,mdss-dsi-border-color = <0>;
		qcom,mdss-dsi-h-sync-pulse = <0>;
		qcom,mdss-dsi-traffic-mode = "non_burst_sync_event";
		qcom,mdss-dsi-bllp-eof-power-mode;
		qcom,mdss-dsi-bllp-power-mode;
		qcom,mdss-dsi-lane-0-state;
		qcom,mdss-dsi-lane-1-state;
		qcom,mdss-dsi-lane-2-state;
		qcom,mdss-dsi-lane-3-state;
		qcom,mdss-dsi-tx-eot-append;
		qcom,mdss-dsi-panel-timings = [EE 38 26 00 6A 6C 2C 3C 2C 03
									04 00];
		qcom,mdss-dsi-reset-sequence = <0 11>, <1 11>, <0 1>, <1 11>;
		qcom,mdss-dsi-lp11-init;
		qcom,mdss-dsi-t-clk-post = <0x2d>;
		qcom,mdss-dsi-t-clk-pre = <0x2c>;
		qcom,mdss-dsi-bl-max-level = <255>;
		qcom,mdss-dsi-dma-trigger = "trigger_sw";
		qcom,mdss-dsi-mdp-trigger = "none";
		qcom,mdss-dsi-bl-pmic-control-type = "bl_ctrl_wled";
		qcom,mdss-dsi-te-pin-select = <1>;
		qcom,mdss-dsi-te-v-sync-rd-ptr-irq-line = <0x2c>;
		qcom,mdss-dsi-te-v-sync-continues-lines = <0x3c>;
		qcom,mdss-dsi-te-dcs-command = <1>;
		qcom,mdss-dsi-te-check-enable;
		qcom,mdss-dsi-te-using-te-pin;
		qcom,mdss-dsi-on-command = [
			/* Setting VBP=8 and VFP=8 */
			39 01 00 00 01 00 04 3B 03 08 08
			/* Configure command mode */
			15 01 00 00 01 00 02 BB 10
			/* Disable BK_EN control */
			15 01 00 00 01 00 02 E5 00
			/* NVT SDC */
			15 01 00 00 01 00 02 C0 00
			/* 1600RGBX2560, GRAM Slide Parameter=16h */
			39 01 00 00 01 00 0C C9 01 01 80 00 0B 06 67 04 3A 11 F8
			/* Don't reload MTP after 0x11 cmd */
			15 01 00 00 01 00 02 FB 01
			/* Engineer CMD2 page 4 is selected */
			15 01 00 00 01 00 02 FF 24
			/* Image up-side down & gate scan inverse */
			15 01 00 00 01 00 02 9D 36
			/* Don't reload MTP after 0x11 cmd*/
			15 01 00 00 01 00 02 FB 01
			/* CMD1 Page1 is selected */
			15 01 00 00 01 00 02 FF 10
			/* Touch improvement - EQ Mux settings */
			15 01 00 00 01 00 02 FF 20
			15 01 00 00 01 00 02 5C 80
			15 01 00 00 01 00 02 5D 84
			15 01 00 00 01 00 02 62 02
			15 01 00 00 01 00 02 FB 01
			15 01 00 00 01 00 02 FF 10
			/* exit sleep mode */
			05 01 00 00 78 00 01 11
			/* enable_te */
			15 01 00 00 01 00 02 35 00
			/* display on */
			05 01 00 00 00 00 01 29];
		qcom,mdss-dsi-on-command-state = "dsi_lp_mode";
		qcom,mdss-dsi-off-command = [
			/* display_off */
			05 01 00 00 01 00 01 28
			/* enter sleep mode */
			05 01 00 00 46 00 01 10];
		qcom,mdss-dsi-off-command-state = "dsi_lp_mode";

		qcom,esd-check-enabled;
		qcom,mdss-dsi-panel-status-check-mode = "reg_read";
		qcom,mdss-dsi-panel-status-command = [06 01 00 01 00 00 01 0A];
		qcom,mdss-dsi-panel-status-command-state = "dsi_hs_mode";
		qcom,mdss-dsi-panel-status-value = <0x9c>;
	};

	mot_inx_570_QHD_1_cmd_v0: qcom,mdss_dsi_mot_inx_570_QHD_dualmipi1_cmd_v0 {
		qcom,mdss-dsi-panel-name = "mipi_mot_cmd_inx_QHD_1_570_v0";
		qcom,mdss-dsi-panel-controller = <&mdss_dsi1>;
		qcom,mdss-dsi-panel-type = "dsi_cmd_mode";
		mmi,sh-control-enabled;
		mmi,quickdraw-enabled;
		qcom,dcs-cmd-by-left;
		qcom,mdss-dsi-panel-destination = "display_2";
		qcom,mdss-dsi-panel-framerate = <60>;
		qcom,mdss-dsi-virtual-channel-id = <0>;
		qcom,mdss-dsi-stream = <0>;
		qcom,mdss-dsi-panel-width = <720>;
		qcom,mdss-dsi-panel-height = <2560>;
		qcom,mdss-pan-physical-width-dimension = <70>;
		qcom,mdss-pan-physical-height-dimension = <125>;
		qcom,mdss-dsi-panel-clockrate = <902000000>;
		qcom,mdss-dsi-h-front-porch = <120>;
		qcom,mdss-dsi-h-back-porch = <44>;
		qcom,mdss-dsi-h-pulse-width = <16>;
		qcom,mdss-dsi-h-sync-skew = <0>;
		qcom,mdss-dsi-v-back-porch = <4>;
		qcom,mdss-dsi-v-front-porch = <8>;
		qcom,mdss-dsi-v-pulse-width = <4>;
		qcom,mdss-dsi-h-left-border = <0>;
		qcom,mdss-dsi-h-right-border = <0>;
		qcom,mdss-dsi-v-top-border = <0>;
		qcom,mdss-dsi-v-bottom-border = <0>;
		qcom,mdss-dsi-bpp = <24>;
		qcom,mdss-dsi-underflow-color = <0xff>;
		qcom,mdss-dsi-border-color = <0>;

		qcom,mdss-dsi-h-sync-pulse = <0>;
		qcom,mdss-dsi-traffic-mode = "non_burst_sync_event";
		qcom,mdss-dsi-bllp-eof-power-mode;
		qcom,mdss-dsi-bllp-power-mode;
		qcom,mdss-dsi-lane-0-state;
		qcom,mdss-dsi-lane-1-state;
		qcom,mdss-dsi-lane-2-state;
		qcom,mdss-dsi-lane-3-state;
		qcom,mdss-dsi-tx-eot-append;
		qcom,mdss-dsi-panel-timings = [EE 38 26 00 6A 6C 2C 3C 2C 03
									04 00];
		qcom,mdss-dsi-lp11-init;
		qcom,mdss-dsi-t-clk-post = <0x2d>;
		qcom,mdss-dsi-t-clk-pre = <0x2c>;
		qcom,mdss-dsi-dma-trigger = "trigger_sw";
		qcom,mdss-dsi-mdp-trigger = "none";
		qcom,mdss-dsi-te-pin-select = <1>;
		qcom,mdss-dsi-te-v-sync-rd-ptr-irq-line = <0x2c>;
		qcom,mdss-dsi-te-v-sync-continues-lines = <0x3c>;
		qcom,mdss-dsi-te-dcs-command = <1>;
		qcom,mdss-dsi-te-check-enable;
		qcom,mdss-dsi-te-using-te-pin;
	};
};
