/* Copyright (c) 2017, The Linux Foundation. All rights reserved.
 *
 * This program is free software; you can redistribute it and/or modify
 * it under the terms of the GNU General Public License version 2 and
 * only version 2 as published by the Free Software Foundation.
 *
 * This program is distributed in the hope that it will be useful,
 * but WITHOUT ANY WARRANTY; without even the implied warranty of
 * MERCHANTABILITY or FITNESS FOR A PARTICULAR PURPOSE.  See the
 * GNU General Public License for more details.
 */


/dts-v1/;

#include "sdm630.dtsi"
#include "sdm630-payton.dtsi"

/ {
	qcom,board-id = <0x42 0x82B0>;
};

&cs47l35 {
	cirrus,accdet {
		acc@1 {
			cirrus,disable-jd2-on-lineout;
		};
	};
};
