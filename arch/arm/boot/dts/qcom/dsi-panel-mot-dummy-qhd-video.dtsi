/* Copyright (c) 2015, The Linux Foundation. All rights reserved.
 *
 * This program is free software; you can redistribute it and/or modify
 * it under the terms of the GNU General Public License version 2 and
 * only version 2 as published by the Free Software Foundation.
 *
 * This program is distributed in the hope that it will be useful,
 * but WITHOUT ANY WARRANTY; without even the implied warranty of
 * MERCHANTABILITY or FITNESS FOR A PARTICULAR PURPOSE.  See the
 * GNU General Public License for more details.
 */

&mdss_mdp {
	mot_dummy_vid_qhd: qcom,mdss_dsi_mot_dummy_qhd_video {
		qcom,mdss-dsi-panel-name = "mipi_mot_video_dummy_qhd";
		qcom,mdss-dsi-panel-type = "dsi_video_mode";
		qcom,mdss-dsi-panel-framerate = <60>;
		qcom,mdss-dsi-virtual-channel-id = <0>;
		qcom,mdss-dsi-stream = <0>;
		qcom,mdss-dsi-panel-width = <540>;
		qcom,mdss-dsi-panel-height = <960>;
		qcom,mdss-pan-physical-width-dimension = <54>;
		qcom,mdss-pan-physical-height-dimension = <95>;
		qcom,mdss-dsi-h-front-porch = <32>;
		qcom,mdss-dsi-h-back-porch = <4>;
		qcom,mdss-dsi-h-pulse-width = <32>;
		qcom,mdss-dsi-h-sync-skew = <0>;
		qcom,mdss-dsi-v-back-porch = <16>;
		qcom,mdss-dsi-v-front-porch = <15>;
		qcom,mdss-dsi-v-pulse-width = <1>;
		qcom,mdss-dsi-bpp = <24>;
		qcom,mdss-dsi-underflow-color = <0xff>;
		qcom,mdss-dsi-border-color = <0>;

		qcom,mdss-dsi-on-command-state = "dsi_lp_mode";
		qcom,mdss-dsi-off-command-state = "dsi_lp_mode";
		qcom,mdss-dsi-h-sync-pulse = <0>;
		qcom,mdss-dsi-traffic-mode = "non_burst_sync_event";
		qcom,mdss-dsi-bllp-eof-power-mode;
		qcom,mdss-dsi-bllp-power-mode;
		qcom,mdss-dsi-lane-0-state;
		qcom,mdss-dsi-lane-1-state;
		qcom,mdss-dsi-tx-eot-append;
		qcom,mdss-dsi-panel-timings = [82 1c 12 00 40 42 16 1e 14 03 04 00];
		qcom,mdss-dsi-t-clk-post = <0x1b>;
		qcom,mdss-dsi-t-clk-pre = <0x1b>;
		qcom,mdss-dsi-dma-trigger = "trigger_sw";
		qcom,mdss-dsi-mdp-trigger = "none";
		qcom,mdss-dsi-reset-sequence = <1 0>;

		qcom,mdss-dsi-bl-min-level = <1>;
		qcom,mdss-dsi-bl-max-level = <255>;
		qcom,mdss-dsi-bl-pmic-control-type = "bl_ctrl_dcs";

		qcom,mdss-dsi-panel-timings-phy-v2 = [1E 1B 04 06 02 03 04 a0
						1E 1B 04 06 02 03 04 a0
						1E 1B 04 06 02 03 04 a0
						1E 1B 04 06 02 03 04 a0
						1E 0D 04 05 02 03 04 a0
		];
	};
};
