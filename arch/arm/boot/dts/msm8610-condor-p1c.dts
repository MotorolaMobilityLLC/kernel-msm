/* Copyright (c) 2013, The Linux Foundation. All rights reserved.
 *
 * This program is free software; you can redistribute it and/or modify
 * it under the terms of the GNU General Public License version 2 and
 * only version 2 as published by the Free Software Foundation.
 *
 * This program is distributed in the hope that it will be useful,
 * but WITHOUT ANY WARRANTY; without even the implied warranty of
 * MERCHANTABILITY or FITNESS FOR A PARTICULAR PURPOSE.  See the
 * GNU General Public License for more details.
 */

/dts-v1/;

/include/ "msm8610-moto-reserve.dtsi"
/include/ "msm8610-v1.dtsi"
/include/ "msm8610-moto-common.dtsi"

/ {
	qcom,msm-id = <147 0x41 0x81c0>;
};

/* Support Gipper factory IC */
&mmi_factory {
	gpios = <&msmgpio 77 0x2>; /* GPIOF_DIR_OUT | GPIOF_INIT_HIGH */
};

/* limit clock speed by 25MHz due to signal integrity issues in HS mode */
&sdhc_2 {
	qcom,clk-rates = <400000 25000000>;
};
