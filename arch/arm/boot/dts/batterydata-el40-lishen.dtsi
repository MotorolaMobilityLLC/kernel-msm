mmi,el40-lishen-batterydata {
	qcom,fcc-mah = <1935>;
	qcom,default-rbatt-mohm = <203>;
	qcom,rbatt-capacitive-mohm = <0>;
	qcom,flat-ocv-threshold-uv = <3800000>;
	qcom,max-voltage-uv = <4350000>;
	qcom,v-cutoff-uv = <3200000>;
	qcom,chg-term-ua = <164000>;
	qcom,batt-id-kohm = <20>;
	qcom,batt-id-range = <380578 424195>;

	qcom,fcc-temp-lut {
		qcom,lut-col-legend = <(-10) 0 23 60>;
		qcom,lut-data = <1935 1935 1935 1935>;
	};

	qcom,pc-temp-ocv-lut {
		qcom,lut-col-legend = <(-10) 0 23 60>;
		qcom,lut-row-legend = <100 95 90 85 80 75 70>,
				<65 60 55 50 45 40 35>,
				<30 25 20 15 10 9 8>,
				<7 6 5 4 3 2 1 0>;
		qcom,lut-data = <4300 4300 4300 4300>,
				<4263 4265 4262 4249>,
				<4206 4209 4207 4195>,
				<4154 4157 4153 4142>,
				<4106 4108 4103 4092>,
				<4055 4062 4056 4045>,
				<3993 4002 4007 4002>,
				<3945 3960 3968 3961>,
				<3904 3916 3923 3918>,
				<3868 3873 3877 3873>,
				<3839 3843 3847 3844>,
				<3817 3821 3825 3822>,
				<3801 3803 3807 3803>,
				<3792 3791 3792 3785>,
				<3784 3783 3779 3763>,
				<3771 3773 3761 3736>,
				<3748 3752 3737 3713>,
				<3721 3719 3707 3687>,
				<3699 3698 3690 3667>,
				<3697 3696 3689 3667>,
				<3694 3694 3688 3665>,
				<3690 3691 3686 3662>,
				<3681 3685 3680 3653>,
				<3659 3666 3660 3630>,
				<3619 3627 3622 3592>,
				<3565 3575 3572 3541>,
				<3492 3507 3503 3471>,
				<3389 3406 3400 3372>,
				<3200 3200 3200 3200>;
	};

	qcom,rbatt-sf-lut {
		qcom,lut-col-legend = <(-10) 0 23 60>;
		qcom,lut-row-legend = <100 95 90 85 80 75 70>,
				<65 60 55 50 45 40 35>,
				<30 25 20 15 10 9 8>,
				<7 6 5 4 3 2 1 0>;
		qcom,lut-data = <599 304 100 47>,
				<606 306 102 52>,
				<614 309 104 57>,
				<624 316 105 58>,
				<646 332 108 60>,
				<656 360 114 61>,
				<646 364 123 64>,
				<670 371 142 70>,
				<679 356 139 75>,
				<704 344 114 60>,
				<752 356 110 60>,
				<816 385 113 61>,
				<891 423 120 64>,
				<989 469 128 67>,
				<1104 528 134 66>,
				<1234 595 129 61>,
				<1325 664 128 61>,
				<1440 672 128 61>,
				<1471 673 125 62>,
				<1538 699 128 62>,
				<1615 733 132 63>,
				<1702 774 138 63>,
				<1791 823 143 64>,
				<1869 871 146 67>,
				<1951 923 152 67>,
				<2057 1004 161 66>,
				<2193 1113 164 70>,
				<2394 1279 181 81>,
				<4316 1938 527 262>;
	};
};