/* Copyright (c) 2014 Motorola Mobility LLC
 *
 * This program is free software; you can redistribute it and/or modify
 * it under the terms of the GNU General Public License version 2 and
 * only version 2 as published by the Free Software Foundation.
 *
 * This program is distributed in the hope that it will be useful,
 * but WITHOUT ANY WARRANTY; without even the implied warranty of
 * MERCHANTABILITY or FITNESS FOR A PARTICULAR PURPOSE.  See the
 * GNU General Public License for more details.
 */

/include/ "msm8974pro-ac-moto-common.dtsi"
/include/ "msm8974pro-victara-common.dtsi"

/ {
	model = "Motorola QC-MSM8974 Pro Victara China";
	compatible = "qcom,msm8974-victara_cn",
		     "qcom,msm8974-moto",
		     "qcom,msm8974";
};

&i2c_2 {
	tpa6165xx@40 {
		ti,tpa6165-jack-detect-config = <0xC0>;
	};
};
