mmi,ey30-lg-batterydata {
	qcom,fcc-mah = <2281>;
	qcom,default-rbatt-mohm = <188>;
	qcom,rbatt-capacitive-mohm = <0>;
	qcom,flat-ocv-threshold-uv = <3800000>;
	qcom,max-voltage-uv = <4350000>;
	qcom,v-cutoff-uv = <3000000>;
	qcom,chg-term-ua = <183000>;
	qcom,max-current-ma = <2400>;
	qcom,batt-id-kohm = <130>;
	qcom,batt-id-range = <1143272 1201721>;

	qcom,fcc-temp-lut {
		qcom,lut-col-legend = <(-10) 0 23 60>;
		qcom,lut-data = <1919 2155 2281 2236>;
	};

	qcom,pc-temp-ocv-lut {
		qcom,lut-col-legend = <(-10) 0 23 60>;
		qcom,lut-row-legend = <100 95 90 85 80 75 70>,
				<65 60 55 50 45 40 35>,
				<30 25 20 15 10 9 8>,
				<7 6 5 4 3 2 1 0>;
		qcom,lut-data =  <4300 4300 4300 4300>,
				<4266 4266 4262 4249>,
				<4209 4212 4207 4195>,
				<4156 4159 4155 4144>,
				<4106 4109 4105 4095>,
				<4058 4064 4059 4048>,
				<4002 4011 4011 4004>,
				<3954 3967 3970 3965>,
				<3910 3921 3933 3921>,
				<3873 3878 3877 3874>,
				<3843 3847 3847 3846>,
				<3820 3825 3825 3823>,
				<3802 3807 3807 3804>,
				<3791 3793 3793 3788>,
				<3782 3783 3780 3759>,
				<3767 3772 3763 3735>,
				<3742 3746 3736 3710>,
				<3714 3711 3695 3678>,
				<3696 3694 3685 3664>,
				<3693 3692 3683 3663>,
				<3689 3689 3681 3660>,
				<3683 3683 3675 3650>,
				<3669 3668 3656 3626>,
				<3640 3639 3624 3586>,
				<3594 3591 3577 3534>,
				<3529 3527 3512 3467>,
				<3438 3436 3422 3374>,
				<3293 3282 3280 3231>,
				<3000 3000 3000 3000>;
	};

	qcom,rbatt-sf-lut {
		qcom,lut-col-legend = <(-10) 0 23 60>;
		qcom,lut-row-legend = <100 95 90 85 80 75 70>,
				<65 60 55 50 45 40 35>,
				<30 25 20 15 10 9 8>,
				<7 6 5 4 3 2 1 0>;
		qcom,lut-data = <607 314 100 62>,
				<615 323 104 64>,
				<624 332 107 67>,
				<636 342 111 71>,
				<650 352 116 74>,
				<667 376 125 78>,
				<667 386 133 79>,
				<665 395 150 85>,
				<656 378 163 89>,
				<655 359 119 73>,
				<670 360 113 73>,
				<698 375 121 76>,
				<735 394 128 80>,
				<800 423 136 87>,
				<902 476 144 77>,
				<1015 553 138 74>,
				<1108 620 135 76>,
				<1204 681 137 76>,
				<1200 685 148 80>,
				<1239 693 145 81>,
				<1281 721 151 81>,
				<1327 745 156 83>,
				<1368 765 156 84>,
				<1402 780 160 81>,
				<1451 805 165 81>,
				<1524 849 169 81>,
				<1624 907 178 87>,
				<1819 1018 201 201>,
				<3032 1951 615 615>;
	};
};
