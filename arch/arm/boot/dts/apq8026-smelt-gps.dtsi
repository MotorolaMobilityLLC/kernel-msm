/* Copyright (c) 2015, The Linux Foundation. All rights reserved.
 *
 * This program is free software; you can redistribute it and/or modify
 * it under the terms of the GNU General Public License version 2 and
 * only version 2 as published by the Free Software Foundation.
 *
 * This program is distributed in the hope that it will be useful,
 * but WITHOUT ANY WARRANTY; without even the implied warranty of
 * MERCHANTABILITY or FITNESS FOR A PARTICULAR PURPOSE.  See the
 * GNU General Public License for more details.
 */

/* CSR SSV GPS */
/ {
	ssv_gps@0 {
		compatible = "mot,ssv_gps";
		status = "ok";
		reg = <0 0>;
		gps-supply = <&pm8226_l9>;

		mot,spi-bus = <4>;
		mot,chip-select = <0>;
		mot,gps-spi-max-frequency = <6800000>;
		mot,rtc-clk = "sleep_clk";
		mot,modalias = "spidev";

		mot,boot-select-gpio = <&msmgpio 34 0x00>;
		mot,on-off-gpio      = <&msmgpio 37 0x00>;
		mot,irq-gpio         = <&msmgpio 46 0x00>;
		mot,reset-gpio       = <&msmgpio 48 0x00>;
		mot,host-wakeup-gpio = <&msmgpio 72 0x00>;
	};
};

/* L9 regulator for GPS */
&pm8226_l9 {
	regulator-min-microvolt = <1800000>;
	regulator-max-microvolt = <1800000>;
	qcom,init-voltage = <1800000>;
	qcom,init-ldo-mode = <1>;
};
