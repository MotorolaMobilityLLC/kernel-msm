mmi,ed30-sony-batterydata-alt {
	qcom,fcc-mah = <2036>;
	qcom,default-rbatt-mohm = <192>;
	qcom,rbatt-capacitive-mohm = <0>;
	qcom,flat-ocv-threshold-uv = <3800000>;
	qcom,max-voltage-uv = <4350000>;
	qcom,v-cutoff-uv = <3200000>;
	qcom,chg-term-ua = <180000>;
	qcom,batt-id-kohm = <65>; /* 64.9 kOhm Round Up */
	qcom,batt-id-range = <837898 900137>;

	qcom,fcc-temp-lut {
		qcom,lut-col-legend = <(-10) 0 23 60>;
		qcom,lut-data = <1599 1922 2036 2015>;
	};

	qcom,pc-temp-ocv-lut {
		qcom,lut-col-legend = <(-10) 0 23 60>;
		qcom,lut-row-legend = <100 95 90 85 80 75 70>,
				<65 60 55 50 45 40 35>,
				<30 25 20 15 10 9 8>,
				<7 6 5 4 3 2 1 0>;
		qcom,lut-data =  <4300 4300 4300 4300>,
				<4241 4230 4241 4222>,
				<4181 4175 4184 4169>,
				<4126 4123 4132 4117>,
				<4075 4074 4082 4070>,
				<4027 4028 4036 4026>,
				<3979 3984 3995 3985>,
				<3935 3940 3957 3949>,
				<3895 3900 3918 3910>,
				<3861 3865 3875 3865>,
				<3833 3838 3843 3838>,
				<3810 3816 3821 3817>,
				<3793 3799 3803 3798>,
				<3782 3786 3790 3784>,
				<3772 3776 3776 3760>,
				<3758 3763 3756 3731>,
				<3736 3742 3734 3712>,
				<3709 3711 3708 3687>,
				<3668 3680 3682 3663>,
				<3661 3675 3679 3660>,
				<3654 3670 3676 3656>,
				<3646 3663 3670 3647>,
				<3635 3651 3659 3629>,
				<3614 3626 3631 3597>,
				<3575 3584 3588 3554>,
				<3519 3529 3533 3499>,
				<3447 3457 3460 3429>,
				<3351 3359 3361 3335>,
				<3200 3200 3200 3200>;
	};

	qcom,rbatt-sf-lut {
		qcom,lut-col-legend = <(-10) 0 23 60>;
		qcom,lut-row-legend = <100 95 90 85 80 75 70>,
				<65 60 55 50 45 40 35>,
				<30 25 20 15 10 9 8>,
				<7 6 5 4 3 2 1 0>;
		qcom,lut-data = <577 360 100 61>,
				<588 357 104 64>,
				<598 354 108 66>,
				<608 351 114 68>,
				<615 354 119 70>,
				<619 355 127 73>,
				<612 349 141 77>,
				<601 331 154 86>,
				<593 311 149 93>,
				<593 301 120 68>,
				<602 299 109 68>,
				<620 305 110 69>,
				<646 315 112 69>,
				<686 328 118 74>,
				<736 345 122 70>,
				<796 361 116 70>,
				<875 377 110 70>,
				<733 408 110 70>,
				<814 330 109 70>,
				<862 339 109 69>,
				<918 354 112 70>,
				<988 372 112 71>,
				<1078 395 112 72>,
				<1191 413 112 72>,
				<1348 443 117 72>,
				<1604 498 123 75>,
				<2014 548 129 79>,
				<2698 724 144 96>,
				<4148 1111 244 193>;
	};
};
