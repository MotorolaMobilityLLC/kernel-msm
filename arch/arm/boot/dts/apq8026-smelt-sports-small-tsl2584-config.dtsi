/* Copyright (c) 2015, The Linux Foundation. All rights reserved.
 *
 * This program is free software; you can redistribute it and/or modify
 * it under the terms of the GNU General Public License version 2 and
 * only version 2 as published by the Free Software Foundation.
 *
 * This program is distributed in the hope that it will be useful,
 * but WITHOUT ANY WARRANTY; without even the implied warranty of
 * MERCHANTABILITY or FITNESS FOR A PARTICULAR PURPOSE.  See the
 * GNU General Public License for more details.
 */

&i2c_3 {
	tsl2584@29 {
		ams,lux1ch0_coeff = /bits/ 32 <1932>;
		ams,lux1ch1_coeff = /bits/ 32 <3054>;
		ams,lux2ch0_coeff = /bits/ 32 <1726>;
		ams,lux2ch1_coeff = /bits/ 32 <2539>;
	};

};
