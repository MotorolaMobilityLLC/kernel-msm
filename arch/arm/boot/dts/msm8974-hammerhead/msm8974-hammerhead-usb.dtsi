/* Copyright (c) 2012, Code Aurora Forum. All rights reserved.
 *
 * This program is free software; you can redistribute it and/or modify
* it under the terms of the GNU General Public License version 2 and
* only version 2 as published by the Free Software Foundation.
*
* This program is distributed in the hope that it will be useful,
* but WITHOUT ANY WARRANTY; without even the implied warranty of
* MERCHANTABILITY or FITNESS FOR A PARTICULAR PURPOSE.  See the
* GNU General Public License for more details.
*/

&usb3 {
	compatible = "qcom,dwc-usb3-msm";
	reg = <0xf9200000 0xfc000>,
		<0xfd4ab000 0x4>;
	qcom,dwc-usb3-msm-adc-low-threshold = <20>;
	qcom,dwc-usb3-msm-adc-high-threshold = <30>;
	qcom,dwc-hsphy-init = <0x00D1DDA4>;
	qcom,dwc-hsphy-host-init = <0x00D191A4>;

	dwc3@f9200000 {
		no-set-vbus-power;
	};
};
