/* Copyright (c) 2013, LGE Inc. All rights reserved.
 *
 * This program is free software; you can redistribute it and/or modify
 * it under the terms of the GNU General Public License version 2 and
 * only version 2 as published by the Free Software Foundation.
 *
 * This program is distributed in the hope that it will be useful,
 * but WITHOUT ANY WARRANTY; without even the implied warranty of
 * MERCHANTABILITY or FITNESS FOR A PARTICULAR PURPOSE.  See the
 * GNU General Public License for more details.
 */

&soc {
	anx7808_avdd33_vreg: avdd33 {
		compatible = "regulator-fixed";
		regulator-name = "avdd-3p3";
		gpio = <&pm8941_gpios 26 0x0>;
		enable-active-high;
	};

	anx7808_vdd10_vreg: vdd10 {
		compatible = "regulator-fixed";
		regulator-name = "vdd-1p0";
		gpio = <&pm8941_gpios 8 0x0>;
		enable-active-high;
	};
};
