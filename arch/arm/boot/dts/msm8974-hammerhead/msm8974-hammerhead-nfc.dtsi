/* Copyright (c) 2012, Code Aurora Forum. All rights reserved.
 *
 * This program is free software; you can redistribute it and/or modify
 * it under the terms of the GNU General Public License version 2 and
 * only version 2 as published by the Free Software Foundation.
 *
 * This program is distributed in the hope that it will be useful,
 * but WITHOUT ANY WARRANTY; without even the implied warranty of
 * MERCHANTABILITY or FITNESS FOR A PARTICULAR PURPOSE.  See the
 * GNU General Public License for more details.
 */

&soc {
	i2c@f9967000 {
		bcm2079x@77 {
			compatible = "bcm,bcm2079x";
			status = "disable";
			reg = <0x77>;
			bcm,i2c-pull-up = <1>;
			interrupt-parent = <&msmgpio>;
			interrupts = <59 0x2>;
			bcm,gpio_sda = <&msmgpio 83 0x00>;
			bcm,gpio_scl = <&msmgpio 84 0x00>;
			bcm,gpio_ven = <&msmgpio 94 0x00>;
			bcm,gpio_wake = <&msmgpio 92 0x00>;
			bcm,gpio_irq = <&msmgpio 59 0x00>;
		};
	};
};
