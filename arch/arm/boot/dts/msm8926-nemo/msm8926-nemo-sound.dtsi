/* Copyright (c) 2014,2015, LGE Inc. All rights reserved.
 *
 * This program is free software; you can redistribute it and/or modify
 * it under the terms of the GNU General Public License version 2 and
 * only version 2 as published by the Free Software Foundation.
 *
 * This program is distributed in the hope that it will be useful,
 * but WITHOUT ANY WARRANTY; without even the implied warranty of
 * MERCHANTABILITY or FITNESS FOR A PARTICULAR PURPOSE.  See the
 * GNU General Public License for more details.
 */

&soc {
	sound-9302 {
		qcom,audio-routing =
			"RX_BIAS", "MCLK",
			"LDO_H", "MCLK",
			"AMIC1", "MIC BIAS1 External",
			"MIC BIAS1 External", "Handset Mic";

		qcom,cdc-mclk-gpios = <&pm8226_gpios 1 0>;

		qcom,prim-auxpcm-gpio-clk  = <&msmgpio 49 0>;
		qcom,prim-auxpcm-gpio-sync = <&msmgpio 50 0>;
		qcom,prim-auxpcm-gpio-din  = <&msmgpio 51 0>;
		qcom,prim-auxpcm-gpio-dout = <&msmgpio 52 0>;
		qcom,prim-auxpcm-gpio-set  = "prim-gpio-tert";
	};
};
