/* Copyright (c) 2015, LGE Inc. All rights reserved.
 *
 * This program is free software; you can redistribute it and/or modify
 * it under the terms of the GNU General Public License version 2 and
 * only version 2 as published by the Free Software Foundation.
 *
 * This program is distributed in the hope that it will be useful,
 * but WITHOUT ANY WARRANTY; without even the implied warranty of
 * MERCHANTABILITY or FITNESS FOR A PARTICULAR PURPOSE.  See the
 * GNU General Public License for more details.
 */

#include "msm8926-nemo.dtsi"

&usb_otg {
	qcom,force-usb-full-speed;
	qcom,hsusb-otg-phy-init-seq =
		<0x44 0x80 0x68 0x81 0x38 0x82 0x13 0x83 0xffffffff>;
};

&dsi_lgd_lg4262_cmd {
		qcom,mdss-dsi-idle-on-command = [
					39 01 00 00 00 00 05 2A 00 00 01 DF
					39 01 00 00 00 00 05 2B 00 00 01 DF
					39 01 00 00 00 00 03 61 4D 00
					15 01 00 00 00 00 02 63 A9
					15 01 00 00 00 00 02 5C 00
					15 01 00 00 00 00 02 B0 AC
					39 01 00 00 00 00 2B DB
					01 1B FF A7 FF 12
					3F 3F 3F 00 1F 24
					25 20 29 25 00 3F
					1C 26 22 22 AA 20
					33 10 0A 20 5A 20
					60 00 4D 00 01 00
					60 00 4D 00 01 00 /* PSM */
					05 01 00 00 00 00 01 39 /* Idle Mode On */
					];
		qcom,mdss-dsi-idle-off-command = [
					39 01 00 00 00 00 05 2A 00 00 01 DF
					39 01 00 00 00 00 05 2B 00 00 01 DF
					39 01 00 00 00 00 03 61 4D 00
					15 01 00 00 00 00 02 63 A0
					15 01 00 00 00 00 02 5C 20
					15 01 00 00 00 00 02 B0 AC
					39 01 00 00 00 00 26 D0
					1A E7 07 61 87 5C
					87 00 00 00 0C 0F
					1B 1E 2A 2D 39 3C
					48 4B 57 0C 1B 2A
					39 48 57 0C 1B 2A
					39 48 57 03 03 00
					00
					39 01 00 00 00 00 2B DB
					01 1B FF A7 FF 12
					3F 3F 3F 00 1F 24
					25 20 29 25 00 3F
					1C 26 22 22 AA 20
					33 10 0A 20 5A 20
					60 00 4D 00 01 00
					60 00 4D 00 01 00 /* PSM */
					05 01 00 00 32 00 01 38 /* Idle Mode Off  */
					];
};
