mmi,ed30-lishen-batterydata {
	qcom,fcc-mah = <2059>;
	qcom,default-rbatt-mohm = <220>;
	qcom,rbatt-capacitive-mohm = <0>;
	qcom,flat-ocv-threshold-uv = <3800000>;
	qcom,max-voltage-uv = <4350000>;
	qcom,v-cutoff-uv = <3200000>;
	qcom,chg-term-ua = <159000>;
	qcom,batt-id-kohm = <65>;
	qcom,batt-id-range = <837898 900137>;

	qcom,fcc-temp-lut {
		qcom,lut-col-legend = <(-10) 0 23 60>;
		qcom,lut-data = <1381 1933 2059 2063>;
	};

	qcom,pc-temp-ocv-lut {
		qcom,lut-col-legend = <(-10) 23 60>;
		qcom,lut-row-legend = <100 95 90 85 80 75 70>,
				<65 60 55 50 45 40 35>,
				<30 25 20 15 10 9 8>,
				<7 6 5 4 3 2 1 0>;
		qcom,lut-data = <4300 4300 4300>,
				<4260 4254 4242>,
				<4201 4197 4185>,
				<4147 4143 4132>,
				<4095 4091 4080>,
				<4041 4043 4033>,
				<3987 3999 3989>,
				<3941 3960 3950>,
				<3900 3919 3908>,
				<3864 3869 3861>,
				<3837 3838 3833>,
				<3815 3817 3812>,
				<3798 3800 3794>,
				<3787 3787 3779>,
				<3778 3776 3758>,
				<3766 3763 3734>,
				<3746 3741 3715>,
				<3721 3712 3686>,
				<3697 3687 3665>,
				<3694 3685 3663>,
				<3692 3683 3660>,
				<3688 3681 3656>,
				<3681 3675 3647>,
				<3662 3658 3625>,
				<3625 3622 3585>,
				<3571 3570 3532>,
				<3501 3499 3462>,
				<3404 3397 3364>,
				<3200 3200 3200>;
	};

	qcom,rbatt-sf-lut {
		qcom,lut-col-legend = <(-10) 23 60>;
		qcom,lut-row-legend = <100 95 90 85 80 75 70>,
				<65 60 55 50 45 40 35>,
				<30 25 20 15 10 9 8>,
				<7 6 5 4 3 2 1 0>;
		qcom,lut-data = <100 100 100>,
				<100 100 100>,
				<100 100 100>,
				<100 100 100>,
				<100 100 100>,
				<100 100 100>,
				<100 100 100>,
				<100 100 100>,
				<100 100 100>,
				<100 100 100>,
				<100 100 100>,
				<100 100 100>,
				<100 100 100>,
				<100 100 100>,
				<100 100 100>,
				<100 100 100>,
				<100 100 100>,
				<100 100 100>,
				<100 100 100>,
				<100 100 100>,
				<100 100 100>,
				<100 100 100>,
				<100 100 100>,
				<100 100 100>,
				<100 100 100>,
				<100 100 100>,
				<100 100 100>,
				<100 100 100>,
				<100 100 100>;
	};
};