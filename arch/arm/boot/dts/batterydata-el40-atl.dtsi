mmi,el40-atl-batterydata {
	qcom,fcc-mah = <1920>;
	qcom,default-rbatt-mohm = <173>;
	qcom,rbatt-capacitive-mohm = <0>;
	qcom,flat-ocv-threshold-uv = <3800000>;
	qcom,max-voltage-uv = <4350000>;
	qcom,v-cutoff-uv = <3200000>;
	qcom,chg-term-ua = <164000>;
	qcom,batt-id-kohm = <45>;
	qcom,batt-id-range = <680624 739842>;

	qcom,fcc-temp-lut {
		qcom,lut-col-legend = <(-10) 0 23 60>;
		qcom,lut-data = <1591 1822 1920 1924>;
	};

	qcom,pc-temp-ocv-lut {
		qcom,lut-col-legend = <(-10) 0 23 60>;
		qcom,lut-row-legend = <100 95 90 85 80 75 70>,
				<65 60 55 50 45 40 35>,
				<30 25 20 15 10 9 8>,
				<7 6 5 4 3 2 1 0>;
		qcom,lut-data = <4300 4300 4300 4300>,
				<4261 4261 4261 4248>,
				<4202 4203 4205 4193>,
				<4148 4149 4150 4139>,
				<4097 4098 4098 4088>,
				<4046 4051 4050 4041>,
				<3990 3998 4004 3997>,
				<3944 3956 3963 3956>,
				<3902 3908 3911 3903>,
				<3867 3870 3870 3867>,
				<3839 3842 3843 3840>,
				<3817 3820 3821 3817>,
				<3799 3803 3803 3798>,
				<3786 3789 3789 3782>,
				<3775 3776 3773 3752>,
				<3762 3763 3751 3727>,
				<3742 3745 3733 3709>,
				<3716 3721 3709 3684>,
				<3698 3697 3687 3665>,
				<3695 3695 3685 3661>,
				<3691 3692 3683 3658>,
				<3684 3688 3677 3652>,
				<3668 3677 3663 3637>,
				<3638 3649 3634 3607>,
				<3599 3609 3596 3565>,
				<3548 3556 3546 3513>,
				<3481 3487 3479 3447>,
				<3385 3386 3382 3356>,
				<3200 3200 3200 3200>;
	};

	qcom,rbatt-sf-lut {
		qcom,lut-col-legend = <(-10) 0 23 60>;
		qcom,lut-row-legend = <100 95 90 85 80 75 70>,
				<65 60 55 50 45 40 35>,
				<30 25 20 15 10 9 8>,
				<7 6 5 4 3 2 1 0>;
		qcom,lut-data = <477 282 100 59>,
				<494 292 104 62>,
				<510 303 109 66>,
				<525 316 112 67>,
				<542 332 116 69>,
				<555 354 126 71>,
				<533 359 138 75>,
				<530 355 159 84>,
				<517 325 134 72>,
				<515 311 113 68>,
				<524 312 112 69>,
				<540 321 115 71>,
				<560 332 119 71>,
				<590 344 128 76>,
				<637 358 131 68>,
				<696 381 115 69>,
				<763 410 117 71>,
				<815 429 122 72>,
				<825 413 124 72>,
				<853 424 121 72>,
				<902 443 124 72>,
				<961 469 128 74>,
				<1020 494 131 75>,
				<1087 508 137 74>,
				<1178 543 145 74>,
				<1305 598 154 76>,
				<1486 675 160 81>,
				<1779 797 178 93>,
				<2756 1246 486 208>;
	};
};