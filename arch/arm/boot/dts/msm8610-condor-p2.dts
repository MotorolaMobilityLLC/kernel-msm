/* Copyright (c) 2013, The Linux Foundation. All rights reserved.
 *
 * This program is free software; you can redistribute it and/or modify
 * it under the terms of the GNU General Public License version 2 and
 * only version 2 as published by the Free Software Foundation.
 *
 * This program is distributed in the hope that it will be useful,
 * but WITHOUT ANY WARRANTY; without even the implied warranty of
 * MERCHANTABILITY or FITNESS FOR A PARTICULAR PURPOSE.  See the
 * GNU General Public License for more details.
 */

/dts-v1/;

/include/ "msm8610-moto-reserve.dtsi"
/include/ "msm8610-v2.dtsi"
/include/ "msm8610-moto-common.dtsi"

/ {
	/* HWREV: 0x0101 0x8200
	 *        ^^^^^^ ^^^^^^
	 *        Rev1.1 P2
	 */
	qcom,msm-id = <147 0x41 0x01018200>;
};

&soc {
	factory_support {
		compatible = "mmi,factory-support-kungpow";
		gpios = <&msmgpio 77 0x0>, /* GPIOF_OUT_INIT_LOW */
			<&msmgpio 75 0x1>, /* GPIOF_IN */
			<&msmgpio 76 0x1>; /* GPIOF_IN */
		gpio-names = "factory_kill_disable",
			"factory_cable_detect",
			"factory_warn";
	};
};
