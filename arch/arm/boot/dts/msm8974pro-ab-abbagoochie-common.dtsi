/* Copyright (c) 2013 Motorola Mobility LLC
 *
 * This program is free software; you can redistribute it and/or modify
 * it under the terms of the GNU General Public License version 2 and
 * only version 2 as published by the Free Software Foundation.
 *
 * This program is distributed in the hope that it will be useful,
 * but WITHOUT ANY WARRANTY; without even the implied warranty of
 * MERCHANTABILITY or FITNESS FOR A PARTICULAR PURPOSE.  See the
 * GNU General Public License for more details.
 */

/include/ "msm8974pro-ab-moto-common.dtsi"
/include/ "dsi-panel-mot-smd-720p-video.dtsi"

/ {
	model = "Motorola QC-MSM8974 Pro Abbagoochie";
	compatible = "qcom,msm8974-abbagoochie",
		     "qcom,msm8974-moto",
		     "qcom,msm8974";

	qcom,mdss_dsi_mot_smd_720p_video {
		status = "ok";
	};
};

&mot_smd_720p_vid {
	vbat_disp-supply = <&vbat_disp_vreg>;
	vdd_disp-supply = <&vdd_disp_vreg>;
	vci_disp-supply = <&vci_disp_vreg>;
};
