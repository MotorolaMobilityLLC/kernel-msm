## arch/arm/mach-msm/lge/Kconfig.board
```kconfig
#
# Inlcude the specific Kconfig file for LGE board
#

# MAKO
source "arch/arm/mach-msm/lge/mako/Kconfig"
```

## arch/arm/mach-msm/lge/mako/Kconfig
```kconfig
config BOARD_HEADER_FILE
	string "LGE board specific header file name"
	default ""

config MACH_APQ8064_MAKO
	depends on ARCH_APQ8064
	select MACH_LGE
	bool "MSM8064 MAKO"
	help
	  Support for the LGE MAKO device.
```

## arch/arm/mach-msm/sprat/Kconfig
```kconfig
config SEC_PROJECT
	bool "Samsung project"
	default n
	help
	  Support for Samsung project.

config MACH_MSM8226_SPRAT
	bool "MSM8226 SPRAT"
    default n
    help
      MSM8226 MODEL SPRAT Specific changes for differentiating
      it with the other models on the same MSM8x26 chipset.

config BT_BCM4334
	bool "Enable BCM4334 driver"
	default n
	help
	Adds BCM4334 RFKILL driver for Broadcom BCM4334 chipset.
	default is n.
```

## arch/arm/mvp/Kconfig
```kconfig
config VMWARE_MVP
       bool "Build VMware Mobile Virtualization Platform modules"
       select SYSFS
       select NAMESPACES
       select NET_NS
       select INET
       select IPV6
       select TUN
       select NETFILTER
       help
	 Say Y here to enable the building of kernel modules
	 for VMware's Mobile Virtualization Platform

config VMWARE_MVP_DEBUG
       bool "Enable debug for VMware Mobile Virtualization Platform modules"
       depends on VMWARE_MVP
       select IKCONFIG
       select IKCONFIG_PROC
       help
	 Say Y here to enable debug on kernel modules
	 for VMware's Mobile Virtualization Platform.
	 This should be enabled for eng or userdebug builds.

config VMWARE_PVTCP_DEBUG
       bool "Enable debug for VMware PVTCP modules"
       depends on VMWARE_MVP_DEBUG
       help
	 Say Y here to enable debug on the PVTCP networking
	 kernel modules for VMware's Mobile Virtualization
	 Platform. This should only be enabled for eng or
	 userdebug builds.
```
