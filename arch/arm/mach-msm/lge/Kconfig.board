## drivers/eom/Kconfig
```kconfig
# SPDX-License-Identifier: GPL-2.0-only
# Copyright (c) Qualcomm Technologies, Inc. and/or its subsidiaries.

config EOM_MSM
	tristate "Eye Opening Monitor (EOM) framework support"
	help
	  This option enables support for the Eye Opening Monitor (EOM) framework,
	  which provides a generic interface for controlling and collecting EOM data
	  from various hardware subsystems. The EOM framework is typically used to
	  monitor signal integrity and eye diagrams in high-speed interfaces.

	  Enable this option if your platform includes hardware that supports EOM
	  and you need to collect or analyze signal quality metrics.


config USB_MSM_EOM
	tristate "MSM USB EOM driver"
	depends on EOM_MSM
	help
	  This option enables the Eye Opening Monitor (EOM) driver for USB PHYs
	  on Qualcomm MSM platforms. It allows monitoring of signal quality and
	  eye diagram characteristics specific to USB interfaces.

	  Enable this option if your MSM-based system uses USB PHYs that support
	  EOM and you need to collect signal integrity data for diagnostics or tuning
```

## drivers/eom/pcie/Kconfig
```kconfig
# SPDX-License-Identifier: GPL-2.0-only
# Copyright (c) Qualcomm Technologies, Inc. and/or its subsidiaries.

config PCI_MSM_EOM
	tristate "MSM PCIE EOM driver"
	depends on PCI_MSM && EOM_MSM
	help
	  This option enables the EOM for PCIe for MSM platforms.
	  This will enable the pcie phy access driver which is a
	  interface to access PCIe PHYs through the EOM framework.
	  Enable this if you are using EOM for PCIe PHY.
```

## drivers/external_drivers/Kconfig
```kconfig
menuconfig EXTERNAL_DRIVERS
	bool "Enable support to external drivers"
	depends on X86
	default y
	help
	  External drivers are drivers located outside this kernel tree
	  but allowed to be configured as builtin.
	  External drivers directories will behave as a regular directory
	  inside kernel tree.

if EXTERNAL_DRIVERS

menuconfig EXTERNAL_MISC_DRIVERS
	bool "Enable support to misc drivers"
	depends on EXTERNAL_DRIVERS
	default y
	help
	  Enable support to external misc drivers.

if EXTERNAL_MISC_DRIVERS
source "drivers/external_drivers/drivers/Kconfig"
endif

menuconfig EXTERNAL_INTEL_MEDIA
	bool "Enable support to intel media drivers"
	depends on EXTERNAL_DRIVERS
	default y
	help
	  Enable support to external intel media drivers.

if EXTERNAL_INTEL_MEDIA
source "drivers/external_drivers/intel_media/Kconfig"
endif

menuconfig EXTERNAL_CAMERA
        bool "Enable support to Intel camera drivers"
        depends on EXTERNAL_DRIVERS
        default y
        help
          Enable support to external Intel camera drivers.

if EXTERNAL_CAMERA
source "drivers/external_drivers/camera/Kconfig"
endif

endif
```

## drivers/external_drivers/drivers/Kconfig
```kconfig
source "drivers/external_drivers/drivers/hwmon/Kconfig"
source "drivers/external_drivers/drivers/misc/Kconfig"
source "drivers/external_drivers/drivers/i2c/busses/Kconfig"
source "drivers/external_drivers/drivers/power/Kconfig"
source "drivers/external_drivers/drivers/platform/x86/Kconfig"
source "drivers/external_drivers/drivers/hsu/Kconfig"
source "drivers/external_drivers/drivers/input/Kconfig"
```

## drivers/external_drivers/drivers/hsu/Kconfig
```kconfig
config SERIAL_MFD_HSU_EXT
	tristate "Medfield High Speed UART support"
	depends on PCI
	select SERIAL_CORE

config SERIAL_MFD_HSU_EXT_CONSOLE
	boolean "Medfile HSU serial console support"
	depends on SERIAL_MFD_HSU_EXT=y
	select SERIAL_CORE_CONSOLE
```
