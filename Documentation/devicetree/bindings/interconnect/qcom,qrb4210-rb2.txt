## Documentation/devicetree/bindings/leds/leds-aw2016.txt
```
/*
 * Copyright (C) 2008 Shanghai awinic technology co.,ltd. All rights reserved.
 *
 * Permission is hereby granted, free of charge, to any person obtaining a
 * copy of this software and associated documentation files (the "Software"),
 * to deal in the Software without restriction, including without limitation
 * the rights to use, copy, modify, merge, publish, distribute, sublicense,
 * and/or sell copies of the Software, and to permit persons to whom the
 * Software is furnished to do so, subject to the following conditions:
 *
 * The above copyright notice and this permission notice shall be
 * included in all copies or substantial portions of the Software.
 *
 * THE SOFTWARE IS PROVIDED "AS IS", WITHOUT WARRANTY OF ANY KIND, EXPRESS OR
 * IMPLIED, INCLUDING BUT NOT LIMITED TO THE WARRANTIES OF MERCHANTABILITY,
 * FITNESS FOR A PARTICULAR PURPOSE AND NONINFRINGEMENT. IN NO EVENT SHALL
 * THE AUTHORS OR COPYRIGHT HOLDERS BE LIABLE FOR ANY CLAIM, DAMAGES OR OTHER
 * LIABILITY, WHETHER IN AN ACTION OF CONTRACT, TORT OR OTHERWISE, ARISING
 * FROM, OUT OF OR IN CONNECTION WITH THE SOFTWARE OR THE USE OR OTHER
 * DEALINGS
 * IN THE SOFTWARE.
 */

Awinic. AW2016 LED

AW2016 LED device supports 3 LED channels and the driver
register each channel as a single LED class device and
exports interfaces to update brightness, set timer trigger
and enable HW based blink functionalities.

- compatible
  Usage: required
  Value type: <string>
  Definition: Must be "awinic,aw2016_led"

- reg
  Usage: required
  Value type: <u32>
  Definition: The 7-bit I2C address for AW2016 chip.

Properties for child properties:
- awinic,name
  Usage: required
  Value type: <string>
  Definition: Name of the LED which will be register as the LED class
	device name.

- awinic,id
  Usage: required
  Value type: <u32>
  Definition: It represents the LED hardware channel index. The valid
	values are: 0, 1, 2.

- awinic,imax
  Usage: required
  Value type: <u32>
  Definition: The setting of the maximum current for the given LED channel,
	the valid values are: 0, 1, 2, 3, and the corresponding current
	setting are: 15mA, 30mA, 5mA, 10mA.

- awinic,led-current
  Usage: required
  Value type: <u32>
  Definition: The setting of the current when the LED channel is enabled.

- awinic,max-brightness
  Usage: required
  Value type: <u32>
  Definition: The maximum brightness value for the LED class device.

- awinic,rise-time-ms
  Usage: required
  Value type <u32>
  Definition: The duration of the led ramping from 0 to maximum brightness
	when breath function is enabled.

- awinic,hold-time-ms
  Usage: required
  Value type: <u32>
  Definition: The duration of the led staying at the maximum brightness
	when breath function is enabled.

- awinic,fall-time-ms
  Usage: required
  Value type: <u32>
  Definition: The duration of the led ramping down from maximum brightness
	to 0 when breath function is enabled.

- awinic,off-time-ms
  Usage: required
  Value type: <u32>
  Definition: The duration of the led staying at 0 brightness when breath
	function is enabled.

Example:
	awinic@64 {
		compatible = "awinic,aw2016_led";
		reg = <0x64>;

		awinic,red {
			awinic,name = "red";
			awinic,id = <0>;
			awinic,imax = <2>;
			awinic,led-current = <3>;
			awinic,max-brightness = <255>;
			awinic,rise-time-ms = <6>;
			awinic,hold-time-ms = <0>;
			awinic,fall-time-ms = <6>;
			awinic,off-time-ms = <4>;
		};

		awinic,green {
			awinic,name = "green";
			awinic,id = <1>;
			awinic,imax = <2>;
			awinic,led-current = <3>;
			awinic,max-brightness = <255>;
			awinic,rise-time-ms = <6>;
			awinic,hold-time-ms = <0>;
			awinic,fall-time-ms = <6>;
			awinic,off-time-ms = <4>;
		};

		awinic,blue {
			awinic,name = "blue";
			awinic,id = <2>;
			awinic,imax = <2>;
			awinic,led-current = <3>;
			awinic,max-brightness = <255>;
			awinic,rise-time-ms = <6>;
			awinic,hold-time-ms = <0>;
			awinic,fall-time-ms = <6>;
			awinic,off-time-ms = <4>;
		};
	};
```

## Documentation/devicetree/bindings/leds/leds-bd65b60.txt
```
ROHM leds-bd65b60 LEDs driver is used for controlling LEDs connected
to BD65B60GWL integrated backlight driver. The IC is connected to
Host processor via i2C bus.

Required properties:
- compatible		: string should be "rohm,leds-bd65b60"
- reg			: interger should be I2C address of the device
- linux,name		: name of the led that is used in led framework
- rohm,led1-used	: boolean use LED1 terminal
- rohm,led2-used	: boolean use LED2 terminal

Optional properties:
- linux,default-trigger	: string trigger the led from external modules such as display
- rohm,ovp-val		: integer over voltage protection threshold, follows enum bd65b60_ovp
- rohm,default-on	: boolean default state of the led, should be "on" or "off"
- rohm,init-level	: integer default level applied if default state is "on"
- rohm,pwm-on		: boolean to enable pwm input for cabc or our own pwm device
- rohm,pwm-period	: integer pwm period in nanoseconds if we want to control pwm device

Example:

bd65b60@64 {
	compatible = "rohm,leds-bd65b60";
	reg = <0x64>;
	status = "okay";
	linux,name = "lcd0:lcd-backlight";
	linux,default-trigger = "lcd-backlight";
	rohm,default-state = "off";
};
```

## Documentation/devicetree/bindings/leds/leds-fan5646.txt
```
MMI fan5646 Leds

MMI fan5646 LEDs driver is used for controlling LEDs
driven by FSI FAN5646 Controller. The IC is connected
to host processor via dedicated GPIO line.
TinyWire protocol is used to communicate with the chip.

Required properties:
- compatible		: should be "fsi,leds-fan5646"
- gpios			: gpio cell to describe pin used to control the IC
- tsleep		: bit duration for TinyWire protocol in us. Max 40us, Min 500 ns.
- full-current		: full-scale LED current setting for Iset bits in control register
			: CONTROL[6:7]:
			: 0 - 5 mA, 1 - 10 mA, 2 - 15 mA, 3 - 20 mA
			: This assumed that Rset resistor is not used as well.
			: Which is always true for for WLCSP packages.
- fan5646-supply	: Phandle of the supply node used to power the IC.
- linux-name 		: Linux led class device name for led connected to the IC.
- rgb-class-name	: Linux led class name for the rgb device.
```

## Documentation/devicetree/bindings/leds/leds-isl98611.txt
```
Intersil leds-isl98611 LEDs driver is used for controlling LEDs connected
to ISL98611 integrated display power and LED backlight driver.
The IC is connected to Host processor via i2C bus.

Required properties:
- compatible		: string should be "intersil,leds-isl98611"
- reg			: interger should be I2C address of the device
- linux,name		: name of the led that is used in led framework

Integer Register values will be written to the corresponding offsets of the IC after
applicable masking. Please refer to the ISL98611 manual for the interpretation.

Optional properties for backlight led:
- linux,default-trigger		: string trigger the led from external modules such as display
- intersil,default-on		: boolean default on for the led
- intersil,init-level		: integer default level applied if default-on is true
- intersil,no-reset		: boolean do not issue SW reset for IC during driver probe
- intersil,cabc-disable		: boolean do not use CABC inputs. PON vlaue is ON.
- intersil,hbm-on		: boolean enable high brightness mode (HBM) support.
- intersil,led-current		: integer current level for led current register  @ 0x12
- intersil,current-scale	: integer current level for led current multiplier register  @ 0x12
- intersil,hbm-led-current	: integer high brightness mode current level for led current register  @ 0x12
- intersil,hbm-current-scale	: integer high brightness mode current level for led current multiplier register  @ 0x12
- intersil,pwm-res		: integer pwm resolution for pwm res register @ 0x14
- intersil,dimm-threshold	: integer dimming threshold for dimming control register @ 0x13
- intersil,switch-supply	: name of the regulator to aquire and enable
- intersil,pfm-value		: register 0x15 setting for PFM entry threshold

Optional properties for display power control settings:
- intersil,vn		: negative supply voltage calculated as VN = -4.5V - vn*50mV
- intersil,vp		: positive supply voltage calculated as VP = 4.5V + vp*50mV

Example:

isl98611@29 {
	compatible = "intersil,leds-isl98611";
	reg = <0x29>;
	status = "okay";
	linux,name = "wled:backlight";
	linux,default-trigger = "bkl-trigger";
	intersil,default-on;
	intersil,vn = <20>;
	intersil,vp = <20>;
};
```

## Documentation/devicetree/bindings/leds/leds-lm2755.txt
```
MMI lm2755 Leds

MMI lm2755 LEDs driver is used for controlling LEDs
driven by TI LM2755 Controller. The IC is connected
to Host processor via I2C bus. This driver supports single
color LED linux devices and RGB tricolor device with configu-
rable blink profile. RGB interface provides combined control
for LEDs on D1, D2 and D3 outputs.

Required properties:
- compatible		: should be "lm,lm2755"
- reg			: I2C address two possible configurations:
			: 0x18 if ADDR pin is grounded
			: 0x67 if ADDR pin is tied high
- clock-mode		: clock mode 0x0 for internal, 0x40 for external clock
- charge-pump-mode	: charge pump mode parameter should be 0x0 or 0x80. In mode 0x80 waveform can
			: be enabled before the charge pump. With mode 0x0 charge pump is powered on
			: before waveform generator
- min-tstep		: Sets N for timing control equations. Valid range from 0 to 7. Defines Tstep:
			: For internal clock Tstep = 50us*2^N
			: For external clock Tstep = 2^N*(32 + Fext)
- max-level 		: max brightness level. LM2755 has 32 brightness levels. Max 0x1F.
			: At least one of the three led outputs has to be configured:
- d1-led-name 		: linux name for led connected to D1 output. No property means output is not used.
- d2-led-name 		: linux name for led connected to D2 output. No property means output is not used.
- d3-led-name 		: linux name for led connected to D3 output. No property means output is not used.

Optional properties for RGB device:
- rgb-class-name	: Linux led class name for the combined rgb device. Default "rgb".
```

## Documentation/devicetree/bindings/leds/leds-lm3633.txt
```
TI LMU LM3633 LED device tree bindings

Required properties:
  - compatible: "ti,lm3633-leds"
  - lvled1-used, lvled2-used, lvled3-used, lvled4-used, lvled5-used, lvled6-used
    : LED string configuration. Each child node should include this information
      about which LED string is used.

Optional properties:
  - chan-name: LED channel name
  - max-current-milliamp: Max current setting. Unit is mA.

Example:

lm3633@36 {
	compatible = "ti,lm3633";
	reg = <0x36>;

	ti,enable-gpio = <&gpio5 6 GPIO_ACTIVE_HIGH>;

	leds {
		compatible = "ti,lm3633-leds";

		chan2 {
			chan-name = "status";
			lvled2-used;
			max-current-milliamp = /bits/ 8 <6>;
		};

		chan456 {
			chan-name = "rgb";
			lvled4-used;
			lvled5-used;
			lvled6-used;

			max-current-milliamp = /bits/ 8 <5>;
		};
	};
};
```

## Documentation/devicetree/bindings/leds/leds-lm3648.txt
```
* TI LM3648 Flash Led driver

Required properties:
- cell-index : Should contain flash source index to diffentiate
    between different flash devices. These indexes represent flash devices
    for multiple flashes.
    - 0, 1, 2, 3
- compatible : should be "ti,lm3648"
- gpios : contain phandle to gpio controller node and array of
    #gpio-cells specifying specific gpio (controller specific)
- qcom,gpio-req-tbl-num : contain index to gpios specific to this flash
- qcom,gpio-req-tbl-flags : contain direction of gpios present in
    qcom,gpio-req-tbl-num property (in the same order)
- qcom,gpio-req-tbl-label : contain name of gpios present in
    qcom,gpio-req-tbl-num property (in the same order)
- qcom,gpio-flash-reset : contain index to gpio used by flash's "flash reset" pin.
- qcom,gpio-flash-en : contain index to gpio used by flash's "flash enable" pin.
- qcom,gpio-flash-now : contain index to gpio used by flash's "flash now" pin.
- label : contain unique flash name to differentiate from other flash
    - shoule be "lm3648"
- qcom,flash-type : type of flash device should be:
    - 1 for LED flash.
- qcom,cci-master : should contain i2c master id to be used for this flash.
    - 0 -> MASTER 0
    - 1 -> MASTER 1

Example:

	led_flash1: ti,lm3648@c6 {
		cell-index = <0>;
		qcom,slave-id = <0xc6 0x0c 0x02>;
		compatible = "ti,lm3648";
		label = "lm3648";
		qcom,flash-type = <1>;
		qcom,gpio-no-mux = <0>;
		gpios = <&msm_gpio 32 0>, /*FLASH_RST(HW_EN)*/
			<&msm_gpio 114 0>, /*TORCH_EN*/
			<&msm_gpio 31 0>; /*FLASH_NOW*/
		qcom,gpio-flash-reset = <0>;
		qcom,gpio-flash-en = <1>;
		qcom,gpio-flash-now = <2>;
		qcom,gpio-req-tbl-num = <0 1 2>;
		qcom,gpio-req-tbl-flags = <0 0 0>;
		qcom,gpio-req-tbl-label = "FLASH_RST",
			"FLASH_EN",
			"FLASH_NOW";
		qcom,cci-master = <0>;
	};
```

## Documentation/devicetree/bindings/leds/leds-msm-gpio-flash.txt
```
Qualcomm GPIO Flash Leds

Qualcomm GPIO flash LEDs driver is used for
controlling flash LEDs that are connected with 2 GPIOs.  The 2 GPIOs are name
flash_en and flash now.


The flash LEDs has torch mode and flash mode. The flash mode is used for camera.
The torch mode is used for torch.


Required properties for each node:
- compatible        : should be "qcom,leds-gpio-flash"
- qcom,flash-en     : the GPIO pin number of flash-en function
- qcom,flash-now    : the GPIO pin number of flash-now function
- linux,name        : name of the led that is used in led framework
- linux,default-trigger : name of the led trigger event
- qcom,op-seq       : GPIO config name
- clocks            : A list of clk correspondence with the gpio pinfunc,
  it is an optional property, it is needed when the flash need use clk
  waveform to driver, and rcg clk is also optional, it is needed when
  the used clk can't configure the duty cycle, we use the parent clk to
  configure the duty cycle.
- clock-names       : Names of the clocks in 1-1 correspondence with the
  "clocks" property.
- qcom,duty-cycle   : It is used to configure the duty cycle in clk mode.
- qcom,clk-freq     : Frequence of clk
- qcom,torch-seq-val: GPIO config value for torch mode
- qcom,flash-seq-val: GPIO config value for flash mode
- pinctrl-names     : pinctrl name
- pinctrl-0         : default gpio stats

No other optional properties for it.

Example:

	flashlight {
		compatible = "leds-gpio-flash";
		status = "okay";
		pinctrl-names = "flash_default";
		pinctrl-0 = <&flash_default>;
		qcom,flash-en = <&msmgpio 31 0>;
		qcom,flash-now = <&msmgpio 32 0>;
		qcom,op-seq = "flash_en", "flash_now";
		clocks = <&clock_gcc clk_camss_gp0_clk>,
			<&clock_gcc clk_camss_gp0_clk_src>,
			<&clock_gcc clk_camss_gp1_clk>,
			<&clock_gcc clk_camss_gp1_clk_src>;
		clock-names = "flash_en_clk", "flash_en_duty_cycle_clk",
			"flash_now_clk", "flash_now_duty_cycle_clk";
		qcom,duty-cycle = <40 30>;
		qcom,clk-freq = <150000 150000>;
		qcom,torch-seq-val = <1, 0>;
		qcom,flash-seq-val = <0, 1>;
		linux,name = "flashlight";
		linux,default-trigger = "flashlight-trigger";
	};
```
