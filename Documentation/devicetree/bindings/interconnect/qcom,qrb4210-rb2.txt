## Documentation/devicetree/bindings/interconnect/qcom,qrb4210-rb2.txt
```
QTI BENGAL Network-On-Chip interconnect driver binding
-----------------------------------------------------------

Required properties :
- compatible : shall contain only one of the following:
			"qcom,bengal-bimc",
			"qcom,bengal-system_noc",
			"qcom,bengal-config_noc",
			"qcom,bengal-clk_virt",
			"qcom,bengal-mmnrt_virt",
			"qcom,bengal-mmrt_virt",
- #interconnect-cells : should contain 1

reg : specifies the physical base address and size of registers
clocks : list of phandles and specifiers to all interconnect bus clocks
clock-names : clock names should include both "bus" and "bus_a"

The following are optional properties:

qcom,util-factor : Parameter that represents the DDR utilization factor
		to be used in aggregation scheme. It is represented as
		actual util-factor * 100.

Examples:

soc {
	...
	system_noc: interconnect@1880000 {
		reg = <0x1880000 0x5f080>;
		compatible = "qcom,bengal-system_noc";
		qcom,util-factor = <142>;
		#interconnect-cells = <1>;
		clock-names = "bus", "bus_a";
		clocks = <&rpmcc RPM_SMD_SNOC_CLK>,
			<&rpmcc RPM_SMD_SNOC_A_CLK>;
	};

	config_noc: interconnect@1900000 {
		reg = <0x1900000 0x6200>;
		compatible = "qcom,bengal-config_noc";
		#interconnect-cells = <1>;
		clock-names = "bus", "bus_a";
		clocks = <&rpmcc RPM_SMD_CNOC_CLK>,
			<&rpmcc RPM_SMD_CNOC_A_CLK>;
	};
};
```

## Documentation/devicetree/bindings/interconnect/qcom,sc8180x.txt
```
Qualcomm Technologies, Inc. SC8180X Network-On-Chip interconnect driver binding
------------------------------------------------------------------------------

SC8180X interconnect providers support system bandwidth requirements through
RPMh hardware accelerators known as Bus Clock Manager (BCM). The provider is
able to communicate with the BCM through the Resource State Coordinator (RSC)
associated with each execution environment. Provider nodes must point to at
least one RPMh device child node pertaining to their RSC and each provider
can map to multiple RPMh resources.

Required properties :
- compatible : shall contain only one of the following:
			"qcom,sc8180x-aggre1-noc";
			"qcom,sc8180x-aggre2-noc";
			"qcom,sc8180x-camnoc-virt";
			"qcom,sc8180x-compute-noc";
			"qcom,sc8180x-config-noc";
			"qcom,sc8180x-dc-noc";
			"qcom,sc8180x-gem-noc";
			"qcom,sc8180x-ipa-virt";
			"qcom,sc8180x-mc-virt";
			"qcom,sc8180x-mmss-noc";
			"qcom,sc8180x-system-noc";
- #interconnect-cells : should contain 1

Examples:

aggre1_noc: interconnect@16e0000 {
	"qcom,sc8180x-aggre1_noc";
	interconnect-cells = <1>;
};
```

## Documentation/devicetree/bindings/interconnect/qcom,sdxbaagha.txt
```
Qualcomm Technologies, Inc. SDXBAAGHA Network-On-Chip interconnect driver binding
-----------------------------------------------------------

SDXBAAGHA interconnect providers support system bandwidth requirements through
RPMh hardware accelerators known as Bus Clock Manager (BCM). The provider is
able to communicate with the BCM through the Resource State Coordinator (RSC)
associated with each execution environment. Provider nodes must point to at
least one RPMh device child node pertaining to their RSC and each provider
can map to multiple RPMh resources.

Required properties :
- compatible : shall contain only one of the following:
			"qcom,sdxbaagha-aggre_noc",
			"qcom,sdxbaagha-cnoc_main",
			"qcom,sdxbaagha-dc_noc_dch",
			"qcom,sdxbaagha-mc_virt",
			"qcom,sdxbaagha-mem_noc",
			"qcom,sdxbaagha-snoc",
- #interconnect-cells : should contain 1

Examples:

snoc: interconnect@15C0000 {
	compatible = "qcom,sdxbaagha-snoc";
	#interconnect-cells = <1>;
};
```

## Documentation/devicetree/bindings/interconnect/qcom,sdxpinn.txt
```
Qualcomm Technologies, Inc. SDXPINN Network-On-Chip interconnect driver binding
-------------------------------------------------------------------------------

SDXPINN interconnect providers support system bandwidth requirements through
RPMh hardware accelerators known as Bus Clock Manager (BCM). The provider is
able to communicate with the BCM through the Resource State Coordinator (RSC)
associated with each execution environment. Provider nodes must point to at
least one RPMh device child node pertaining to their RSC and each provider
can map to multiple RPMh resources.

Required properties :
- compatible : shall contain only one of the following:
			"qcom,sdxpinn-clk_virt",
			"qcom,sdxpinn-dc_noc",
			"qcom,sdxpinn-gem_noc",
			"qcom,sdxpinn-mc_virt",
			"qcom,sdxpinn-pcie_anoc",
			"qcom,sdxpinn-system_noc",
- #interconnect-cells : should contain 1

Examples:

system_noc: interconnect@1640000 {
	compatible = "qcom,sdxpinn-system_noc";
	interconnect-cells = <1>;
};
```

## Documentation/devicetree/bindings/interrupt-controller/cirrus,madera.txt
```
Cirrus Logic Madera class audio codec IRQ driver

See also the core bindings for the parent MFD driver:
See Documentation/devicetree/bindinge/mfd/madera.txt

Required properties:

  - interrupts : The interrupt line the /IRQ signal for the device is
    connected to.

  - interrupt-controller : Madera class devices contain interrupt controllers
    and may provide interrupt services to other devices.

  - interrupt-parent : The parent interrupt controller.

  - #interrupt-cells: the number of cells to describe an IRQ, this should be 2.
    The first cell is the IRQ number.
    The second cell is the flags, encoded as the trigger masks from
    bindings/interrupt-controller/interrupts.txt

Optional properties:
  - cirrus,irq-gpios : The GPIO the host IRQ is connected to. Used when the
    host IRQ is edge-triggered to emulate a level-triggered IRQ. If specified
    must be exactly one GPIO entry

  - cirrus,irq_flags :  host controller flags as defined in
    bindings/interrupt-controller/interrupts.txt

Example:

codec: cs47l85@0 {
	compatible = "cirrus,cs47l85";

	interrupts = <&host_irq1>;
	interrupt-controller;
	#interrupt-cells = <2>;
        interrupt-parent = <&gic>;
};
```

## Documentation/devicetree/bindings/interrupt-controller/qcom,mpm.txt
```
QTI MPM interrupt controller
MPM (MSM sleep Power Manager) is QTI's platform parent
interrupt controller. It manages subsystem wakeups and
resources during sleep. This driver marks the wakeup
interrupts in APSS such that it monitors the interrupts
when the system is asleep, wakes up the APSS when one
of these interrupts occur and replays it to the subsystem
interrupt controller after it becomes operational.

Platform interrupt controller MPM is next in hierarchy,
followed by others.

This defines 2 interrupt controllers to monitor the
interrupts when system is asleep:

One to monitor the wakeup capable gic interrupts called
wakegic.

Properties:

- compatible:
	Usage: required
	Value type: <string>
	Definition: Should contain "qcom,mpm" and the respective
	target compatible flag from below ones.
		"qcom,mpm-bengal"
		"qcom,mpm-khaje"
		"qcom,mpm-monaco"
		"qcom,mpm-scuba"

- interrupts:
	Usage: required
	Value type: <prop-encoded-array>
	Definition: should specify the IRQ used by remote processor to
	wakeup APSS.

- interrupt-parent:
	Usage: required
	Value type: <phandle>
	Definition: Specifies the interrupt parent necessary for
	hierarchical domain to operate.

- interrupt-controller:
	Usage: required
	Value type: <bool>
	Definition: Identifies the node as an interrupt controller.

- reg:
	Usage: required
	Value type: <prop-encoded-array>
	Definition: Specifies the base physical address to trigger an
	interrupt into remote processor.

-reg-names:
	Usage: required
	Value type: <string>, <string>
	Definition: Specifies the address field names.

- qcom,num-mpm-irqs:
	Usage: optional
	Value type: <value>
	Defination: Specifies the number of interrupts supported.

Example:

mpm: interrupt-controller@45f01b8 {
	compatible = "qcom,mpm", "qcom,mpm-khaje";
	interrupts = <GIC_SPI 171 IRQ_TYPE_EDGE_RISING>;
	reg = <0x45f01b8 0x1000>,
	      <0xb011008 0x4>,  /* MSM_APCS_GCC_BASE 4K */
	      <0xf121000 0x1000>; /* Timer Frame Register */
	reg-names = "vmpm", "ipc", "timer";
	interrupt-controller;
	interrupt-parent = <&intc>;
	#interrupt-cells = <2>;
};
```

## Documentation/devicetree/bindings/leds/backlight/aw99703_dts.txt
```
aw99703 panel backlight control IC configuration

This document describes the DTS configuration items of aw99703 backlight control IC.

Required properties:
    compatible : Must be "awinic,aw99703-bl"
    reg:Specifies the i2c slave address,must be 0x36
    aw99703,hwen-gpio:Specifies the enabled gpio.

Optional properties:
    aw99703,pwm-mode:Write the Mode Register 0x02 bit[4] to disable or enable the PWM dimming function,0:disable 1:enable,default disable.

    aw99703,pwm-maptype:Write the Mode Register 0x02 bit[2] to select map type, 0:exponential(default) 1:linear.

    aw99703,bl-fscal-led:Write the LED Current Register 0x03 bits[7:3] to control the backlight full scale current.
                         Full scale current ranges from 4.8mA to 29.6mA with 0.8mA/step and 20mA as the default.
                         I = 4.8mA + code × 0.8mA

    aw99703,bl-channel: Write the LED Current Register 0x03 bits[2:0] to enable or disable led channel.
                        0:all channels are disabled, 1:enable channel 1, 2:enable channel 1 and channel 2, 3:all channels are enabled,
                        default all channels are enabled

    aw99703,sf-sft: Write the Boost Control1 Register 0x04 bits[7:6] to switch frequency shift.
                    0:No shift, 1:Shift Up by 20%, 2:Shift Down by 12%, 3:Shift Down by 24%, default: No shift.

    aw99703,switching-frequency: Write the Boost Control1 Register 0x04 bit[5] to switch Frequency.
                    0:500kHZ, 1:1000kHZ, default:1000kHZ

    aw99703,ovp-sel: Write the Boost Control1 Register 0x04 bits[4:2] to set up the boost output exceeding safe operating voltages
                    0:17v, 1:24v, 2:31v 3:38v, 4:41.5v, default:38v

    aw99703,ocp-sel: Write the Boost Control1 Register 0x04 bits[1:0] to set up the over current protection.
                    0:0.9A, 1:1.8A, 2:2.7A, 3:3.4A, default:2.7A

    aw99703,idctsel: Write the Boost Control2 Register 0x05 bit[6] to set up the value of inductors.
                    0:For less than 10μH inductors, 1:For 10μH inductors, default:0

    aw99703,pwm-frequency: Write the PWM Control Register 0x08 bits[7:6] to set up selectable frequency of PWM input.
                    0:800kHZ, 1:4MHZ, 2:24MHZ, default:24MHZ

    aw99703,pwm-hysteresis: Write the PWM Control Register 0x08 bits[4:2] to set up pwm duty cycle hysteresis.
                    0:0/2047, 1:1/2047, 2:2/2047, 3:3/2047, 4:4/2047, 5:5/2047, 6:6/2047, 7:7/2047, default 4

    aw99703,pwm-filter:Write the PWM Control Register 0x08 bits[1:0] to set up pwm filter time.
                    0:No filter, 1:100ns, 2:150ns, 3:200ns, default 3

    aw99703,turn-on-ramp:Write the Turn ON/OFF Ramp Time Register 0x09 bits[7:4] to set up LED current ramp up time.
                    0:512us, 1:1ms, 2:2ms, 3:4ms, 4:8ms, 5:16ms. 6:32ms,..., D:4096, E:8192, F:16384ms,default:8ms

    aw99703,turn-off-ramp:Write the Turn ON/OFF Ramp Time Register bits[3:0] to set up LED current ramp down time.
                    0:512us, 1:1ms, 2:2ms, 3:4ms, 4:8ms, 5:16ms. 6:32ms,..., D:4096, E:8192, F:16384ms,default:8ms

    aw99703,pwm-trans-dim:Write the Transition Ramp Time Register 0x0A bits[7:4] to set up PWM transition ramp time
                    0:2ms, 1:4ms, 2:8ms ,..., 5:64ms, 6:128ms, 7:256ms,  default:2ms

    aw99703,i2c-trans-dim:Write the Transition Ramp Time Register 0x0A bits[3:0] to set up I2C transition ramp time
                    0:2ms, 1:4ms, 2:8ms ,..., 5:64ms, 6:128ms, 7:256ms, default:2ms

    aw99703,flash-flto-dim:Write the Flash Setting Register 0x0B bits[7:4] to set up flash timeout time
                    0:200ms, 1:300ms, 2:400ms ,..., D:1300ms, E:1400ms, F:1500ms, default:500ms

    aw99703,flash-fl-s:Write the Flash Setting Register 0x0B bits[3:0] to set up flash current, I = (1 + (code + 2)/10)*29.6mA
                    0:35.52mA, 1:38.48mA, ... , E:76.96mA, 79.92mA, default:59,2mA

    aw99703,bl-map:Set up the brightness map level. 1:256, 2:1024, 3:2048, default:256
```

## Documentation/devicetree/bindings/leds/leds-atc.txt
```
Driver leds-atc is used to control ATC charging led on a Qualcomm PMIC.

Required properties
- compatible		: string should be "qcom,leds-atc"
- linux,name		: name of the led that is used in led framework
- qcom,ctrl-reg		: ATC LED register address. Check PMIC specification

Example:

qcom,leds@104d {
	compatible = "qcom,leds-atc";
	linux,name = "charging";
	qcom,ctrl-reg = <0x104D>;
};
```
