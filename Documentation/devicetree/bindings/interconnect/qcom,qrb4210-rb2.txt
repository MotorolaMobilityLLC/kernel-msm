## Documentation/devicetree/bindings/mfd/madera.txt
```
Cirrus Logic Madera class audio codecs multi-function device

These devices are audio SoCs with extensive digital capabilities and a range
of analogue I/O.

See also the child driver bindings in:
bindings/extcon/extcon-madera.txt
bindings/gpio/gpio-madera.txt
bindings/interrupt-controller/cirrus,madera.txt
bindings/regulator/madera-ldo1.txt
bindings/regulator/madera-micsupp.txt
bindings/sound/madera.txt
bindings/switch/madera.txt

Required properties:

  - compatible : One of the following chip-specific strings:
        "cirrus,cs47l35"
        "cirrus,cs47l85"
        "cirrus,cs47l90"
        "cirrus,cs47l91"
        "cirrus,wm1840"

  - reg : I2C slave address when connected using I2C, chip select number when
    using SPI.

  - DCVDD-supply : Power supply for the device as defined in
    bindings/regulator/regulator.txt
    Mandatory on CS47L35, CS47L90, CS47L91
    Optional on CS47L85, WM1840

  - AVDD-supply, DBVDD1-supply, DBVDD2-supply, CPVDD1-supply, CPVDD2-supply :
    Power supplies for the device

  - DBVDD3-supply, DBVDD4-supply : Power supplies for the device
    (CS47L85, CS47L90, CS47L91, WM1840)

  - SPKVDDL-supply, SPKVDDR-supply : Power supplies for the device
    (CS47L85, WM1840)

  - SPKVDD-supply : Power supplies for the device
    (CS47L35)

Optional properties:

  , MICVDD-supply : Power supply, only need to be specified if
    powered externally

  - reset-gpios : One entry specifying the GPIO controlling /RESET.
    As defined in bindings/gpio.txt.

  - cirrus,clk32k-src : set input source for codec 32kHz clock.
      0 = default, 1 = MCLK1, 2 = MCLK2, 3 = None

  - cirrus,gpio-defaults : A list of values for the GPn_CONFIGx registers.
    There are two entries for each GPIO, corresponding to the GPn_CONFIG1 and
    GPn_CONFIG2 registers for that GPIO. Defines for the appropriate values can
    be found in <dt-bindings/mfd/madera.h>. If absent, no configuration of these
    registers is performed. If any entry has a value >0xFFFF the chip default
    will be used.

  - cirrus,micbias1 : Configuration for the micbias regulator, there are 8 cells
    <vout cap disA disB disC disD soft bypass>
    where
      vout is the output voltage in millivolts
      cap is non-zero value if an external capacitor is fitted
      disA,B,C,D non-zero if that output should be actively discharged
      soft non-zero to enable soft-start
      bypass non-zero to enable bypass
  - cirrus,micbias2 : See cirrus,micbias1
  - cirrus,micbias3 : See cirrus,micbias1
  - cirrus,micbias4 : See cirrus,micbias1

Example:

codec: cs47l85@0 {
	compatible = "cirrus,cs47l85";
	reg = <0>;

	reset-gpios = <&gpio 0>;

	cirrus,gpio-defaults = <
		Madera_GP_FN_TXLRCLK
		Madera_GP_DEFAULT
		Madera_GP_DEFAULT
		Madera_GP_DEFAULT
		Madera_GP_DEFAULT
	>;

	cirrus,micbias2 = <2600 0 1 0 0 0 1 0>;
};
```

## Documentation/devicetree/bindings/mfd/ti-lmu.txt
```
TI LMU(Lighting Management Unit) device tree bindings

TI LMU driver supports lighting devices belows.

   Name        Device tree properties
  ------      ------------------------
  LM3532       Backlight
  LM3631       Backlight and regulator
  LM3633       Backlight and LED
  LM3695       Backlight
  LM3697       Backlight

Those have shared device tree properties.

Required properties:
  - compatible: "ti,lm3532", "ti,lm3631", "ti,lm3633", "ti,lm3695", "ti,lm3697"
  - reg: I2C slave address.
    0x38 is LM3532
    0x29 is LM3631
    0x36 is LM3633, LM3697
    0x63 is LM3695
  - ti,enable-gpio: GPIO number of hardware enable pin

For the TI LMU backlight properties, please refer to:
Documentation/devicetree/bindings/video/backlight/ti-lmu-backlight.txt

For the LM3631 regulator properties, please refer to:
Documentation/devicetree/bindings/regulator/lm3631-regulator.txt

For the LM3633 LED properties, please refer to:
Documentation/devicetree/bindings/leds/leds-lm3633.txt

Examples:

lm3532@38 {
	compatible = "ti,lm3532";
	reg = <0x38>;

	/* GPIO134 for HWEN pin */
	ti,enable-gpio = <&gpio5 6 GPIO_ACTIVE_HIGH>;

	backlight {
		compatible = "ti,lmu-backlight", "ti,lm3532-backlight";

		lcd {
			hvled1-used;
			hvled2-used;
			hvled3-used;

			max-current-milliamp = /bits/ 8 <20>;
			ramp-up = <1>;
			ramp-down = <1>;
		};
	};
};

lm3631@29 {
	compatible = "ti,lm3631";
	reg = <0x29>;

	ti,enable-gpio = <&gpio5 6 GPIO_ACTIVE_HIGH>;

	/* Only Vpos and Vneg are used with LCD boost */
	regulators {
		compatible = "ti,lm3631-regulator";

		vboost {
			regulator-name = "lcd_boost";
			regulator-min-microvolt = <4500000>;
			regulator-max-microvolt = <6350000>;
			regulator-always-on;
		};

		vpos {
			regulator-name = "lcd_vpos";
			regulator-min-microvolt = <4000000>;
			regulator-max-microvolt = <6000000>;
			regulator-boot-on;
		};

		vneg {
			regulator-name = "lcd_vneg";
			regulator-min-microvolt = <4000000>;
			regulator-max-microvolt = <6000000>;
			regulator-boot-on;
		};
	};

	backlight {
		compatible = "ti,lmu-backlight", "ti,lm3631-backlight";

		lcd_bl {
			bl-name = "lcd";
			hvled1-used;
			hvled2-used;
			ramp-up = <100>;
		};
	};
};

lm3633@36 {
	compatible = "ti,lm3633";
	reg = <0x36>;

	ti,enable-gpio = <&gpio5 6 GPIO_ACTIVE_HIGH>;

	backlight {
		compatible = "ti,lmu-backlight", "ti,lm3633-backlight";

		main {
			bl-name = "main_lcd";
			hvled2-used;
			hvled3-used;
			max-current-milliamp = /bits/ 8 <20>;
		};

		front {
			bl-name = "front_lcd";
			hvled1-used;
			max-current-milliamp = /bits/ 8 <10>;
		};
	};

	leds {
		compatible = "ti,lm3633-leds";

		chan2 {
			chan-name = "status";
			lvled2-used;
			max-current-milliamp = /bits/ 8 <6>;
		};

		chan456 {
			chan-name = "rgb";
			lvled4-used;
			lvled5-used;
			lvled6-used;

			max-current-milliamp = /bits/ 8 <5>;
		};
	};
};

lm3695@63 {
	compatible = "ti,lm3695";
	reg = <0x63>;

	ti,enable-gpio = <&gpio5 6 GPIO_ACTIVE_HIGH>;

	backlight {
		compatible = "ti,lmu-backlight", "ti,lm3695-backlight";

		lcd {
			hvled1-used;
			hvled2-used;
		};
	};
};

lm3697@36 {
	compatible = "ti,lm3697";
	reg = <0x36>;

	ti,enable-gpio = <&gpio5 6 GPIO_ACTIVE_HIGH>;

	backlight {
		compatible = "ti,lmu-backlight", "ti,lm3697-backlight";

		lcd_bl {
			bl-name = "lcd";
			hvled1-used;
			hvled2-used;
			hvled3-used;

			max-current-milliamp = /bits/ 8 <20>;
			initial-brightness = /bits/ 8 <10>;

			ramp-up = <500>;
			ramp-down = <500>;
		};
	};
};
```

## Documentation/devicetree/bindings/misc/ams-ct406.txt
```
CT406 Digital Ambient Light Sensor, Proximity Sensor

CT406 is a Digital Ambient Light Sensor,
Proximity Sensor and IR LED in an Optical Module.
It is connected to the host processor on the I2C interface.

Required properties:
- compatible:			Must be "ams,ct406"
- reg:				Specifies the I2C address of the part.
- interrupt-parent:		The parent interrupt controller
- interrupts:			The interrupt line connected to main SoC
- gpios:			Required GPIOs for operation
				- IRQ GPIO

- ams,ip-prox-limit:			in pocket detection prox limit.
- ams,ip-als-limit:			in pocket detection als limit
- ams,prox-samples-for-noise-floor:
- ams,prox-saturation-threshold:
- ams,prox-covered-offset:
- ams,prox-uncovered-offset:
- ams,prox-recalibrate-offset:
- ams,prox-offset:
- ams,prox-pulse-count:

Optional Properties:
- vdd-supply:		regulator suppy to VDD.

Example:

	ct406@39 {
		compatible = "ams,ct406";
		reg = <0x39>;
		interrupt-parent = <&msmgpio>;
		interrupts = <65 0x2>;
		gpios = <&msmgpio 65 0>; /* IRQ */
		vdd-supply = <&pm8226_l19>;
		ams,prox-samples-for-noise-floor = <0x05>;
		ams,ip-prox-limit = <0x200>;
		ams,ip-als-limit = <10>;
		ams,prox-saturation-threshold = <0x0208>;
		ams,prox-covered-offset = <0x0096>;
		ams,prox-uncovered-offset = <0x006e>;
		ams,prox-recalibrate-offset = <0x0046>;
		ams,prox-offset = <0x00>;
		ams,prox-pulse-count = <0x04>;
	};
```

## Documentation/devicetree/bindings/misc/capsense_hssp.txt
```
			Cypress CapSense devices programming support
			--------------------------------------------

Overview
--------

This driver implements the programming for Linux of Cypress CapSense devices by
simulating host sourced programming protocol (HSSP) on GPIO pins.
By using this driver you can reprogram the in-system flash without additional
adapters. This solution is working with blank or non-blank flash memory.
Current release was tested with CY8C4014LQI CapSense device.

References
----------

The main references are at (http://www.cypress.com) see:

1. Protocol description:
Programming Specifications, Document #: 001-81799
http://www.cypress.com/?rID=40048

2. Programming Using an External Microcontroller (HSSP)
http://www.cypress.com/?docID=41696

Required properties:
 - compatible:    Should be "cypress,cycapsense_hssp"
 - label:         IC type name, it is used to identify firmware file name
 - silicon_id:    IC type identifier, used to identify connected IC.
 - block_size:    In-system flash memory block size
 - num_of_blocks: Number of flash memory blocks.
 - secure_bytes:  Number secure bytes;
 - gpios :        Three interface gpio pins. Index 0 is reset line,
				index 1 - clock line, index 2 - data line.
Optional properties:
 - use-raw-gpio-rw: Do direct register read/write to get/set GPIO,
 - gpio_base_addr:  Address of GPIO IO block;
 - gpio_base_size:  Size of GPIO IO block;

Using the driver
----------------

Once the driver is loaded you can use sysfs support to erase or to program
in-system flash memory.

1. Program firmware will be automatically loaded from file with
name defined by label option presented in directory
/system/etc/firmware.
Firmware will be flashed if checksum in hex file does not match
with checksum of in-system flash memory:
To flash FW:

#echo 1 > /sys/class/capsense/fw_update

2. Program firmware without checking name and checksum. If file <file_name>.hex
is present in /system/etc/firmware directory you may program it with following
command:

#echo <file_name>.hex > /sys/class/capsense/fw_update

3. To erase in-system flash memory:

#echo erase > /sys/class/capsense/fw_update

4. To use driver from another module there is exported API cycapsense_fw_update,
which implements same logic as case #1 above.

5. To reset IC:

#echo reset > /sys/class/capsense/fw_update
or
#echo 1 > /sys/class/capsense/reset
```

## Documentation/devicetree/bindings/misc/hob_ram.txt
```
HOB RAM MMAP Device

HOB RAM MMAP Device provides ability for userspace to access the hand over block
memory to read out modem related parameters.

Required properties:
- compatible : should be "mmi,hob_ram"
- reg :
	(0) offset and length of the DHOB partition
	(1) offset and length of the SHOB partition

Example:
	hob_ram@c2c0000 {
		compatible = "mmi,hob_ram";
		reg = <0xc2c0000 0x40000>,
		      <0xc300000 0x1000>;
	};
```
