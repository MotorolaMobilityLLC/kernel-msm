## Documentation/devicetree/bindings/input/touchscreen/parade_pt.txt
```
* Parade pt touch controller

Please add this description here: The Parade Touch controller is connected to the
host processor via I2C. The controller generates interrupts when the user touches
the panel. The host controller is expected to read the touch coordinates over I2C and
pass the coordinates to the rest of the system.

Required properties:
 - compatible           : should be "parade,pt_i2c_adapter"
 - reg                  : i2c slave address of the device.
 - vdd-supply           : digital voltage power supply needed to power device.
 - avdd-supply          : analog voltage power supply needed to power device.
 - novatek,reset-gpio   : reset gpio.
 - novatek,irq-gpio     : irq gpio.

Example:
        &i2c_1 {
                status = "ok";

                /* Parade device tree node */
                tsc@24 {
                        compatible = "parade,pt_i2c_adapter";
                        reg = <0x24>;
                        status = "ok";

                        vdd-supply = <&L29A>;
                        vcc_i2c-supply = <&L21A>;

                        parade,core {
                                parade,rst_gpio = <&tlmm 71 0x00>;
                                parade,irq_gpio = <&tlmm 80 0x2008>;
                        };
                };
        };
```

## Documentation/devicetree/bindings/input/touchscreen/synaptics.txt
```
Synaptics Touch Controllers

Required properties:

 - compatible:
        should be "synaptics,sy3200", or "synaptics,sy3400",
        or "synaptics,synaptics_dsx_i2c"
 - reg:
        i2c slave address of the device
 - interrupt-parent:
        parent controller of interrupt
 - interrupts:
        touch sample interrupt to indicate presense or release of fingers on the
        panel.
 - gpios:
        <0> interrupt - the interrupt gpio, should match the interrupts param
        <1> reset     - the reset line
        <2> enable    - optional, enable gpio

        The interrupt and reset lines are required, the enable GPIO is optional
        if its not connected.
 - synaptics,sy3200-tdat-filename:
        firmware filename to flash to the 3200 controller
 - synaptics,sy3400-tdat-filename:
        firmware filename to flash to the 3400 controller
 - synaptics,panel-sync-enabled:
        flag to enable state changes notifications from panel driver

        Those notifications include power on/off and display on and can be used
        to control suspend/resume for in-cell touch solutions and/or to purge
        touch events received before display is on.
 - synaptics,key-buttons:
        key codes for the supported buttons
 - synaptics,reset-on-resume:
        flag to enable ic reset when driver resumes
 - synaptics,display-synced-suspend:
        flag to use display notifications to control entering into suspend
 - synaptics,one-touch-enabled:
        flag to enable configuring one touch on entering to suspend
 - synaptics,normal-mode:
	<0>         - enforce no sleep mode
	<1>         - use normal mode and clear no sleep bit if it's set
	not defined - use mode settings programmed in firmware
 - synaptics,hw-reset:
        flag to perform hard reset in oppose to soft reset
 - synaptics,gpio-config:
        flag to explicitly configure touch irq and reset gpios

Example:
	i2c@16200000 {
		status = "okay";

		qcom,i2c-bus-freq = <400000>;
		qcom,i2c-src-freq = <24000000>;

		sy3200@20 {
			compatible = "synaptics,sy3200";
			reg = <0x20>;
			interrupt-parent = <&msmgpio>;
			interrupts = <46 0>;
			gpios = <&msmgpio 46 0>, /* IRQ */
				<&msmgpio 63 0>; /* RESET */

			synaptics,sy3200-tdat-filename = "sy3200-r0.tdat";
		};
	};

	or

	&i2c@3 {
		synaptics_dsx_i2c@20 {
			compatible = "synaptics,synaptics_dsx_i2c";
			reg = <0x20>;
			interrupt-parent = <&msmgpio>;
			interrupts = <46 0>;
			gpios = <&msmgpio 46 0>, /* IRQ */
				<&msmgpio 63 0>; /* RESET */

			synaptics,panel-sync-enabled = <1>;
			synaptics,normal-mode = <1>;
			synaptics,purge-enabled;
			synaptics,reset-on-resume;
			synaptics,hw-reset;
			synaptics,gpio-config;
			synaptics,one-touch-enabled;
			synaptics,display-synced-suspend;
			synaptics,key-buttons = <139 102 158 0>; /* KEY_MENU, KEY_HOME, KEY_BACK */
		};
	};
```

## Documentation/devicetree/bindings/input/touchscreen/synaptics_dsx_i2c_mmi.txt
```
Synaptics DSX touch controller MMI implementation

Required properties:

 - compatible		: should be "synaptics,synaptics_dsx_i2c"
 - reg			: i2c slave address of the device
 - interrupt-parent	: parent of interrupt
 - interrupts		: touch sample interrupt to indicate presense or release
				of fingers on the panel.
 - gpios		: irq and reset gpios
 - pinctrl-names	: This should be defined if a target uses pinctrl framework.
			  See "pinctrl" in Documentation/devicetree/bindings/pinctrl/msm-pinctrl.txt.
			  It should specify the names of the configs that pinctrl can install in
			  driver. Following are the pinctrl configs that can be installed:
			  "active" : Active configuration of pins, this should specify active
			  config defined in pin groups of interrupt and reset gpio.
			  "default" : Disabled configuration of pins, this should specify sleep
			  config defined in pin groups of interrupt and reset gpio.
Optional property:
 - touch_vdd-supply		: digital voltage power supply needed to power device
 - synaptics,key-buttons	: virtual key code mappings to be used
 - synaptics,aod-multi-touch	: number of fingers to support in AoD (control access block feature)
 - synaptics,x-flip		: modify orientation of the x axis
 - synaptics,y-flip		: modify orientation of the y axis
 - synaptics,gpio-config	: execute gpio configuration function in probe
 - synaptics,purge-enabled	: purge touch events received prior frame buffer resume notification
 - config_modifier-names	: list of modifiers names used in current setup
				  Typically, modifier is a set of configuration (register) and/or
				  functional (clipping) restrictions.
				  Following names are defined: "aod", "folio", "charger", "fps",
				  "wakeup" and "stats". Where:
				   * aod     - Always On Display (not AP controlled)
				   * folio   - cover with access window
				   * charger - charger insertion/removal
				   * fps     - finger print sensor
				   * wakeup  - wakeup gesture
				   * stats   - touch noise mitigation statistics (if supported by FW)

Optional properties inside config_modifier-modname child node:
 - enable-notification		: modifier has a switch notifier
 - modname-active		: modier has active restrictions
 - modname-suspended		: modifier has suspended restrictions
 - patch-data			: modifier specific touch IC registers values
 - touch-clip-area		: modifier specific touch events clipping

Example:
	i2c@f9927000 {
		synaptics@20 {
			compatible = "synaptics,synaptics_dsx_i2c"
			reg = <0x20>;
			interrupt-parent = <&tlmm>;
			interrupts = <40 0>;
			gpios = <&tlmm 40 0>,
				<&tlmm 39 0>;
			touch_vdd-supply = <&pm8994_l22>;
			synaptics,gpio-config;
			synaptics,x-flip;
			synaptics,y-flip;
			pinctrl-names = "default","active";
			pinctrl-0 = <&touch_int_default &touch_reset_active>;
			pinctrl-1 = <&touch_int_active &touch_reset_active>;
			config_modifier-names = "folio", "charger";
			config_modifier-folio {
				enable-notification;
				folio-active {
					/* Saturation cap; Force update; */
					patch-data = "F54@2=B400;F12@10=1E1F;U";
					touch-clip-area = <64 0 1015 1014 0>;
				};
				folio-suspended {
					/* Saturation cap; Force update; Power->sleep; */
					patch-data = "F54@2=9000;U;S";
				};
			};
			config_modifier-charger {
				enable-notification;
				charger-active {
					/* Charger bit; */
					patch-data = "F1@0=1&20";
				};
			};
		};
	};
```

## Documentation/devicetree/bindings/interconnect/qcom,cinder.txt
```
Qualcomm Technologies, Inc. Cinder Network-On-Chip interconnect driver binding
-----------------------------------------------------------

Cinder interconnect providers support system bandwidth requirements through
RPMh hardware accelerators known as Bus Clock Manager (BCM). The provider is
able to communicate with the BCM through the Resource State Coordinator (RSC)
associated with each execution environment. Provider nodes must point to at
least one RPMh device child node pertaining to their RSC and each provider
can map to multiple RPMh resources.

Required properties :
- compatible : shall contain only one of the following:
			"qcom,cinder-clk_virt",
			"qcom,cinder-gem_noc",
			"qcom,cinder-mc_virt",
			"qcom,cinder-system_noc",
- #interconnect-cells : should contain 1

Examples:

system_noc: interconnect@1640000 {
	compatible = "qcom,cinder-system_noc";
	interconnect-cells = <1>;
};
```

## Documentation/devicetree/bindings/interconnect/qcom,kalama.txt
```
Qualcomm Technologies, Inc. kalama Network-On-Chip interconnect driver binding
-----------------------------------------------------------

kalama interconnect providers support system bandwidth requirements through
RPMh hardware accelerators known as Bus Clock Manager (BCM). The provider is
able to communicate with the BCM through the Resource State Coordinator (RSC)
associated with each execution environment. Provider nodes must point to at
least one RPMh device child node pertaining to their RSC and each provider
can map to multiple RPMh resources.

Required properties :
- compatible : shall contain only one of the following:
			"qcom,kalama-aggre1_noc",
			"qcom,kalama-aggre2_noc",
			"qcom,kalama-clk_virt",
			"qcom,kalama-cnoc_cfg",
			"qcom,kalama-cnoc_main",
			"qcom,kalama-gem_noc",
			"qcom,kalama-lpass_ag_noc",
			"qcom,kalama-lpass_lpiaon_noc",
			"qcom,kalama-lpass_lpicx_noc",
			"qcom,kalama-mc_virt",
			"qcom,kalama-mmss_noc",
			"qcom,kalama-nsp_noc",
			"qcom,kalama-system_noc",
			"qcom,kalama-pcie_anoc",
- #interconnect-cells : should contain 1

Examples:

system_noc: interconnect@1680000 {
	compatible = "qcom,kalama-system_noc";
	interconnect-cells = <1>;
};
```

## Documentation/devicetree/bindings/interconnect/qcom,lemans.txt
```
Qualcomm Technologies, Inc. Lemans Network-On-Chip interconnect driver binding
------------------------------------------------------------------------------
Lemans interconnect providers support system bandwidth requirements through
RPMh hardware accelerators known as Bus Clock Manager (BCM). The provider is
able to communicate with the BCM through the Resource State Coordinator (RSC)
associated with each execution environment. Provider nodes must point to at
least one RPMh device child node pertaining to their RSC and each provider
can map to multiple RPMh resources.

Required properties :
- compatible : shall contain only one of the following:
		"qcom,lemans-aggre1_noc";
		"qcom,lemans-aggre2_noc";
		"qcom,lemans-clk_virt";
		"qcom,lemans-config_noc";
		"qcom,lemans-dc_noc";
		"qcom,lemans-gem_noc";
		"qcom,lemans-lpass_ag_noc";
		"qcom,lemans-mc_virt";
		"qcom,lemans-mmss_noc";
		"qcom,lemans-nspa_noc";
		"qcom,lemans-nspb_noc";
		"qcom,lemans-system_noc";
		"qcom,lemans-pcie_anoc";
		"qcom,lemans-gpdsp_anoc";
- #interconnect-cells : should contain 1

Examples:

aggre1_noc: interconnect@16c0000 {
	"qcom,lemans-aggre1_noc";
	interconnect-cells = <1>;
};
```
