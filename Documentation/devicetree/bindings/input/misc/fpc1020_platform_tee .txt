## Documentation/devicetree/bindings/input/misc/fpc1020_platform_tee .txt
```
fpc fpc1020 fingerprint platform driver

Required properties:

 - compatible		: Should be "fpc,fpc1020" .

Optional properites:

		fpc_fpc1020@0{
			compatible = "fpc,fpc1020";
			status = "ok";
			irq = <&tlmm 86 0>;
			rst = <&tlmm 8 0>;
		};
```

## Documentation/devicetree/bindings/input/misc/fpc1020_tee.txt
```
fpc fpc1020 fingerprint  driver

Required properties:

 - compatible		: Should be "fpc,fpc1020" .

Optional properites:

		fpc_fpc1020@0{
			compatible = "fpc,fpc1020";
			status = "ok";
			fpc,gpio_irq = <&tlmm 128 0>;
		};
```

## Documentation/devicetree/bindings/input/misc/ltr559.txt
```
LTR-559 optical sensor

LTR559 is an ambient light and proximity sensor. It connects to host SoC via
I2C bus.

Abbreviation:
ALS: ambient light sensor
PS: proximity sensor
ALPS: ambient light and proximity sensor

Required properties:
 - compatible		: Should be "liteon,ltr559".
 - reg			: i2c slave address of this device.
 - vdd-supply		: Analog power supply needed to power up this device.
 - vio-supply		: Digital IO power supply needed for IO and i2c.
 - interrupt-parent	: The interrupt controller this device is connected to.
 - interrupts		: L/P sample interrupt to indicate new data ready.
 - pinctrl-names	: pinctrl configuration names of this device. Should be
	"default" and "sleep".
 - pinctrl-0		: Should specify pin control groups used for this sensor.
 - pinctrl-1		: Should specify pin control groups used for this sensor.
 - liteon,irq-gpio	: GPIO pin for interrupt of this device.
 - liteon,ps-threshold	: Proximity sensor threshold.
 - liteon,ps-hysteresis-threshold	: Proximity sensor hysteresis threshold.
 - liteon,als-polling-time	: Ambient Light sensor polling time.
 - liteon,prox-sensor-name	: Proximity sensor name.
 - liteon,ps-nearoffset	: Proximity nearoffset when noise < 200
 - liteon,ps-faroffset	: Proximity faroffset when noise < 200

 Example:

 i2c@78b5000 { /* BLSP1 QUP1 */
	 liteon@23 {
		 compatible = "liteon,ltr559";
		 reg = <0x23>;
		 pinctrl-names = "default","sleep";
		 pinctrl-0 = <&ltr559_default>;
		 pinctrl-1 = <&ltr559_sleep>;
		 interrupt-parent = <&tlmm>;
		 interrupts = <46 0x2>;
		 vdd-supply = <&pm8937_l10>;
		 vio-supply = <&pm8937_l6>;
		 ltr,irq-gpio = <&tlmm 46 0x2>;
		 ltr,ps-threshold = <800>;
		 ltr,ps-hysteresis-threshold = <300>;
		 ltr,als-polling-time = <200>;
		 ltr,prox-sensor-name = "Rear liteon-proximity";
		 ltr,ps-nearoffset = <35>
		 ltr,ps-faroffset = <20>
	 };

 }
```

## Documentation/devicetree/bindings/input/misc/mxg3300.txt
```
AKM mxg3300 3-axis electronic compass driver

Required properties:

 - compatible		: Should be "mx,g3300"
 - reg			: i2c address of the device.
 - mx,vdd_io-supply	: Digital IO power supply needed for IO and I2C.
 - mx,position_array	: The layout of the magnitic sensor
	<x y z signX signY singZ>

 Example:
	g3300@06 {
		compatible = "mx,g3300";
		reg = <0x06>;
		mx,vdd_io-supply = <&pm8917_l6>;
		mx,position = <0x1>;
		mx,position_array = <0 1 2 1 1 0>;
	};
```

## Documentation/devicetree/bindings/input/misc/stmvl53l0.txt
```
st stmvl53l0 laser  driver

Required properties:

 - compatible		: Should be "st,stmvl53l0" .

Optional properites:


 Example:
	st,stmvl53l0 {
		cell-index = <1>;
		compatible = "st,stmvl53l0";
		qcom,cci-master = <0>;
		cam_vio-supply = <&pm8994_lvs1>;
		qcom,cam-vreg-name = "cam_vio";
		qcom,cam-vreg-min-voltage = <0>;
		qcom,cam-vreg-max-voltage = <0>;
		qcom,cam-vreg-op-mode = <0>;
		gpios =<&pm8994_gpios 10 0>,
			  <&tlmm 119 0>;
		qcom,gpio-reset = <0>;
		qcom,gpio-req-tbl-num = <0 1>;
		qcom,gpio-req-tbl-flags = <0 1>;
		qcom,gpio-req-tbl-label = "TOF_XSHUTDOWN","TOF_INT";
		pinctrl-names = "laser_default", "laser_suspend";
		pinctrl-0 = <&laser_active>;
		pinctrl-1 = <&laser_suspend>;
	};
```

## Documentation/devicetree/bindings/input/misc/stmvl53l0_i2c.txt
```
st,stmvl53l0_i2c laser  driver

Required properties:

 - compatible		: Should be "st,stmvl53l0_i2c".

Optional properites:


 Example:
	stmvl53l0@29 {
		compatible = "st,stmvl53l0_i2c";
		reg = <0x29>;
		gpios =<&pm8994_gpios 10 0>,
				<&tlmm 119 0>;
		qcom,gpio-reset = <0>;
		qcom,gpio-req-tbl-num = <0 1>;
		qcom,gpio-req-tbl-flags = <0 1>;
		qcom,gpio-req-tbl-label = "TOF_XSHUTDOWN","TOF_INT";
		pinctrl-names = "laser_default", "laser_suspend";
		pinctrl-0 = <&laser_active>;
		pinctrl-1 = <&laser_suspend>;
		st,sensorthreshold = <40 45>;
	};
```

## Documentation/devicetree/bindings/input/misc/stmvl53l1.txt
```
StMicroelectronis vl53l1

Requires properties:
- compatible: must be "st,stmvl53l1".
- reg: I2C address of the chip.
- xsdn-gpio: gpio number connected to vl53l1 reset pin.

Optional properties:
- intr-gpio: gpio number connected to vl53l1 irq pin.
- vdd: a phandle for the regulator supplying power for vl53l1.
- pwren-gpio: gpio number use to control vl53l1 power.

Example:
	&i2c1 {
		/* ... */

		stmvl53l1: stmvl53l1@29 {
			compatible = "st,stmvl53l1";
			reg = <0x29>;
			xsdn-gpio = <19>;
			pwren-gpio = <12>;
			intr-gpio = <16>;
		};

		/* ... */
	};
```

## Documentation/devicetree/bindings/input/misc/sx9310.txt
```
sx9310 cap touch sensor from semtech

It is a i2c slave device
two specific properties for driver init registers's value

Required properties:
 - cap,use_channel	:cap channel has selected,CS0=0x01,CS1=0x02,CS2=0x04,COMB=0x08
 - cap,scan_period	:scan period
 - reg_array_len	:num of registers need to be set
 - reg_array_val	:registers's val, format is <reg addr, reg val ...>

Example:

	sx9310@28 {
		compatible = "semtech,sx9310";
		reg = <0x28>;
		cap_svdd-supply = <&pm8953_l6>;
		cap_vdd-supply = <&pm8953_l22>;
		interrupt-parent = <&tlmm>;
		interrupts = <46 0x2008>;
		gpios = <&tlmm 46 0x2008>; /* IRQ */
		pinctrl-names = "default";
		pinctrl-0 = <&sx9310_irq_default>;
		cap,use_channel = <0x04>;
		cap,scan_period = <0x01>;
		reg_array_len = <5>;
		reg_array_val = <0x12 0x0B 0x13 0x05 0x15 0xC2
				0x18 0x5E 0x10 0x51>;
	};
```

## Documentation/devicetree/bindings/input/misc/sx933x.txt
```
sx933x cap touch sensor from semtech

It is a i2c slave device
two specific properties for driver init registers's value

a).CONFIG_INPUT_SX933x corresponding driver sx933x.c,
sx933x.c is a single channel driver.

Required properties:
 - Semtech,button-flag	:flag of used buttons,0~4 bits refers to button 0~4
 - Semtech,reg-num	:num of registers need to be set
 - Semtech,reg-init	:registers's val, format is <reg addr, reg val ...>

Example:

	sx933x@28 {
		compatible = "Semtech,sx933x";
		reg = <0x28>;
		interrupt-parent = <&tlmm>;
		interrupts = <75 0>;
		Semtech,nirq-gpio = <&tlmm 75 0x00>;
		cap_vdd-supply = <&pm660l_l8>;
		Semtech,reg-num = <12>;
		Semtech,button-flag = <0x07>; //used button 0~2
		Semtech,reg-init = <0x8020 0x3F00C0
			0x8024 0x44F
			0x8028 0x24928000
			0x802C 0x44F
			0x8030 0x24960000
			0x8034 0x44F
			0x8038 0x24B20000
			0x803C 0x44F
			0x8040 0x25920000
			0x8044 0x44F
			0x8048 0x2C920000
			0x4004 0x67 >;
	};
```

## Documentation/devicetree/bindings/input/stm-lis3dh_mot.txt
```
LIS3DH Accelerometer

LIS3DH is a MEMS digital output motion sensor ultra low-power
high performance 3-axes 'nano' accelerometer.
It is connected to the host processor on the I2C interface.

Required properties:
- compatible:		Must be "stm,lis3dh"
- reg:			Specifies the I2C address of the part.
- poll-interval:	polling interval in ms.
- min-interval:		minimum allowed polling interval.
- g-range:		G-Range scale.

Optional Properties:
- vdd-supply:	regulator suppy to VDD.

Example:

	lis3dh@19 {
		compatible = "stm,lis3dh";
		reg = <0x19>;
		vdd-supply = <&pm8226_l19>;
		stm,poll-interval = <200>;
		stm,min-interval = <1>;
		stm,g-range = <8>;
	};
```

## Documentation/devicetree/bindings/input/touchscreen/atmxt.txt
```
Atmel touch controller

Required properties:

 - compatible	: should be "atmel,atmxt-ts"
 - reg			: i2c slave address of the device
 - interrupt-parent	: parent of interrupt
 - interrupts		: touch sample interrupt to indicate presense or release
				of fingers on the panel.
 - gpios	: interrupt, reset, and enable GPIOS

 - atmel,atmxt-tdat-filename: firmware filename to flash

Example:
	i2c@16200000 {
		status = "okay";

		qcom,i2c-bus-freq = <400000>;
		qcom,i2c-src-freq = <24000000>;

		atmxt@4a {
			compatible = "atmel,atmxt-ts";
			reg = <0x4a>;
			interrupt-parent = <&msmgpio>;
			interrupts = <46 0>;
			gpios = <&msmgpio 46 0>, /* IRQ */
				<&msmgpio 63 0>, /* RESET */
				<&msmgpio 52 0>; /* ENABLE */

			atmel,atmxt-tdat-filename = "atmxt-r2.tdat";
		};
	};
```

## Documentation/devicetree/bindings/input/touchscreen/cyttsp3-i2c.txt
```
Cypress Gen3 touch controller

Required properties:

 - compatible	: should be "cyttsp3,i2c"
 - reg			: i2c slave address of the device
 - interrupt-parent	: parent of interrupt
 - interrupts		: touch sample interrupt to indicate presense or release
				of fingers on the panel.
 - vdd_ana-supply	: Analog power supply needed to power device
 - vdd_i2c-supply	: Power supply need to power i2c bus
 - cyttsp3,reset-gpio	: reset gpio
 - cyttsp3,flags	: flags to enable debugging, etc.
 - cyttsp3,abs		: abs parameters, containing info such as panel and display sizes
 - cyttsp3,tsett-list	: tsett list
 - cyttsp3,tsett1	: tsett1 parameter
 - cyttsp3,tsett1-tag	: tsett1 tag
 - cyttsp3,tsett2	: tsett2 parameter
 - cyttsp3,tsett2-tag	: tsett2 tag
 - cyttsp3,tsett3	: tsett3 parameter

Required for firmware update only:
 - cyttsp3,fw-version	: firmware version
 - cyttsp3,fw-name	: firmware name to use for flashing firmware

Optional property:
 - cyttsp3,enable-vkeys	: enable/disable virtual keys
 - cyttsp3,vkey-map	: virtual key mapping in display coordinates

Example:
	i2c@f9966000 {
		cell-index = <3>;
		compatible = "qcom,i2c-qup";
		reg = <0xf9966000 0x1000>;
		reg-names = "qup_phys_addr";
		interrupts = <0 104 0>;
		interrupt-names = "qup_err_intr";
		qcom,i2c-bus-freq = <100000>;
		qcom,i2c-src-freq = <24000000>;

		cyttsp3_i2c@3b {
			compatible = "cyttsp3,i2c";
			reg = <0x3b>;
			interrupt-parent = <&msmgpio>;
			interrupts = <48 0x0>;
			vdd_ana-supply = <&pm8941_l18>;
			vcc_i2c-supply = <&pm8941_lvs1>;
			cyttsp3,reset-gpio = <&msmgpio 24 0>;
			cyttsp3,flags = <0x03>;
			cyttsp3,abs = <
				0x35 14 1009 0 0
				0x36 10  944 0 0
				0x3A  0  255 0 0
				0x32  0   20 0 0
				0x39  0    4 0 0 >;
			cyttsp3,enable-vkeys = <1>;
			cyttsp3,vkey-map = <
				107 1345 104 103
				276 1345 104 103
				444 1345 104 103
				613 1345 104 103 >;
			cyttsp3,tsett-list = <1 2 3>;
			cyttsp3,tsett1 = <0 0 0 0>;
			cyttsp3,tsett1-tag = <3>;
			cyttsp3,tsett2 = <0 0 0 0 0 0x01 0x00 0xff 0x00>;
			cyttsp3,tsett2-tag = <6>;
			cyttsp3,tsett3 = <0 1 2 3 4 5 6 7>;
			cyttsp3,fw-version = <0x16 0xa4 0x00 0x00 0x18 0x0b 0x14 0x0c 0x00>;
			cyttsp3,fw-name = "cyttsp3.bin";
		}
	};
```

## Documentation/devicetree/bindings/input/touchscreen/goodix_ts_i2c.txt
```
Device tree binding for Goodix i2c touchdriver

Required properties:
 - compatible: device & driver matching.
         * for berlin series touch device, souch as "goodix,gt9916", "goodix,gt9966"

 - reg: i2c client address, value can be 0x14 or 0x5d. please refer to datasheet.
 - goodix,reset-gpio: reset gpio.
 - goodix,irq-gpio: interrupt gpio.
 - goodix,irq-flags: irq trigger type config, value should be:
                1 - rising edge,
                2 - falling edge,
                4 - high level,
                5 - low level.
 - goodix,panel-max-x: max resolution of x direction.
 - goodix,panel-max-y: max resolution of y direction.
 - goodix,panel-max-w: panel max width value.
 - goodix,panel-max-p: pen device max pressure value.

Optional properties:
 - goodix,avdd-name: set name of regulator.
 - avdd-supply: power supply for the touch device.
   example of regulator:
        goodix,avdd-name = "avdd";
        avdd-supply = <&pm8916_l15>;
 - iovdd-supply: power supply for digital io circuit
   example of regulator:
        goodix,iovdd-name = "iovdd";
        iovdd-supply = <&pm8916_l16>;
 - goodix,pen-enable: set this property if you want support stylus.
        goodix,pen-enable;
 - goodix,firmware-name: set firmware file name, if not configured, use the default name.
 - goodix,config-name: set config file name, if not configured, use the default name.
 - invert_xy: invert x and y in case of inversely mounted IC.

Example 1:
	goodix-berlin@5d {
		compatible = "goodix,gt9916";
		reg = <0x5d>;
		goodix,reset-gpio = <&msm_gpio 12 0x0>;
		goodix,irq-gpio = <&msm_gpio 13 0x2800>;
		goodix,irq-flags = <2>; /* 1:trigger rising, 2:trigger falling;*/
		goodix,panel-max-x = <720>;
		goodix,panel-max-y = <1280>;
		goodix,panel-max-w = <255>;
	};

Example 2:
	goodix-berlin@5d {
		compatible = "goodix,gt9966";
		goodix,avdd-name = "avdd";
		avdd-supply = <&pm8916_l15>;
		goodix,iovdd-name = "iovdd";
		iovdd-supply = <&pm8916_l16>;

		reg = <0x5d>;
		goodix,reset-gpio = <&msm_gpio 12 0x0>;
		goodix,irq-gpio = <&msm_gpio 13 0x2800>;
		goodix,irq-flags = <2>; /* 1:trigger rising, 2:trigger falling;*/
		goodix,panel-max-x = <720>;
		goodix,panel-max-y = <1280>;
		goodix,panel-max-w = <255>;
		goodix,panel-max-p = <4096>; /* max pressure that pen device supported */
		goodix,pen-enable; /* support active stylus device*/
		invert_xy;
		goodix,firmware-name = "goodix_firmware.bin";
		goodix,config-name = "goodix_cfg_group.bin";
	};
```

## Documentation/devicetree/bindings/input/touchscreen/goodix_ts_spi.txt
```
devicetree binding for Goodix spi touchdriver

Required properties:
 - compatible: device & driver matching.
        * for berlin series touch device, such as "goodix,gt9916S", "goodix,gt9916S2"

 - spi-max-frequency: set spi transfer speed.
 - reg: depend on CS gpio.
 - goodix,reset-gpio: reset gpio.
 - goodix,irq-gpio: interrupt gpio.
 - goodix,irq-flags: irq trigger type config, value should be:
                1 - rising edge,
                2 - falling edge,
                4 - high level,
                5 - low level.
 - goodix,panel-max-x: max resolution of x direction.
 - goodix,panel-max-y: max resolution of y direction.
 - goodix,panel-max-w: panel max width value.
 - goodix,panel-max-p: pen device max pressure value.

Optional properties:
 - goodix,avdd-name: set name of regulator.
 - avdd-supply: power supply for the touch device.
   example of regulator:
        goodix,avdd-name = "avdd";
        avdd-supply = <&pm8916_l15>;
 - iovdd-supply: power supply for digital io circuit
   example of regulator:
        goodix,iovdd-name = "iovdd";
        iovdd-supply = <&pm8916_l16>;
 - goodix,pen-enable: set this property if you want support stylus.
        goodix,pen-enable;
 - goodix,firmware-name: set firmware file name, if not configured, use the default name.
 - goodix,config-name: set config file name, if not configured, use the default name.

Example 1:
	goodix-berlin@0 {
		compatible = "goodix,gt9916S";
		reg = <0>;
		spi-max-frequency = <1000000>;
		goodix,reset-gpio = <&msm_gpio 12 0x0>;
		goodix,irq-gpio = <&msm_gpio 13 0x2800>;
		goodix,irq-flags = <2>; /* 1:trigger rising, 2:trigger falling;*/
		goodix,panel-max-x = <720>;
		goodix,panel-max-y = <1280>;
		goodix,panel-max-w = <255>;
	};

Example 2:
	goodix-berlin@0 {
		compatible = "goodix,gt9916S2";
		reg = <0>;
		spi-max-frequency = <1000000>;

		goodix,avdd-name = "avdd";
		avdd-supply = <&pm8916_l15>;
		goodix,iovdd-name = "iovdd";
		iovdd-supply = <&pm8916_l16>;

		goodix,reset-gpio = <&msm_gpio 12 0x0>;
		goodix,irq-gpio = <&msm_gpio 13 0x2800>;
		goodix,irq-flags = <2>; /* 1:trigger rising, 2:trigger falling;*/
		goodix,panel-max-x = <720>;
		goodix,panel-max-y = <1280>;
		goodix,panel-max-w = <255>;
		goodix,panel-max-p = <4096>; /* max pressure that pen device supported */
		goodix,pen-enable; /* support active stylus device*/

		goodix,firmware-name = "goodix_firmware.bin";
		goodix,config-name = "goodix_cfg_group.bin";
	};
```
