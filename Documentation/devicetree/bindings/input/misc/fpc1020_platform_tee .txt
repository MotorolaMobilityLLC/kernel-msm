## Documentation/devicetree/bindings/input/touchscreen/novatek.txt
```
Novatek TDDI nt36xxx series touch controller

Required properties:
 - compatible           : Should be "novatek,NVT-ts".
 - reg                  : I2c slave address of the device.
 - interrupt-parent     : Parent of interrupt.
 - interrupts		    : Configuration of touch panel controller interrupt GPIO.
 - novatek,irq-gpio	    : Interrupt gpio



Optional property:
 - novatek,reset-gpio	 : Reset gpio
 - vdd-supply			 : Phandle for digital voltage regulator device node.
 - avdd-supply			 : Phandle for analog voltage regulator device node.
 - novatek,mp-support-dt : Boolean used to enable MP criteria definition in dtsi file.
 - novatek-mp-criteria-nvtpid : The "nvtpid" shoud be replaced to Novatek project id.
                           ID is provided by Novatek. The nvtpid is 2 bytes data (show hex).
                           Ex. 110E.



Optional properties inside child node:
These properties are defined only when novatek,mp-support-dt property and
novatek-mp-criteria-nvtpid are defined in DT.
 - compatible       : Needs be the same as child node name "novatek-mp-criteria-nvtpid".
 - IC_X_CFG_SIZE    : Totally touch sensor pin number in x-direction.
 - IC_Y_CFG_SIZE    : Totally touch sensor pin number in y-direction.
 - IC_KEY_CFG_SIZE  : Totally touch sensor pin number as touch keys.
 - X_Channel        : Used pin number in x-direction. It depends on panel design.
 - Y_Channel        : Used pin number in y-direction. It depends on panel design.
 - AIN_X            : Touch sensor pin mapping from IC to sensor pad in x-direction.
 - AIN_Y            : Touch sensor pin mapping from IC to sensor pad in y-direction.
 - AIN_KEY          : Touch sensor pin mapping from IC to sensor pad for touch key.
 - PS_Config_Lmt_Short_Rawdata_P     : Positive criteria of short test for active area.
 - PS_Config_Lmt_Short_Rawdata_N     : Negative criteria of short test for active area.
 - PS_Config_Lmt_Key_Short_Rawdata_P : Positive criteria of short test for touch key.
 - PS_Config_Lmt_Key_Short_Rawdata_N : Negative criteria of short test for touch key.
 - PS_Config_Lmt_Open_Rawdata_P      : Positive criteria of open test for active area.
 - PS_Config_Lmt_Open_Rawdata_N      : Negative criteria of open test for active area.
 - PS_Config_Lmt_FW_Rawdata_P        : Positive criteria of open test for touch key.
 - PS_Config_Lmt_FW_Rawdata_N        : Negative criteria of open test for touch key.

 - PS_Config_Lmt_FW_CC_P             : Positive criteria of capacitance compensation for active area.
 - PS_Config_Lmt_FW_CC_N             : Negative criteria of capacitance compensation for active area.
 - PS_Config_Lmt_Key_FW_CC_P         : Positive criteria of capacitance compensation for touch key.
 - PS_Config_Lmt_Key_FW_CC_N         : Negative criteria of capacitance compensation for touch key.

 - PS_Config_Lmt_FW_Diff_P           : Positive criteria of diff test data for active area.
 - PS_Config_Lmt_FW_Diff_N           : Negative criteria of diff test data for active area.
 - PS_Config_Lmt_Key_FW_Diff_P       : Positive criteria of diff test data for touch key.
 - PS_Config_Lmt_Key_FW_Diff_N       : Negative criteria of diff test data for touch key.

 - PS_Config_Diff_Test_Frame         : Test frame number for diff test.



These properties are supported only for carrier system touch controller.
 - PS_Config_Lmt_Short_Diff_P        : Positive criteria of short test diff data for active area.
 - PS_Config_Lmt_Short_Diff_N        : Negative criteria of short test diff data for active area.
 - PS_Config_Lmt_Key_Short_Diff_P    : Positive criteria of short test diff data for touch key.
 - PS_Config_Lmt_Key_Short_Diff_N    : Negative criteria of short test diff data for touch key.
 - PS_Config_Lmt_Short_Base_P        : Positive criteria of short test for active area.
 - PS_Config_Lmt_Short_Base_N        : Negative criteria of short test for active area.
 - PS_Config_Lmt_Key_Short_Base_P    : Positive criteria of short test for touch key.
 - PS_Config_Lmt_Key_Short_Base_N    : Negative criteria of short test for touch key.
 - PS_Config_Lmt_FW_CC_I_P           : Positive criteria of I-phase capacitance compensation for active area.
 - PS_Config_Lmt_FW_CC_I_N           : Negative criteria of I-phase capacitance compensation for active area.
 - PS_Config_Lmt_FW_CC_Q_P           : Positive criteria of Q-phase capacitance compensation for active area.
 - PS_Config_Lmt_FW_CC_Q_N           : Negative criteria of Q-phase capacitance compensation for active area.
 - PS_Config_Lmt_Key_FW_CC_I_P       : Positive criteria of I-phase capacitance compensation for touch key.
 - PS_Config_Lmt_Key_FW_CC_I_N       : Negative criteria of I-phase capacitance compensation for touch key.
 - PS_Config_Lmt_Key_FW_CC_Q_P       : Positive criteria of Q-phase capacitance compensation for touch key.
 - PS_Config_Lmt_Key_FW_CC_Q_N       : Negative criteria of Q-phase capacitance compensation for touch key.



Example:
i2c@f9927000 {
	novatek@62 {
		compatible = "novatek,NVT-ts";
		reg = <0x62>;
		status = "ok";
		novatek,reset-gpio = <&msm_gpio 102 0x00>;
		novatek,irq-gpio = <&msm_gpio 65 0x2001>;

		/* MP */
		novatek,mp-support-dt;

		novatek-mp-criteria-110E@0 {
			#address-cells = <1>;
			#size-cells = <0>;
			compatible = "novatek-mp-criteria-110E";

			/* MP Config */
			IC_X_CFG_SIZE = <18>;
			IC_Y_CFG_SIZE = <32>;
			IC_KEY_CFG_SIZE = <4>;
			X_Channel = <18>;
			Y_Channel = <32>;
			AIN_X = <0 1 2 3 4 5 6 7 8 9 10 11 12 13 14 15 16 17>;
			AIN_Y = <0 1 2 3 4 5 6 7 8 9 10 11 12 13 14 15 16 17 18 19
								20 21 22 23 24 25 26 27 28 29 30 31>;
			AIN_KEY = <0 1 2 0xFF>;

			/* MP Criteria */
			PS_Config_Lmt_Short_Rawdata_P = <20000>;
			PS_Config_Lmt_Short_Rawdata_N = <11550>;
			PS_Config_Lmt_Key_Short_Rawdata_P = <20000>;
			PS_Config_Lmt_Key_Short_Rawdata_N = <11550>;
			PS_Config_Lmt_Short_Diff_P = <6300>;
			PS_Config_Lmt_Short_Diff_N = <0>;
			PS_Config_Lmt_Key_Short_Diff_P = <6300>;
			PS_Config_Lmt_Key_Short_Diff_N = <0>;
			PS_Config_Lmt_Short_Base_P = <2000>;
			PS_Config_Lmt_Short_Base_N = <(-2000)>;
			PS_Config_Lmt_Key_Short_Base_P = <2000>;
			PS_Config_Lmt_Key_Short_Base_N = <(-2000)>;

			PS_Config_Lmt_Open_Rawdata_P = <
				9000 9000 9000 9000 9000 9000 9000 9000 9000 9000 9000 9000 9000 9000 9000 9000 9000 9000
				9000 9000 9000 9000 9000 9000 9000 9000 9000 9000 9000 9000 9000 9000 9000 9000 9000 9000
				9000 9000 9000 9000 9000 9000 9000 9000 9000 9000 9000 9000 9000 9000 9000 9000 9000 9000
				9000 9000 9000 9000 9000 9000 9000 9000 9000 9000 9000 9000 9000 9000 9000 9000 9000 9000
				9000 9000 9000 9000 9000 9000 9000 9000 9000 9000 9000 9000 9000 9000 9000 9000 9000 9000
				9000 9000 9000 9000 9000 9000 9000 9000 9000 9000 9000 9000 9000 9000 9000 9000 9000 9000
				9000 9000 9000 9000 9000 9000 9000 9000 9000 9000 9000 9000 9000 9000 9000 9000 9000 9000
				9000 9000 9000 9000 9000 9000 9000 9000 9000 9000 9000 9000 9000 9000 9000 9000 9000 9000
				9000 9000 9000 9000 9000 9000 9000 9000 9000 9000 9000 9000 9000 9000 9000 9000 9000 9000
				9000 9000 9000 9000 9000 9000 9000 9000 9000 9000 9000 9000 9000 9000 9000 9000 9000 9000
				9000 9000 9000 9000 9000 9000 9000 9000 9000 9000 9000 9000 9000 9000 9000 9000 9000 9000
				9000 9000 9000 9000 9000 9000 9000 9000 9000 9000 9000 9000 9000 9000 9000 9000 9000 9000
				9000 9000 9000 9000 9000 9000 9000 9000 9000 9000 9000 9000 9000 9000 9000 9000 9000 9000
				9000 9000 9000 9000 9000 9000 9000 9000 9000 9000 9000 9000 9000 9000 9000 9000 9000 9000
				9000 9000 9000 9000 9000 9000 9000 9000 9000 9000 9000 9000 9000 9000 9000 9000 9000 9000
				9000 9000 9000 9000 9000 9000 9000 9000 9000 9000 9000 9000 9000 9000 9000 9000 9000 9000
				9000 9000 9000 9000 9000 9000 9000 9000 9000 9000 9000 9000 9000 9000 9000 9000 9000 9000
				9000 9000 9000 9000 9000 9000 9000 9000 9000 9000 9000 9000 9000 9000 9000 9000 9000 9000
				9000 9000 9000 9000 9000 9000 9000 9000 9000 9000 9000 9000 9000 9000 9000 9000 9000 9000
				9000 9000 9000 9000 9000 9000 9000 9000 9000 9000 9000 9000 9000 9000 9000 9000 9000 9000
				9000 9000 9000 9000 9000 9000 9000 9000 9000 9000 9000 9000 9000 9000 9000 9000 9000 9000
				9000 9000 9000 9000 9000 9000 9000 9000 9000 9000 9000 9000 9000 9000 9000 9000 9000 9000
				9000 9000 9000 9000 9000 9000 9000 9000 9000 9000 9000 9000 9000 9000 9000 9000 9000 9000
				9000 9000 9000 9000 9000 9000 9000 9000 9000 9000 9000 9000 9000 9000 9000 9000 9000 9000
				9000 9000 9000 9000 9000 9000 9000 9000 9000 9000 9000 9000 9000 9000 9000 9000 9000 9000
				9000 9000 9000 9000 9000 9000 9000 9000 9000 9000 9000 9000 9000 9000 9000 9000 9000 9000
				9000 9000 9000 9000 9000 9000 9000 9000 9000 9000 9000 9000 9000 9000 9000 9000 9000 9000
				9000 9000 9000 9000 9000 9000 9000 9000 9000 9000 9000 9000 9000 9000 9000 9000 9000 9000
				9000 9000 9000 9000 9000 9000 9000 9000 9000 9000 9000 9000 9000 9000 9000 9000 9000 9000
				9000 9000 9000 9000 9000 9000 9000 9000 9000 9000 9000 9000 9000 9000 9000 9000 9000 9000
				9000 9000 9000>;

			PS_Config_Lmt_Open_Rawdata_N = <
				5500 5500 5500 5500 5500 5500 5500 5500 5500 5500 5500 5500 5500 5500 5500 5500 5500 5500
				5500 5500 5500 5500 5500 5500 5500 5500 5500 5500 5500 5500 5500 5500 5500 5500 5500 5500
				5500 5500 5500 5500 5500 5500 5500 5500 5500 5500 5500 5500 5500 5500 5500 5500 5500 5500
				5500 5500 5500 5500 5500 5500 5500 5500 5500 5500 5500 5500 5500 5500 5500 5500 5500 5500
				5500 5500 5500 5500 5500 5500 5500 5500 5500 5500 5500 5500 5500 5500 5500 5500 5500 5500
				5500 5500 5500 5500 5500 5500 5500 5500 5500 5500 5500 5500 5500 5500 5500 5500 5500 5500
				5500 5500 5500 5500 5500 5500 5500 5500 5500 5500 5500 5500 5500 5500 5500 5500 5500 5500
				5500 5500 5500 5500 5500 5500 5500 5500 5500 5500 5500 5500 5500 5500 5500 5500 5500 5500
				5500 5500 5500 5500 5500 5500 5500 5500 5500 5500 5500 5500 5500 5500 5500 5500 5500 5500
				5500 5500 5500 5500 5500 5500 5500 5500 5500 5500 5500 5500 5500 5500 5500 5500 5500 5500
				5500 5500 5500 5500 5500 5500 5500 5500 5500 5500 5500 5500 5500 5500 5500 5500 5500 5500
				5500 5500 5500 5500 5500 5500 5500 5500 5500 5500 5500 5500 5500 5500 5500 5500 5500 5500
				5500 5500 5500 5500 5500 5500 5500 5500 5500 5500 5500 5500 5500 5500 5500 5500 5500 5500
				5500 5500 5500 5500 5500 5500 5500 5500 5500 5500 5500 5500 5500 5500 5500 5500 5500 5500
				5500 5500 5500 5500 5500 5500 5500 5500 5500 5500 5500 5500 5500 5500 5500 5500 5500 5500
				5500 5500 5500 5500 5500 5500 5500 5500 5500 5500 5500 5500 5500 5500 5500 5500 5500 5500
				5500 5500 5500 5500 5500 5500 5500 5500 5500 5500 5500 5500 5500 5500 5500 5500 5500 5500
				5500 5500 5500 5500 5500 5500 5500 5500 5500 5500 5500 5500 5500 5500 5500 5500 5500 5500
				5500 5500 5500 5500 5500 5500 5500 5500 5500 5500 5500 5500 5500 5500 5500 5500 5500 5500
				5500 5500 5500 5500 5500 5500 5500 5500 5500 5500 5500 5500 5500 5500 5500 5500 5500 5500
				5500 5500 5500 5500 5500 5500 5500 5500 5500 5500 5500 5500 5500 5500 5500 5500 5500 5500
				5500 5500 5500 5500 5500 5500 5500 5500 5500 5500 5500 5500 5500 5500 5500 5500 5500 5500
				5500 5500 5500 5500 5500 5500 5500 5500 5500 5500 5500 5500 5500 5500 5500 5500 5500 5500
				5500 5500 5500 5500 5500 5500 5500 5500 5500 5500 5500 5500 5500 5500 5500 5500 5500 5500
				5500 5500 5500 5500 5500 5500 5500 5500 5500 5500 5500 5500 5500 5500 5500 5500 5500 5500
				5500 5500 5500 5500 5500 5500 5500 5500 5500 5500 5500 5500 5500 5500 5500 5500 5500 5500
				5500 5500 5500 5500 5500 5500 5500 5500 5500 5500 5500 5500 5500 5500 5500 5500 5500 5500
				5500 5500 5500 5500 5500 5500 5500 5500 5500 5500 5500 5500 5500 5500 5500 5500 5500 5500
				5500 5500 5500 5500 5500 5500 5500 5500 5500 5500 5500 5500 5500 5500 5500 5500 5500 5500
				5500 5500 5500 5500 5500 5500 5500 5500 5500 5500 5500 5500 5500 5500 5500 5500 5500 5500
				5500 5500 5500>;

			PS_Config_Lmt_FW_Rawdata_P = <
				2000 2000 2000 2000 2000 2000 2000 2000 2000 2000 2000 2000 2000 2000 2000 2000 2000 2000
				2000 2000 2000 2000 2000 2000 2000 2000 2000 2000 2000 2000 2000 2000 2000 2000 2000 2000
				2000 2000 2000 2000 2000 2000 2000 2000 2000 2000 2000 2000 2000 2000 2000 2000 2000 2000
				2000 2000 2000 2000 2000 2000 2000 2000 2000 2000 2000 2000 2000 2000 2000 2000 2000 2000
				2000 2000 2000 2000 2000 2000 2000 2000 2000 2000 2000 2000 2000 2000 2000 2000 2000 2000
				2000 2000 2000 2000 2000 2000 2000 2000 2000 2000 2000 2000 2000 2000 2000 2000 2000 2000
				2000 2000 2000 2000 2000 2000 2000 2000 2000 2000 2000 2000 2000 2000 2000 2000 2000 2000
				2000 2000 2000 2000 2000 2000 2000 2000 2000 2000 2000 2000 2000 2000 2000 2000 2000 2000
				2000 2000 2000 2000 2000 2000 2000 2000 2000 2000 2000 2000 2000 2000 2000 2000 2000 2000
				2000 2000 2000 2000 2000 2000 2000 2000 2000 2000 2000 2000 2000 2000 2000 2000 2000 2000
				2000 2000 2000 2000 2000 2000 2000 2000 2000 2000 2000 2000 2000 2000 2000 2000 2000 2000
				2000 2000 2000 2000 2000 2000 2000 2000 2000 2000 2000 2000 2000 2000 2000 2000 2000 2000
				2000 2000 2000 2000 2000 2000 2000 2000 2000 2000 2000 2000 2000 2000 2000 2000 2000 2000
				2000 2000 2000 2000 2000 2000 2000 2000 2000 2000 2000 2000 2000 2000 2000 2000 2000 2000
				2000 2000 2000 2000 2000 2000 2000 2000 2000 2000 2000 2000 2000 2000 2000 2000 2000 2000
				2000 2000 2000 2000 2000 2000 2000 2000 2000 2000 2000 2000 2000 2000 2000 2000 2000 2000
				2000 2000 2000 2000 2000 2000 2000 2000 2000 2000 2000 2000 2000 2000 2000 2000 2000 2000
				2000 2000 2000 2000 2000 2000 2000 2000 2000 2000 2000 2000 2000 2000 2000 2000 2000 2000
				2000 2000 2000 2000 2000 2000 2000 2000 2000 2000 2000 2000 2000 2000 2000 2000 2000 2000
				2000 2000 2000 2000 2000 2000 2000 2000 2000 2000 2000 2000 2000 2000 2000 2000 2000 2000
				2000 2000 2000 2000 2000 2000 2000 2000 2000 2000 2000 2000 2000 2000 2000 2000 2000 2000
				2000 2000 2000 2000 2000 2000 2000 2000 2000 2000 2000 2000 2000 2000 2000 2000 2000 2000
				2000 2000 2000 2000 2000 2000 2000 2000 2000 2000 2000 2000 2000 2000 2000 2000 2000 2000
				2000 2000 2000 2000 2000 2000 2000 2000 2000 2000 2000 2000 2000 2000 2000 2000 2000 2000
				2000 2000 2000 2000 2000 2000 2000 2000 2000 2000 2000 2000 2000 2000 2000 2000 2000 2000
				2000 2000 2000 2000 2000 2000 2000 2000 2000 2000 2000 2000 2000 2000 2000 2000 2000 2000
				2000 2000 2000 2000 2000 2000 2000 2000 2000 2000 2000 2000 2000 2000 2000 2000 2000 2000
				2000 2000 2000 2000 2000 2000 2000 2000 2000 2000 2000 2000 2000 2000 2000 2000 2000 2000
				2000 2000 2000 2000 2000 2000 2000 2000 2000 2000 2000 2000 2000 2000 2000 2000 2000 2000
				2000 2000 2000 2000 2000 2000 2000 2000 2000 2000 2000 2000 2000 2000 2000 2000 2000 2000
				2000 2000 2000>;

			PS_Config_Lmt_FW_Rawdata_N= <
				400 400 400 400 400 400 400 400 400 400 400 400 400 400 400 400 400 400
				400 400 400 400 400 400 400 400 400 400 400 400 400 400 400 400 400 400
				400 400 400 400 400 400 400 400 400 400 400 400 400 400 400 400 400 400
				400 400 400 400 400 400 400 400 400 400 400 400 400 400 400 400 400 400
				400 400 400 400 400 400 400 400 400 400 400 400 400 400 400 400 400 400
				400 400 400 400 400 400 400 400 400 400 400 400 400 400 400 400 400 400
				400 400 400 400 400 400 400 400 400 400 400 400 400 400 400 400 400 400
				400 400 400 400 400 400 400 400 400 400 400 400 400 400 400 400 400 400
				400 400 400 400 400 400 400 400 400 400 400 400 400 400 400 400 400 400
				400 400 400 400 400 400 400 400 400 400 400 400 400 400 400 400 400 400
				400 400 400 400 400 400 400 400 400 400 400 400 400 400 400 400 400 400
				400 400 400 400 400 400 400 400 400 400 400 400 400 400 400 400 400 400
				400 400 400 400 400 400 400 400 400 400 400 400 400 400 400 400 400 400
				400 400 400 400 400 400 400 400 400 400 400 400 400 400 400 400 400 400
				400 400 400 400 400 400 400 400 400 400 400 400 400 400 400 400 400 400
				400 400 400 400 400 400 400 400 400 400 400 400 400 400 400 400 400 400
				400 400 400 400 400 400 400 400 400 400 400 400 400 400 400 400 400 400
				400 400 400 400 400 400 400 400 400 400 400 400 400 400 400 400 400 400
				400 400 400 400 400 400 400 400 400 400 400 400 400 400 400 400 400 400
				400 400 400 400 400 400 400 400 400 400 400 400 400 400 400 400 400 400
				400 400 400 400 400 400 400 400 400 400 400 400 400 400 400 400 400 400
				400 400 400 400 400 400 400 400 400 400 400 400 400 400 400 400 400 400
				400 400 400 400 400 400 400 400 400 400 400 400 400 400 400 400 400 400
				400 400 400 400 400 400 400 400 400 400 400 400 400 400 400 400 400 400
				400 400 400 400 400 400 400 400 400 400 400 400 400 400 400 400 400 400
				400 400 400 400 400 400 400 400 400 400 400 400 400 400 400 400 400 400
				400 400 400 400 400 400 400 400 400 400 400 400 400 400 400 400 400 400
				400 400 400 400 400 400 400 400 400 400 400 400 400 400 400 400 400 400
				400 400 400 400 400 400 400 400 400 400 400 400 400 400 400 400 400 400
				400 400 400 400 400 400 400 400 400 400 400 400 400 400 400 400 400 400
				400 400 400>;

			PS_Config_Lmt_FW_CC_P = <38>;
			PS_Config_Lmt_FW_CC_N = <9>;
			PS_Config_Lmt_Key_FW_CC_P = <38>;
			PS_Config_Lmt_Key_FW_CC_N = <9>;

			PS_Config_Lmt_FW_CC_I_P = <25>;
			PS_Config_Lmt_FW_CC_I_N = <0>;
			PS_Config_Lmt_FW_CC_Q_P = <25>;
			PS_Config_Lmt_FW_CC_Q_N = <0>;
			PS_Config_Lmt_Key_FW_CC_I_P = <25>;
			PS_Config_Lmt_Key_FW_CC_I_N = <0>;
			PS_Config_Lmt_Key_FW_CC_Q_P = <25>;
			PS_Config_Lmt_Key_FW_CC_Q_N = <0>;

			PS_Config_Lmt_FW_Diff_P = <35>;
			PS_Config_Lmt_FW_Diff_N = <(-35)>;
			PS_Config_Lmt_Key_FW_Diff_P = <35>;
			PS_Config_Lmt_Key_FW_Diff_N = <(-35)>;

			PS_Config_Diff_Test_Frame = <50>;
		};
	};
};
```
