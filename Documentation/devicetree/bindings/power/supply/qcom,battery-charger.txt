## Documentation/devicetree/bindings/regulator/tps65132-regulator.txt
```
TPS65132 Regulator

Required properties:
- compatible:		Must be "ti,tps65132".
- reg:			i2c slave address of the device
- regulator:		Must include this node with the following properties
	- regulator-name:	Specifies regulator name to use

Optional properties:
- active-dis:		Enables active discharge
- app-tablet:		Enables tablet mode appliation for higher current needs
- gpios:		Specifies the gpios for enable-p and enable-n

All properties specified within the core regulator framework can also be used in
the regulator node. These bindings can be found in regulator.txt.

Example:

/ {
	tps65132@3e {
		compatible = "ti,tps65132";
		reg = <0x3e>;
		gpios = <&msmgpio 31 0x0>, <&msmgpio 33 0x0>;
		tps65132: regulator {
			regulator-name = "tps65132";
			regulator-min-microvolt = <5300000>;
			regulator-max-microvolt = <5900000>;
		};
	};
};
```

## Documentation/devicetree/bindings/soc/qcom/adsp_sleepmon.txt
```
Qualcomm Technologies, Inc. ADSP Sleep Monitor

The ADSP Sleep monitor driver tracks ADSP sleep statistics stored in SMEM region
and establishes an interface with different userspace clients which make use of
ADSP subsystem. Based on the activity notifications from the userspace clients
for activity start and stop notifications, the driver detects and logs an error
message in kernel logs and creates a kernel/ADSP panic (when enabled) upon detecting
a violation in ADSP sleep/LPI state after the configured monitoring duration.
By default the driver emits out kernel message on detecting these violations,
optionally a kernel/ADSP panic can be enabled separately for ADSP sleep or LPI
issues via this config. When enabled, corresponding panics can be
disabled/re-enabled runtime via debugfs node exposed from the driver.

"echo 0 > /d/adspsleepmon/panic-state" --> Disables kernel panic for ADSP sleep and LPI voilations.

"echo 1 > /d/adspsleepmon/panic-state" --> Enables kernel panic for ADSP sleep voilations.

"echo 2 > /d/adspsleepmon/panic-state" --> Enables kernel panic for ADSP LPI voilations.

"echo 3 > /d/adspsleepmon/panic-state" --> Enables kernel panic for ADSP Sleep and LPI voilations.

"cat /d/adspsleepmon/read_panic_state" --> Displays the current panic enablement status


"echo 0 > /d/adspsleepmon/adsp_panic_state" --> Disables ADSP panic for ADSP sleep and LPI voilations.

"echo 1 > /d/adspsleepmon/adsp_panic_state" --> Enables ADSP panic for ADSP sleep voilations.

"echo 2 > /d/adspsleepmon/adsp_panic_state" --> Enables ADSP panic for ADSP LPI voilations.

"echo 3 > /d/adspsleepmon/adsp_panic_state" --> Enables ADSP panic for ADSP Sleep and LPI voilations.

"echo 4 > /d/adspsleepmon/adsp_panic_state" --> Enable ADSP panic on ADSP sleep monitor detecting
				continuous ADSP sleep violation for qcom,wait_time_lpm_overall
				duration over qcom,min_required_resumes CPU resumes when there
				is no audio activity.

"echo 7 > /d/adspsleepmon/adsp_panic_state" --> Enable ADSP panic on ADSP sleep monitor detecting
				continuous ADSP sleep violation for qcom,wait_time_lpm_overall
				duration over qcom,min_required_resumes CPU resumes when there
				is no audio activity along with ADSP panic for ADSP sleep and LPI
				voilations for audio clients.

"cat /d/adspsleepmon/read_adsp_panic_state" --> Displays the current ADSP panic enablement status


Examples:

"cat /d/adspsleepmon/read_panic_state"

 >Panic State: LPM and LPI panics Disabled

"cat /d/adspsleepmon/read_panic_state"

 >Panic State: LPI Panic enabled

properties:
- compatible: Must be "qcom,adsp-sleepmon".

- qcom,wait_time_lpm: wait time in seconds for LPM violation detections.
			The ADSP sleep monitor would wait for the specified
			duration after all the activities are done
			(based on user space clients activity notifications)
			before checking ADSP state.

- qcom,wait_time_lpi: wait time in seconds for LPI violation detections.
			The ADSP sleep monitor would wait for the specified
			duration after the start of an LPI only activity
			(based on user space clients activity notifications)
			before checking ADSP state.

- qcom,wait_time_lpm_overall: Minimum monitoring duration in seconds required for sleep
			violation detection when there is no audio activity.
			ADSP sleep monitor raises ADSP panic (if enabled via
			qcom,enable_adsp_panic_lpm_overall) on detecting sleep
			violation continuously for a minimum of this specified
			duration over qcom,min_required_resumes number of CPU resumes.

-qcom,min_required_resumes: Minimum number of CPU resumes required for sleep violation detection
			and action when there is no audio activity. ADSP sleep monitor raises
			ADSP panic (if enabled via qcom,enable_adsp_panic_lpm_overall)
			on detecting sleep violation continuously for a minimum of
			qcom,wait_time_lpm_overall duration over the specified number
			of CPU resumes.

- qcom,enable_panic_lpm: Enables kernel panic on detecting ADSP sleep violations.

- qcom,enable_panic_lpi: Enables kernel panic on detecting ADSP LPI violations.

- qcom,enable_adsp_panic_lpm: Enables ADSP panic on detecting ADSP sleep violations.

- qcom,enable_adsp_panic_lpi: Enables ADSP panic on detecting ADSP LPI violations.

-qcom,enable_adsp_panic_lpm_overall: Enable ADSP panic on ADSP sleep monitor detecting
				continuous ADSP sleep violation for qcom,wait_time_lpm_overall
				duration over qcom,min_required_resumes CPU resumes when there
				is no audio activity.
				ADSP sleep monitor doesn't track non-audio activities on ADSP.
				The panic can result in false positives if ADSP is kept active for
				the specified duration by a non-audio entity
				(sensors, camera, charger, wifi paging etc.). When enabling, the
				minimum duration and number of CPU resumes should be fine tuned based
				on the expected non-audio use case scenarios on ADSP.

Example:
adsp_sleepmon: adsp-sleepmon {
		compatible = "qcom,adsp-sleepmon";
		qcom,wait_time_lpm = <5>;
		qcom,wait_time_lpi = <15>;
		qcom,enable_adsp_panic_lpm;
		qcom,enable_adsp_panic_lpi;
		qcom,wait_time_lpm_overall = <60>;
		qcom,enable_adsp_panic_lpm_overall;
		qcom,min_required_resumes = <5>;
	};

Required properties:
- compatible: Must be "qcom,msm-adspsleepmon-rpmsg"
- qcom,glink-channels: Glink channel for communication with ADSP
- qcom,intents: A list of <size of each intent, number of intents>

Example:
qcom,msm_adspsleepmon_rpmsg {
	compatible = "qcom,msm-adspsleepmon-rpmsg";
	qcom,glink-channels = "sleepmonglink-apps-adsp";
	qcom,intents = <0x1000 8>;
	};
```

## Documentation/devicetree/bindings/soc/qcom/dmesg-dumper.yaml
```yaml
# SPDX-License-Identifier: GPL-2.0-only OR BSD-2-Clause
%YAML 1.2
---
$id: "http://devicetree.org/schemas/soc/qcom/dmesg-dumper.yaml#"
$schema: "http://devicetree.org/meta-schemas/core.yaml#"

title: Qualcomm Technologies, Inc. Dmesg dumper binding

maintainers:
  - Guru Das Srinagesh <quic_gurus@quicinc.com>

description: |
  Upon encountering a kernel panic in a Virtual machine or getting
  Virtual machine's alive log trrigger by primary Virtual machine,
  enable the dumping the dmesg log buffer to a reserved memory
  section through the use of a Gunyah shared-memory doorbell object.

properties:
  compatible:
    const: qcom,dmesg-dump

  qcom,primary-vm:
    description: Specify if this device is on the primary virtual machine.

  gunyah-label:
    $ref: '/schemas/types.yaml#/definitions/u32'
    maxItems: 1
    description: The label qrtr should request interrupts with this label from
                 the gunyah doorbell driver.

  shared-buffer:
    $ref: '/schemas/types.yaml#/definitions/phandle'
    maxItems: 1
    description: phandle reference to a reserved memory region for sharing
                 between vms

   ddump-pubkey-size:
    maxItems: 1
    description: The size of public key used to encrypt the alive log.

   ddump-pubkey:
    maxItems: 1
    description: The value of public key used to encrypt the alive log.

required:
  -compatible
  -gunyah-label
  -shared-buffer

examples:
  - |
    trust_ui_vm_dump@e55f2000 {
        no-map;
        reg = <0x0 0xe55f2000 0x0 0x1000>;
    };

    dmesg-dump {
        compatible = "qcom,dmesg-dump";
        qcom,primary-vm;
        gunyah-label = <6>;
        shared-buffer = <&trust_ui_vm_dump>;
    };
```

## Documentation/devicetree/bindings/soc/qcom/qcom,crm.yaml
```yaml
# SPDX-License-Identifier: (GPL-2.0-only OR BSD-2-Clause)
%YAML 1.2
---
$id: http://devicetree.org/schemas/soc/qcom/qcom-crm.yaml#
$schema: http://devicetree.org/meta-schemas/core.yaml#

title: Qualcomm Technologies, Inc. (QTI) CRM bindings

maintainers:
  - Maulik Shah <mkshah@qti.qualcomm.com>

description:
  Support for communication with the hardened-CRM blocks. A set of HW and
  SW client DRVs in CRM provides interface to vote desired power state of
  resources local to a subsystem.

properties:
  label:
    $ref: /schemas/types.yaml#/definitions/string-array
    maxItems: 1
    oneOf:
      - items:
          - const: cam_crm
          - const: pcie_crm
      - description: Specifies the name of the CRM.

  compatible:
    enum:
      - qcom,cam-crm
      - qcom,pcie-crm

  reg:
    maxItems: 1
    items:
      - description: Should specify the base address for the CRM device.

  reg-names:
    maxItems: 1
    items:
      - const: base

  interrupts:
    maxItems: 1
    items:
      - description: SW drv vote completion IRQ.

  interrupt-names:
    maxItems: 1
    oneOf:
      - items:
          - const: cam_crm
          - const: pcie_crm

  qcom,hw-drv-ids:
    description: List of HW DRV IDs.
    $ref: /schemas/types.yaml#/definitions/uint32-array
    minItems: 1
    maxItems: 3
    items:
      minimum: 0
      maximum: 2

  qcom,sw-drv-ids:
    description: List of SW DRV IDs.
    $ref: /schemas/types.yaml#/definitions/uint32-array
    minItems: 1
    maxItems: 2
    items:
      minimum: 0
      maximum: 1

  clocks:
    maxItems: 1
    items:
      - description: Bus Clock

required:
  - label
  - compatible
  - reg
  - reg-names
  - clocks

oneOf:
  - required:
      - qcom,hw-drv-ids
  - required:
      - qcom,sw-drv-ids

if:
  required:
      - qcom,sw-drv-ids
then:
  required:
    - interrupts
    - interrupt-names

additionalProperties: false

examples:
  # Example of Camera CRM device with HW DRVs
  - |
    #include <dt-bindings/interrupt-controller/arm-gic.h>
    #include <dt-bindings/clock/qcom,camcc-kalama.h>
    cam_crm: crm@add7000 {
      label = "cam_crm";
      compatible = "qcom,cam-crm";
      reg = <0xadd7000 0x2000>;
      clocks = <&camcc CAM_CC_DRV_AHB_CLK>;
      qcom,hw-drv-ids = <0 1 2>;
    };
  # Example of PCIe CRM device with SW DRVs
  - |
    #include <dt-bindings/interrupt-controller/arm-gic.h>
    pcie_crm: crm@1d01000 {
      label = "pcie_crm";
      compatible = "qcom,pcie-crm";
      reg = <0x1d01000 0x3000>;
      interrupts = <GIC_SPI 248 IRQ_TYPE_EDGE_RISING>;
      interrupt-names = "pcie_crm";
      clocks = <&pcie_0_pipe_clk>;
      qcom,sw-drv-ids = <0>;
    };
...
```

## Documentation/devicetree/bindings/soc/qcom/qcom,gh-msg-test.txt
```
QCT Gunyah Hypervisor Message Queue Test Driver

The Gunyah Hypervisor Test Driver is used to validate gunyah hypervisor
functionality. It includes test nodes for transferring gunyah message
queue between VMs.

Required properties:
- compatible:	"qcom,gh-msgq-test"
- qcom,label:   The IDs of message queue which are defined in gh_msgq.h
- qcom,primary: qcom,primary is required for the master device.
                The client device should ignore this property.
- affinity:     affinity is required for the client device.
                The property is used to affine msgq to specific CPU ID.

Example:
	Master:
	qcom,test-msgq {
		compatible = "qcom,gh-msgq-test";
		gunyah-label = <4>;
		qcom,primary;
	};

	Client:
	qcom,test-msgq {
		compatible = "qcom,gh-msgq-test";
		gunyah-label = <4>;
		affinity = <0>;
	};
```

## Documentation/devicetree/bindings/soc/qcom/qcom,glink-slatecom-xprt.txt
```
Qualcomm Technologies, Inc GLINK SLATECOM transport (glink_slatecom_xprt) binding

This binding describes the Qualcomm Technologies, Inc glink slatecom transport
driver, a slatecom-spi based communication channel for sending data between the
various subsystems in Qualcomm Technologies, Inc platforms.

- compatible:
	Usage: required
	Value type: <stringlist>
	Definition: must be "qcom,glink-slatecom-xprt"

- label:
	Usage: required
	Value type: <stringlist>
	Definition: must be "slate"

= EXAMPLE

The following example reprsents a glink_slatecom node.

	qcom,glink-slatecom-xprt-slate {
		compatible = "qcom,glink-slatecom-xprt";
		label = "slate";
	};

= AUDIO_CC_IPC_NODE
Each subnode of the glink_slatecom_xprt is a device node exposed to user space
by the audio-cc-ipc driver for sending ipc packets between the ipc clients.
Maximum nodes supported is 2.
- Each node defined should contain following property

- compatible:
	Usage: required
	Value type: <stringlist>
	Definition: must be "qcom,audio_cc_ipc"

- qcom,glink-channels:
	Usage: required
	Value type: <stringlist>

- reg:
	Usage: required
	Value type: <u32>

- cdev_name:
	Usage: required
	Value type: <stringlist>

= CC_CODEC_NODE
Audio_cc_ipc nodes can have a cc_codec child node. This node will act as an
interface for proxy codec, to manage the communication to its counter part
through ipc.
- Each node defined should contain following property

- compatible:
	Usage: required
	Value type: <stringlist>
	Definition: must be "qcom,cc-codec"

= EXAMPLE
The following example represents the audio-cc-ipc node having a codec child node

	audio_ipc1: qcom,audio_cc_ipc1 {
		compatible = "qcom,audio_cc_ipc";
		qcom,glink-channels = "custom_cc_apps";
		qcom,intents = <0x2000 2>;
		reg = <GPR_DOMAIN_ADSP>;
		cdev_name = "nongpr_channel";

		cc_codec: qcom,cc-codec {
			compatible = "qcom, cc-codec";
		};
	};
```

## Documentation/devicetree/bindings/soc/qcom/qcom,minidump.yaml
```yaml
%YAML 1.2
---
$id: "http://devicetree.org/schemas/soc/qcom/qcom,minidump.yaml#"
$schema: "http://devicetree.org/meta-schemas/core.yaml#"

title: Qualcomm Technologies, Inc. Minidump driver

description: |
  Minidump driver allows clients to register memory regions. It can dump
  registered memory regions when system goes wrong.

properties:
  compatible:
    enum:
      - qcom,minidump
      - qcom,minidump-rm

required:
  - compatible

examples:
  - |
    qcom,minidump {
        compatible = "qcom,minidump";
    };
```

## Documentation/devicetree/bindings/soc/qcom/qcom,power-state.txt
```
* Qualcomm Technologies, Inc. Power State Driver

This binding describes the Qualcomm Technologies, Inc. Power State Driver. Power
State creates power_state device node for user space communication. User space
client can open device node for communication and driver accordingly handles the
request.

Required Properties:

- compatible:
	Usage: required
	Value type: <string>
	Definition: must be "qcom,power-state"

Example:

	qcom,power-state {
		compatible = "qcom,power-state";
	};
```

## Documentation/devicetree/bindings/soc/qcom/qcom,slate_rsb.txt
```
Qualcomm technologies, Inc. slate-rsb

SALTE-RSB : slate-rsb is used to communicate with Slate over Glink
to configure the RSB eventsslate-rsb send commands over glink to
send configure, enable/disable RSB to Slate

Required properties:
- compatible : should be "qcom,slate-rsb"

Example:
	qcom,slate-rsb {
		compatible = "qcom,slate-rsb";
	};
```
