## Documentation/devicetree/bindings/soc/qcom/qcom,slatecom_rpmsg.txt
```
* Slatecom RPMSG Driver

slatecom_rpmsg driver provides functionality
to send and receive data over Glink from slate co processor.

Required properties:
- compatible:	      Must be "qcom,slatecom-rpmsg"
- qcom,glink-channels	specifies the glink channel name
- qcom,glinkpkt-edge	specifies the glink edge to match

Optional properties:
- intents		specifies the size and count of intents to glink

Example:
	qcom,slatecom-rpmsg {
		compatible = "qcom,slatecom-rpmsg";
		qcom,glink-channels = "slate_ctrl";
		qcom,glinkpkt-edge = "slate";
		intents = <0x200 1>;
	};
```

## Documentation/devicetree/bindings/soc/qcom/qcom,slatersb_rpmsg.txt
```
Qualcomm technologies, Inc. slatersb-rpmsg

SLATERSB-RPMSG : slatersb-rpmsg is used as an interface between SLATE-RSB
and slate for Glink communication.slate-rsb is used to communicate with
Slate over Glink to configure the RSB events.

Required properties:
- compatible : should be "qcom,slatersb-rpmsg"
- glink-channels : RSB_CTRL
- glinkpkt-edge : slate
- intents : <0x200 1>

Example:
	qcom,slatersb-rpmsg {
		compatible = "qcom,slatersb-rpmsg";
		qcom,glink-channels = "RSB_CTRL";
		qcom,glinkpkt-edge = "slate";
		intents = <0x200 1>;
	};
```

## Documentation/devicetree/bindings/soc/qcom/qcom,tlmm-vm-test.yaml
```yaml
%YAML 1.2
---
$id: http://devicetree.org/schemas/bindings/arm/msm/qcom,tlmm-vm-test.yaml#

title: Qualcomm Technologies, Inc. TLMM VM test driver binding

description: |+
  The driver can be used to test memory lending to VM.

properties:
  compatible:
    const: qcom,tlmm-vm-test

  reg:
    items:
      - description: Base address of register space to be lent
      - description: Size of the register space

example:
  - |
    tlmm-vm-mem-test {
       compatible = "qcom,tlmm-vm-test";
       tlmm-vm-io-bases = <0xf140000 0xf141000>;
       tlmm-vm-io-sizes = <0x1000 0x1000>;
    };
```

## Documentation/devicetree/bindings/sound/cs35l36.txt
```
CS35L36 Speaker Amplifier

Required properties:

  - compatible : "cirrus,cs35l36"

  - reg : the I2C address of the device for I2C

  - VA-supply, VP-supply : power supplies for the device,
    as covered in
    Documentation/devicetree/bindings/regulator/regulator.txt.

Optional properties:
  - cirrus,sclk-force-output : Audio serial port SCLK force
  output control. Forces the SCLK to continue to drive even
  if no ASP_TXn channels are enabled.

  - cirrus,lrclk-force-output : Audio serial port LRCLK force
  output control. Forces the LRCLK to continue to drive even
  if no ASP_TXn channels are enabled.

  - cirrus,right-channel-amp : Boolean to determine which channel
  the amplifier is to receive the audio data on. If present the
  amplifier receives data on the right channel of I2S data.
  If not present the amplifier receives data on the left
  channel of I2S data

  - cirrus,boost-ctl-millivolt : Boost Voltage Value.  Configures the boost
  converter's output voltage in mV. The range is from 2550mV to 10000mV with
  increments of 50mV.
  (Default) VP

  - cirrus,boost-peak-milliamp : Boost-converter peak current limit in mA.
  Configures the peak current by monitoring the current through the boost FET.
  Range starts at 1600mA and goes to a maximum of 4500mA with increments of
  50mA.
  (Default) 4.50 Amps

  - cirrus,amp-gain-zc : Boolean to determine if to use Amplifier gain-change
  zero-cross

  - cirrus,ldm-mode-select : Amplifier level-dependent muting enable mode selection.
  Configures whether the amplifier level-dependent muting is enabled for the various
  blocks when the selected audio source has been below the AMP_LDM_THLD for a period
  of time configured by AMP_LDM_DELAY. Any and all bits can be set.

  00000 - All level-dependent muting functionality disabled (Default)
  xxxx1 - Amplifier level-dependent muting detection enabled (OUT+/-; switching)
  xxx1x - Boost converter DCM detection enabled
  xx1xx - VMON low power mode detection enabled
  x1xxx - IMON low power mode detection enabled
  1xxxx - VP brownout prevention detection enabled

  - cirrus,pdm-ldm-exit : Boolean : Amplifier PDM mode digital volume ramp enable.
  When AMP_PDM_MODE = 1 controls whether the digital volume soft ramp is enabled
  or disabled when exiting a level-dependent muted condition. The AMP_RAMP_PDM_DN
  control is used to control desired ramp rate.

  - cirrus,pdm-ldm-enter : Boolean: Amplifier PDM mode digital volume ramp enable.
  When AMP_PDM_MODE = 1 controls whether the digital volume soft ramp is enabled
  or disabled when entering a level-dependent muted condition. The AMP_RAMP_PDM_UP
  control is used to control desired ramp rate.

  - cirrus,pdm-channel-select : PDM Channel select.
  0x00 (Default) : Selects Channel A data when the PDM audio input is selected.
  0x01 : Selects Channel B data when the PDM audio input is selected

  - cirrus,weak-fet-disable : Boolean : The strength of the output drivers is
  reduced when operating in a Weak-FET Drive Mode and must not be used to drive
  a large load.

  - cirrus,classh-wk-fet-delay :  Weak-FET entry delay. Controls the delay
  (in ms) before the Class H algorithm switches to the weak-FET voltage
  (after the audio falls and remains below the value specified in WKFET_AMP_THLD).

  0 = 0ms
  1 = 5ms
  2 = 10ms
  3 = 50ms
  4 = 100ms (Default)
  5 = 200ms
  6 = 500ms
  7 = 1000ms

  - cirrus,classh-weak-fet-thld-millivolt : Weak-FET amplifier drive threshold.
  Configures the signal threshold at which the PWM output stage enters
  weak-FET operation. The range is 50mV to 700mV in 50mV increments.

  - cirrus,temp-warn-threshold :  Amplifier overtemperature warning threshold.
  Configures the threshold at which the overtemperature warning condition occurs.
  When the threshold is met, the overtemperature warning attenuation is applied
  and the TEMP_WARN_EINT interrupt status bit is set.
  If TEMP_WARN_MASK = 0, INTb is asserted.

  0 = 105C
  1 = 115C
  2 = 125C (Default)
  3 = 135C

Example:

cs35l36: cs35l36@58 {
	compatible = "cirrus,cs35l36";
	reg = <0x58>;
	VA-supply = <&dummy_vreg>;
	VP-supply = <&dummy_vreg>;
	reset-gpios = <&axi_gpio 54 0>;

	cirrus,boost-ctl-millivolt = <10000>;
};
```

## Documentation/devicetree/bindings/sound/fsa8500.txt
```
Fairchild FSA8500 is a full-featured audio jack detection solution
that detects an accessory plug into the audio jack and distinguishes
between 3-pole headphone, 4-pole headset or UART. For a 4-pole headset,
it automaticaly detects CTIA vs. OMTP standard.

Required properties:

-compatible		: should be "fairchild,fsa8500".
-reg			: i2c address to be used.
-gpios			: Interrupt GPIO
-hs_det_vdd-supply	: regulator to power the chip.
-hs_det_micvdd-supply	: regulator to power the mic bias.
-fsa8500-init-regs	: initial registers settings

Optional properties:

-fsa8500-always-on-micbias: Keep bias always on.


Example:

&i2c_8 {
	fsa8500@23 {
		compatible = "fairchild,fsa8500";
		reg = <0x23>;
		gpios = <&msmgpio 9 0x0>;
		hs_det_vdd-supply = <&pma8084_lvs2>;
		hs_det_micvdd-supply = <&pma8084_l18>;
		fsa8500-init-regs = <0x0C 0xA1>,
				    <0x0F 0xF9>;
	};
};
```

## Documentation/devicetree/bindings/sound/msm-cirrus-playback.txt
```
Cirrus Logic MSM Framework Driver

Required properties:

  - compatible : "cirrus,msm-cirrus-playback"

  - usecase-names : List of strings representing the various usecases
  available on a given platform (max of 4).

  - usecase-indexes : List of usecases index representing the above

  - ff-port-id : Port index of feedforward speaker enhancement module

Example:

msm-cirrus-playback {
	compatible = "cirrus,msm-cirrus-playback";
	usecase-names = "Playback", "Voice", "Headset", "Handsfree";
	usecase-indexes = <0 1 2 3>;
	ff-port-id = "16384";
};
```
