## Documentation/devicetree/bindings/power/supply/qcom,battery-charger.txt
```
QTI battery charger binding

This binding describes the Qualcomm Technologies, Inc. battery charger device.
QTI battery charger gets and sets power supply properties by communicating with
charger firmware running on the remote subsystem (e.g. DSP) over PMIC Glink.

Refer to Documentation/devicetree/bindings/soc/qcom/qcom,pmic-glink.txt for
information on "qcom,pmic_glink" device which is used in the example below.

- compatible:
	Usage: required
	Value type: <stringlist>
	Definition: must be "qcom,battery-charger"

- qcom,thermal-mitigation:
	Usage: optional
	Value type: <prop-encoded-array>
	Definition: Array of fast charge current limit values for different
		    system thermal mitigation levels. This should be a flat
		    array that denotes the maximum charging current (in uA) for
		    each thermal level. Elements should be defined in such a
		    way that the next element is always less than or equal to
		    the current element (descending order).

- qcom,thermal-mitigation-step:
	Usage: optional
	Value type: <u32>
	Definition: Fast charging current step (in uA) which if specified
		    would be used to calculate different system thermal mitigation
		    levels based on the maximum charging current provided by the
		    charger firmware. This property can be specified only if
		    "qcom,thermal-mitigation" property is not specified.
		    Minimum step value is 500000(500 mA).

- qcom,wireless-fw-name:
	Usage: optional
	Value type: <string>
	Definition: Firmware name that needs to be used for updating wireless
		    charger firmware.

- qcom,shutdown-voltage:
	Usage: optional
	Value type: <u32>
	Definition: Battery voltage (in mV) when shutdown needs to be initiated
		    when battery SOC reaches 0 and device is not charging.

- qcom,display-panels:
	Usage: optional
	Value type: <prop-encoded-array>
	Definition: Array of one or more phandles of the display panel(s) that
			sends the DRM blank/unblank notifications.

= EXAMPLE

&soc {
	qcom,pmic_glink {
		...
		qcom,battery_charger {
			compatible = "qcom,battery-charger";
			qcom,thermal-mitigation =
					<3000000 1500000 1000000 500000>;
			qcom,wireless-fw-name = "idt9412.bin";
			qcom,shutdown-voltage = <3100>;
		};
		...
	};
};
```

## Documentation/devicetree/bindings/power_supply/fan54100_charger.txt
```
fan54100_charger
~~~~~~~~~~~~~~~~

Required properties :
 - compatible : "fairchild,fan54100"

Optional properties :
 - fairchild,sotp-limit-c: Slow Temperature Limit in Celsius

 - fairchild,fovp-limit-mv: Fast Overvoltage Limit in millivolts

 - fairchild,ocp-limit-ma: Fast Overcurrent Limit in milliamps


Example:

	fan54100: fan54100-charger@30 {
		compatible = "fairchild,fan54100";
		reg = <0x30>;

		interrupt-parent = <&spmi_bus>;
		interrupts = <2 0xc6 6>;
		gpios = <&pmi8994_gpios 7 0x11>; /* GPIOF_DIR_IN|GPIOF_EXPORT */
		gpio-names = "fan-int-n";
		supply-names = "battery";

		fairchild,sotp-limit-c = <150>;
		fairchild,fovp-limit-mv = <4700>;
		fairchild,ocp-limit-ma = <6200>;
	};
```

## Documentation/devicetree/bindings/ptp/qcom,ptp-tsc.txt
```
* Qualcomm Technologies, Inc. Timestamp Counter(TSC) based PTP clock

TSC module is a timestamp generator, which runs a 64 bit counter for
system timekeeping.
ETU is event timestamp module, which captures the timestamp from TSC
and global counter bus for a given event. The event is selected from
a set of GPIOs and SW triggered events. The design is parameterized
to detect multiple events, using different “slices”.
One slice is used for every event.

Required properties:
- compatible: should contain the compatibility string.
                 "qcom,tsc"
- reg: address and length of the TSC registers.
	Address and length of the ETU registers(optional).
- reg-names: must contain "tsc", "etu" (optional).
- clocks: list of clock phandles required to access TSC/ETU.
- clock-names: list of clock names for the above clock phandles.
- assigned-clocks: clock phandles to assign clock rates.
- assigned-clock-rates: clock rates in HZ.

Optional properties:
- qcom,tsc-nsec-update: boolean property to indicate the TSC counters
			have values in nanoseconds, rather than in secs
			and nanoseconds.
- qcom,etu-event-sel: array of ETU slice numbers.
- qcom,etu-event-names: ETU slice names for the corresponding
			event slice numbers.
- interrupts: interrupt numbers associated with the ETU slice.
- interrupt-names: names corresponding to the above interrupt numbers.
- pinctrl-<#> : pinctrl configurations
- pinctrl-names: pinctrl names

Example:

        tsc@1da0000 {
                compatible = "qcom,tsc";
                reg = <0x1da0000 0x2000>, <0x01db0000 0x10000>;
                reg-names = "tsc", "etu";

                clocks = <&gcc GCC_TSC_CFG_AHB_CLK>, <&gcc GCC_TSC_CNTR_CLK >,
                       <&gcc GCC_TSC_ETU_CLK>;
                clock-names = "cfg_ahb", "cntr", "etu";
                assigned-clocks = <&gcc GCC_TSC_CNTR_CLK>, <&gcc GCC_TSC_ETU_CLK>;
                assigned-clock-rates = <500000000> , <500000000>;

		qcom,etu-event-sel = <1 3>;
		qcom,etu-event-names = "gps_pps", "tod_pps";

	        interrupts = <GIC_SPI 331 IRQ_TYPE_EDGE_RISING>,
                             <GIC_SPI 329 IRQ_TYPE_EDGE_RISING>;
                interrupt-names = "tod_pps", "gps_pps";

		pinctrl-names = "default";
		pinctrl-0 = <&etu_tod_pps_active>, <&etu_gps_pps_active>;
        };
```

## Documentation/devicetree/bindings/regulator/gdsc-regulator.txt
```
QTI Global Distributed Switch Controller (GDSC) Regulator Driver

The GDSC driver, implemented under the regulator framework, is responsible for
safely collapsing and restoring power to peripheral and multimedia cores on
chipsets like SDM845 for power savings.

Required properties:
 - compatible:      Must be "qcom,gdsc"
 - regulator-name:  A string used as a descriptive name for regulator outputs
 - reg:             The address of the GDSCR register

Optional properties:
 - parent-supply:   phandle to the parent supply/regulator node
 - clock-names:     List of string names for core clocks
 - qcom,retain-regs: Presence denotes a hardware requirement to enable the
		     usage of retention registers which maintain their state
		     after the GDSC is disabled and re-enabled.
 - qcom,skip-logic-collapse: Presence denotes a requirement to leave power to
                             the core's logic enabled.
 - qcom,support-hw-trigger: Presence denotes a hardware feature to switch
			    on/off this regulator based on internal HW signals
			    to save more power.
 - qcom,enable-root-clk: Presence denotes that the clocks in the "clocks"
			property are required to be enabled before gdsc is
			turned on and disabled before turning off gdsc. This
			will be used in subsystems where reset is synchronous
			and root clk is active without sw being aware of its
			state. The clock-name which denotes the root clock
			should be named as "core_root_clk".
 - qcom,force-enable-root-clk: If set, denotes that the root clock should be
			force enabled before turning on the GDSC and then be
			immediately force disabled. Likewise for GDSC disable.
			This is used in cases where the core root clock needs
			to be force-enabled prior to turning on the core. The
			clock-name which denotes the root clock should be
			"core_root_clk".
 - qcom,clk-dis-wait-val: Input value for CLK_DIS_WAIT controls state transition
			 delay after halting clock in the collapsible core.
 - reg-names:		Names of the bases for the above "reg" registers.
			Ex. "base", "domain-addr", "sw-reset", "hw-ctrl-addr".
 - qcom,no-status-check-on-disable: Do not poll the status bit when GDSC
			is disabled.
 - qcom,gds-timeout:	Maximum time (in usecs) that might be taken by a GDSC
			to enable.
 - qcom,reset-aon-logic: If present, the GPU DEMET cells need to be reset while
			 enabling the GX GDSC.
 - vdd_parent-supply:	phandle to the regulator that this GDSC gates. If
			present, need to vote for a minimum operational voltage
			(LOW_SVS) on the GDSC parent regulator prior to
			configuring it. The vote is removed once the GDSC FSM
			has latched on to the new state.
 - resets: reset specifier pair consisting of phandle for the reset controller
			and reset lines used by this controller. These can be
			supplied only if we support qcom,skip-logic-collapse.
 - reset-names: reset signal name strings sorted in the same order as the resets
			property. These can be supplied only if we support
			qcom,skip-logic-collapse.
 - qcom,skip-disable-before-sw-enable : Presence denotes a hardware requirement
					to leave the GDSC on that has been
					enabled by an entity external to HLOS.
 - qcom,no-config-gdscr: Presence denotes HW only supports a single register
			per GDSC.
 - qcom,collapse-vote: If present, GDSC will be controlled by votable register.
			We need to pass the phandle of the register along with
			the bit number of respective GDSC.
 - sw-reset: If present, supports asynchronous resets for GDSC. We need to pass
			the phandles of reset registers while using the property.
 - domain-addr: If present, supports reset for voltage rail of GDSC. We pass
			the phandle of the register while using the property.
 - hw-ctrl-addr: If present, separate register will be there to poll for GDSC
			status. While using the property, need to pass the phandle
			of the register.
 - qcom,skip-disable: Boolean flag indicating that the gdsc must not be
			physically disabled upon a software disable request.
			Instead, the GDSC will be disabled by always-on
			processor (AOP) upon entering system sleep. The AOP
			will also perform a special reset sequence for the GDSC
			upon resuming the system sleep.
 - qcom,support-cfg-gdscr: If present, the GDSC power on/down polling status is
			read through GDSC configuration register.
 - mboxes: Mailbox tuple containing QMP mailbox phandle and channel identifier.
			If this is specified, then a QMP message should be sent
			to enable the GDSC instead of setting SW_COLLAPSE=0.

Example:
	gdsc_oxili_gx: qcom,gdsc@fd8c4024 {
		compatible = "qcom,gdsc";
		regulator-name = "gdsc_oxili_gx";
		parent-supply = <&pm8841_s4>;
		reg = <0xfd8c4024 0x4>;
		clock-names = "core_clk";
		mboxes = <&qmp_aop 0>;
		qcom,collapse-vote = <&gcc_apcs_gdsc_vote_ctrl 0>;
	};
```

## Documentation/devicetree/bindings/regulator/lm3631-regulator.txt
```
TI LMU LM3631 regulator device tree bindings

Required properties:
  - compatible: "ti,lm3631-regulator"

Optional properties:
  - regulator-name
  - regulator-min-microvolt
  - regulator-max-microvolt
  - regulator-always-on
  - regulator-boot-on

  For those properties, please refer to:
  Documentation/devicetree/bindings/regulator/regulator.txt

Example:

lm3631@29 {
	compatible = "ti,lm3631";
	reg = <0x29>;

	ti,enable-gpio = <&gpio5 6 GPIO_ACTIVE_HIGH>;

	/* Only VPOS and VNEG are used with LCD boost */
	regulators {
		compatible = "ti,lm3631-regulator";

		vboost {
			regulator-name = "lcd_boost";
			regulator-min-microvolt = <4500000>;
			regulator-max-microvolt = <6350000>;
			regulator-always-on;
		};

		vpos {
			regulator-name = "lcd_vpos";
			regulator-min-microvolt = <4000000>;
			regulator-max-microvolt = <6000000>;
			regulator-boot-on;
		};

		vneg {
			regulator-name = "lcd_vneg";
			regulator-min-microvolt = <4000000>;
			regulator-max-microvolt = <6000000>;
			regulator-boot-on;
		};
	};
};
```

## Documentation/devicetree/bindings/regulator/madera-ldo1.txt
```
Cirrus Logic Madera class audio codecs LDO1 regulator driver

Only required if you are using the codec internal LDO1 regulator.

See also the core bindings for the parent MFD driver:
See Documentation/devicetree/bindinge/mfd/madera.txt

Required properties:
  - LDOVDD-supply : Power supply for the LDO1 regulator.

  - cirrus,ldoena-gpios : One entry specifying the GPIO controlling LDOENA.
    As defined in bindings/gpio.txt.

Optional subnodes:
  - ldo1 : Initial data for the LDO1 regulator, as described in
    bindings/regulator/regulator.txt

Example:

codec: cs47l85@0 {
	compatible = "cirrus,cs47l85";

	LDOVDD-supply = <&pmic_vdd1>;
	cirrus,ldoena-gpios = <&gpio 0>;
};
```

## Documentation/devicetree/bindings/regulator/madera-micsupp.txt
```
Cirrus Logic Madera class audio codecs mic supply regulator driver

Only required if the codec has an internal mic supply regulator.

See also the core bindings for the parent MFD driver:
See Documentation/devicetree/bindinge/mfd/madera.txt

Optional subnodes:

  - micvdd : Initial data for the MICVDD regulator, as covered in
    Documentation/devicetree/bindings/regulator/regulator.txt

Example:

codec: cs47l85@0 {
	compatible = "cirrus,cs47l85";

	micvdd {
		regulator-min-microvolt = <900000>;
		regulator-max-microvolt = <3300000>;
		regulator-allow-bypass = <1>;
	};
};
```

## Documentation/devicetree/bindings/regulator/ote2005b-regulator.txt
```
MOT Silego + OTE2005B Fixed Voltage Regulators

Required properties:
  - compatible:		Must be "mot,regulator-ote2005b"
  - parent-supply:	Specify a phandle to a parent supply regulator
  - mot,ctrl-gpios:	Specify GPIOs for charge pumping mode control
  - mot,gpio-state-off: Byte array to indicate the GPIOs value for OFF mode
  - mot,gpio-state-on:  Byte array to indicate the GPIOs value for ON mode
  - mot,gpio-state-idle: Byte array to indicate the GPIOs value for IDLE mode

Example:

	ote2005b {
		compatible = "mot,regulator-ote2005b";
		regulator-name = "avdd_avee_5.4v";
		parent-supply = <&pm8226_l14>;
		regulator-min-microvolt = <5400000>;
		regulator-max-microvolt = <5400000>;
		mot,ctrl-gpios = <&msmgpio 33 0x0>,
				 <&msmgpio 25 0x0>;
		mot,gpio-state-off = [00 00];
		mot,gpio-state-on  = [01 01];
		mot,gpio-state-idle= [01 00];
	};
```

## Documentation/devicetree/bindings/regulator/qcom,ocp-notifier.yaml
```yaml
# SPDX-License-Identifier: (GPL-2.0-only OR BSD-2-Clause)
%YAML 1.2
---
$id: "http://devicetree.org/schemas/regulator/qcom,ocp-notifier.yaml#"
$schema: "http://devicetree.org/meta-schemas/core.yaml#"

title: Qualcomm Technologies, Inc. Regulator Over-Current Notifier binding

maintainers:
  - David Collins <collinsd@quicinc.com>

description: |
  This device provides support for logging and notifying consumers about
  regulator over-current (OCP) events on certain Qualcomm Technologies,
  Inc. PMIC devices.  This is useful for debugging as well as for providing a
  more graceful recovery mechanism than resetting the entire system.

properties:
  compatible:
    const: qcom,regulator-ocp-notifier

  interrupts:
    description: PMIC regulator OCP notification summary interrupt.
    maxItems: 1

  nvmem-cells:
    description: |
      phandle of the nvmem cell for the PMIC register region which stores the
      PMIC OCP log.
    maxItems: 1

  nvmem-cell-names:
    const: ocp_log

patternProperties:
  "^periph-[0-9a-f]{3}-supply$":
    description: |
      phandle for regulator device corresponding to the PMIC peripheral with
      PPID equal to the hex value listed in the supply property name.

required:
  - compatible
  - interrupts
  - nvmem-cells
  - nvmem-cell-names

additionalProperties: false

examples:
  - |
    #include <dt-bindings/interrupt-controller/irq.h>

    regulator-ocp-notifier {
        compatible = "qcom,regulator-ocp-notifier";
        interrupt-parent = <&spmi_bus>;
        interrupts = <0x0 0x71 0x1 IRQ_TYPE_EDGE_RISING>;
        nvmem-cells = <&ocp_log>;
        nvmem-cell-names = "ocp_log";

        periph-1c1-supply = <&L1B>;
        periph-1c2-supply = <&L2B>;
        periph-1c5-supply = <&L5B>;
    };
```
