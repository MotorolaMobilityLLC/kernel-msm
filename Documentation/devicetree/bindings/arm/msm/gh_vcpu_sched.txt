## Documentation/devicetree/bindings/bluetooth/nitrous.txt
```
* Nitrous Bluetooth Power Management Driver

The Nitrous BT power management is designed to handle the power management
between a host processor and a BT controller.  In its current form, the
driver is specific to the power management between a MSM processor and a
Broadcom BT controller over UART communication.

The driver handles the following key power management elements:
-rfkill.
-host-wake-gpio/dev-wake-gpio sleep protocol.
-serial driver power management.

On Tx, the driver registers and receives a callback from the serial core to
toggle the dev-wake-gpio and utilizes the PM Runtime framework to wake up
the serial driver for transmission.

On Rx, the driver listens to the host-wake GPIO and wakes up the serial driver
to receive incoming data.  The host-wake GPIO is also capable of waking up
the host processor from suspend.

Required Properties:
  - compatible: "goog,nitrous"
  - uart-port = UART port number for serial communication.
  - power-gpio = GPIO number for controller power.
  - host-wake-gpio: GPIO number for host wake signal (controller to host).
  - host-wake-polarity: Polarity for host wake GPIO
                        (0: active low; 1: active high).
  - dev-wake-gpio: GPIO number for controller wake signal (host to controller).
  - dev-wake-polarity: Polarity for dev wake GPIO
                       (0: active low; 1: active high).

Optional Properties:
  None

Example:
	bt_nitrous {
		compatible = "goog,nitrous";
		uart-port = <6>;
		power-gpio = <&msmgpio 10 0>;
		host-wake-gpio = <&msmgpio 20 0>;
		host-wake-polarity = <0>;
		dev-wake-gpio = <&msmgpio 30 0>;
		dev-wake-polarity = <0>;
	};
```

## Documentation/devicetree/bindings/clock/qcom,camcc.txt
```
Qualcomm Technologies, Inc. Camera Clock & Reset Controller Binding
------------------------------------------------

Required properties :
- compatible : shall contain
		"qcom,sdm845-camcc"
		"qcom,lahaina-camcc"
		"qcom,lahaina-camcc-v2"
		"qcom,shima-camcc"
		"qcom,waipio-camcc"
		"qcom,waipio-camcc-v2"
		"qcom,diwali-camcc"
		"qcom,kalama-camcc"
		"qcom,kalama-camcc-v2"
		"qcom,sm8150-camcc"
		"qcom,sm8150-camcc-v2"
		"qcom,sa8155-camcc"
		"qcom,sa8155-camcc-v2"
		"qcom,sc8180x-camcc"
		"qcom,lemans-camcc"

- reg : shall contain base register location and length.
- #clock-cells : from common clock binding, shall contain 1.
- #reset-cells : from common reset binding, shall contain 1.
- #power-domain-cells : from generic power domain binding, shall contain 1.

Example:
	camcc: clock-controller@ad00000 {
		compatible = "qcom,sdm845-camcc";
		reg = <0xad00000 0x10000>;
		#clock-cells = <1>;
		#reset-cells = <1>;
		#power-domain-cells = <1>;
	};
```

## Documentation/devicetree/bindings/clock/qcom,ecpricc.txt
```
Qualcomm Technologies, Inc. ECPRI Clock Controller Binding
--------------------------------------------------------------------

Required properties :
- compatible : shall contain "qcom,cinder-ecpricc"

- reg: shall contain base register offset and size.
- reg-names: names of registers listed in the same order as in the reg property.
		Must contain "cc_base".
- vdd_cx-supply: The vdd_cx logic rail supply.
- #clock-cells : from common clock binding, shall contain 1
- #reset-cells : from common reset binding, shall contain 1

Optional properties :
- #power-domain-cells : from generic power domain binding, shall contain 1
- clocks : shall contain the XO clock
	   shall contain the gpll0/2/4/5 out main clock
- clock-names : shall be "xo"
		shall be "gpll0/2/4/5"

Example:
1.
	ecpricc: clock-controller@280000 {
		compatible = "qcom,cinder-ecpricc";
		reg = <0x280000 0x40000>;
		vdd_cx-supply = <VDD_CX_SUPPLY>;
		#clock-cells = <1>;
		#reset-cells = <1>;
		#power-domain-cells = <1>;
		clocks = <&rpmhcc RPMH_CXO_CLK>, <&gcc GCC_PLL0>,
			 <&gcc GCC_PLL2>, <&gcc GCC_PLL4>, <&gcc GCC_PLL5>;
		clock-names = "xo", "gpll0", "gpll2", "gpll4", "gpll5";
	};
```

## Documentation/devicetree/bindings/clock/qcom,videocc.txt
```
Qualcomm Technologies, Inc. Video Clock & Reset Controller Binding
-----------------------------------------------

Required properties :
- compatible : shall contain only one of the following:

			"qcom,sdm845-videocc"
			"qcom,lahaina-videocc"
			"qcom,shima-videocc"
			"qcom,waipio-videocc"
			"qcom,diwali-videocc"
			"qcom,kalama-videocc"
			"qcom,kalama-videocc-v2"
			"qcom,sm8150-videocc"
			"qcom,sm8150-videocc-v2"
			"qcom,sa8155-videocc"
			"qcom,sa8155-videocc-v2"
			"qcom,lemans-videocc"

- reg : shall contain base register location and length
- #clock-cells : from common clock binding, shall contain 1.
- #power-domain-cells : from generic power domain binding, shall contain 1.
- #reset-cells : from common reset binding, shall contain 1.

Example:
	videocc: clock-controller@ab00000 {
		compatible = "qcom,sdm845-videocc";
		reg = <0xab00000 0x10000>;
		#clock-cells = <1>;
		#power-domain-cells = <1>;
		#reset-cells = <1>;
	};
```

## Documentation/devicetree/bindings/cnss/cnss-sdio-wlan.txt
```
* Qualcomm Technologies Inc Connectivity SubSystem Platform Driver

This platform driver adds support for the CNSS subsystem used for SDIO
based Wi-Fi devices. It also adds support to manage two 1.8V voltage
regulators and WLAN power enable 3.3V regulators. The main purpose of this
device tree entry below is to invoke the CNSS SDIO platform driver
and provide handle to the WLAN power enable 3.3V pmic GPIO and two 1.8V
PMIC voltage regulator resources.

Required properties:
  - compatible: "qcom,cnss_sdio"
  - reg: memory resource to save firmware dump, optional.
  - reg-names: memory resource name.
  - subsys-name: cnss sdio subsytem device name, required.
  - vdd-wlan-supply: phandle to the WLAN vdd regulator device tree node.
  - vdd-wlan-dsrc-supply: phandle to the WLAN dsrc vdd regulator device tree node.
  - vdd-wlan-io-supply: phandle to the WLAN IO regulator device tree node.
  - vdd-wlan-xtal-supply: phandle to the WLAM XTAL regulator device tree node.
  - qcom,wlan-ramdump-dynamic: To enable CNSS RAMDUMP collection
    by providing the size of CNSS DUMP

Example:
	qcom,cnss-sdio {
		compatible = "qcom,cnss_sdio";
                reg = <0x87a00000, 0x200000>;
                reg-names = "ramdump";
                subsys-name = "AR6320";
		vdd-wlan-supply = <&rome_vreg>;
		vdd-wlan-io-supply = <&pm8950_l5>;
		qcom,wlan-ramdump-dynamic = <0x200000>;
	};
```

## Documentation/devicetree/bindings/dtv/dtv-fci.txt
```
Future Communication Mobile Digital TV FC8180 device driver

The FC8180 is connected to host processor via SPI.

Required properties:
- compatible: Should be "fci,isdbt"
- reg:  Spi slave address, give it 0.
- irq-gpio :  GPIO used for interrupt.
- enable-gpio: GPIO used for power enabling device.
- enable-active-high: Polarity of GPIO is active high (default is low).
- pinctrl-names,pinctrl-0: the pincontrol setting to configure muxing properly
			for pins that connect to FC8180.

Optional properties:
- qcom,bbm-xtal-freq: the clock speed of external XTAL or PMIC clock in khz.
			If not set default is 37400 khz. be sure to set it correctly if the
			clock speed is not equal to the default value.
- isdbt_vdd-supply: power supply needed to power device.
			be sure to set it if the power supply is not turned on by default.
- qcom,vdd-min-max-voltage:  minimum and maximum voltage in uv for vdd-supply.
			If not set , driver won't change the voltage of vdd-supply and
			the default voltage of vdd-supply is set by pmic driver.
- isdbt_ant-supply:  power supply needed to power the antenna of device.
- qcom,ant-min-max-voltage:   minimum and maximum voltage in uv for ant-supply.
			If not set, driver won't change the voltage of ant-supply and
			the default voltage of ant-supply is set by pmic driver.
- anten-gpio: GPIO used for switching on the antenna.
- clocks: phandles to the pmic clock source.
- clock-names: name of the pmic clock.
- qcom,using-pmic: with pmic clock sources( BBCLK2) this must be set to 1 and
			require clocks, clock-names entries to work propperly.  If external
			XTAL clock is used, this entry is not needed or set it to 0.
- spi-max-frequency : maximum SPI clocking speed of device in Hz, it should be
			equal to or less than qcom,bbm-xtal-freq.

Example:

&spi_5 {
	status = "/chosen", "mmi,dtv", "true";
	fci_dtv: fc8180@0 {
		status = "/chosen", "mmi,dtv", "true";
		compatible = "fci,isdbt";
		reg = <0>;
		spi-max-frequency = <19200000>;
		irq-gpio = <&msm_gpio 52 0>;
		anten-gpio = <&msm_gpio 50 0>;
		enable-gpio = <&msm_gpio 51 0>;
		enable-active-high;
		pinctrl-names = "default";
		pinctrl-0 = <&dtv_output_default &dtv_input_default>;
		clocks = <&clock_rpm clk_bb_clk2>;
		clock-names = "dtv_refclk";
		isdbt_vdd-supply = <&pm8916_l6>;
		isdbt_ant-supply = <&pm8916_l17>;
		qcom,vdd-min-max-voltage = <1800000 1800000>;
		qcom,ant-min-max-voltage = <2850000 2850000>;
		qcom,bbm-xtal-freq = <19200>;
		qcom,using-pmic = <1>;
	};
};
```

## Documentation/devicetree/bindings/gpio/gpio-madera.txt
```
Cirrus Logic Madera class audio codecs gpio driver

See also the core bindings for the parent MFD driver:
See Documentation/devicetree/bindinge/mfd/madera.txt

Required properties:

  - gpio-controller : Indicates this device is a GPIO controller.
  - #gpio-cells : Must be 2. The first cell is the pin number. The second cell
    is reserved for future use and must be zero

Example:

codec: cs47l85@0 {
	compatible = "cirrus,cs47l85";

	gpio-controller;
	#gpio-cells = <2>;
};
```

## Documentation/devicetree/bindings/gpio/gpio-pm8xxx-gpio.txt
```
PM8xxx GPIO Controllers by Qualcomm, Inc.

This is for the QC PM8xxx GPIO controller found on various Qualcomm
PowerICs such as: pm8921, pm8038, etc.

Required properties:
- compatible : "qcom,msm-pm8xxx-gpios"
- #gpio-cells : Should be two.  The first cell is the pin number and the
  second cell is used to specific optional parameters (unused).
- gpio-controller : Marks the port as a GPIO controller.

Optional children nodes:
- mux : defines pin mux control for the GPIO controller, and has following
  required and optional properties.

  Required properties:
  - qcom,pm8xxx-gpio-pin : the gpio pin number, must match the range of valid
    pin numbers for the specific chip (ex: 1-44 for 8921, 1-12 on 8038, etc)

  Optional properties (will default to value of '0' if not specified):
  - qcom,pm8xxx-gpio-func : choose alternate function for the gpio:
           PM_GPIO_FUNC_NORMAL             0
           PM_GPIO_FUNC_PAIRED             1
           PM_GPIO_FUNC_1                  2
           PM_GPIO_FUNC_2                  3
           PM_GPIO_DTEST1                  4
           PM_GPIO_DTEST2                  5
           PM_GPIO_DTEST3                  6
           PM_GPIO_DTEST4                  7

  - qcom,pm8xxx-gpio-direction : indicates whether gpio should be input, output
    or both:
           PM_GPIO_DIR_NONE                0
           PM_GPIO_DIR_OUT                 1
           PM_GPIO_DIR_IN                  2
           PM_GPIO_DIR_BOTH                3

  - qcom,pm8xxx-gpio-out-buffer : inidcates gpio should be configured as CMOS
    or open drain:
           PM_GPIO_OUT_BUF_CMOS            0
           PM_GPIO_OUT_BUF_OPEN_DRAIN      1

  - qcom,pm8xxx-gpio-out-value : the output value of the gpio line, 0 or 1
  - qcom,pm8xxx-gpio-pull : indicates whether a pull up or pull down should be
    applied:
           PM_GPIO_PULL_UP_30              0
           PM_GPIO_PULL_UP_1P5             1
           PM_GPIO_PULL_UP_31P5            2
           PM_GPIO_PULL_UP_1P5_30          3
           PM_GPIO_PULL_DN                 4
           PM_GPIO_PULL_NO                 5

  - qcom,pm8xxx-gpio-vin-sel : specifies the voltage level when the output is
    set to 1, or if an input, the votlage level at which the input is
    interpreted as a logical 1:
           PM_GPIO_VIN_VPH                 0
           PM_GPIO_VIN_BB                  1
           PM_GPIO_VIN_S4                  2
           PM_GPIO_VIN_L15                 3
           PM_GPIO_VIN_L4                  4
           PM_GPIO_VIN_L3                  5
           PM_GPIO_VIN_L17                 6

  - qcom,pm8xxx-gpio-out-strength : the amount of current supplied for an
    output gpio:
           PM_GPIO_STRENGTH_NO             0
           PM_GPIO_STRENGTH_HIGH           1
           PM_GPIO_STRENGTH_MED            2
           PM_GPIO_STRENGTH_LOW            3

  - qcom,pm8xxx-gpio-inv-int-pol : speicifes whether to invert the polarity
    before feeding the line to the interrupt module in pmic, 0 or 1.
  - qcom,pm8xxx-gpio-disable-pin : disable the gpio by configuring it as high
    impedance, 0 or 1.

Example of gpio-controller nodes for PM8921:

	qcom,msm-pm8921-gpios {
		compatible = "qcom,msm-pm8xxx-gpios";
		gpio-controller;
		#gpio-cells = <2>;
	};

Example using the option "mux" child node:

	pm8921_gpio: qcom,msm-pm8921-gpios {
		mux {
			gpioi@12 {
				qcom,pm8xxx-gpio-pin = <12>;

				qcom,pm8xxx-gpio-func = <0>;      /* Normal  */
				qcom,pm8xxx-gpio-direction = <2>; /* Input   */
				qcom,pm8xxx-gpio-pull = <4>;      /* Down    */
				qcom,pm8xxx-gpio-vin-sel = <4>;   /* S4      */
			};
	};
```
