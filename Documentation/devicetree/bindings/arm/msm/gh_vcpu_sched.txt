## Documentation/devicetree/bindings/arm/msm/gh_vcpu_sched.txt
```
Qualcomm Technologies, Inc. VCPU Scheduling for Secondary VMs

Required properties:
- compatible: should be "qcom,gh_vcpu_sched"

Example:
	gh_vcpu_sched {
		compatible = "qcom,gh_vcpu_sched";
	};
```

## Documentation/devicetree/bindings/arm/msm/msm.txt
```
* Qualcomm Technologies, Inc. MSM

MSM uses a combination of DTS and DTSI files to describe the hardware on various
SoCs and boards. Typically, a SoC-specific DTSI file describes the devices
present on a given SoC, and a board-specific DTSI file describes the devices
external to the SoC, although some targets may follow a more simplified
approach. Additionally, the SoC-specific DTSI files may further consist of a
base chip-specific file and a version-specific DTSI file, to facilitate reuse
of device definitions among multiple revisions of the same SoC.

Required properties:
- compatible: Every device present on the MSM SoC shall have a 'qcom,' prefix
  in its compatible string

Example:
restart@fc4ab000 {
	compatible = "qcom,pshold";
	reg = <0xfc4ab000 0x4>;
};


* Compatible strings:

SoCs:

- APQ8016
  compatible = "qcom,apq8016"

- APQ8084
  compatible = "qcom,apq8084"

- APQ8096
  compatible = "qcom,apq8096"

- MSM8916
  compatible = "qcom,msm8916"

- MSM8960
  compatible = "qcom,msm8960"

- MSM8996
  compatible = "qcom,msm8996"

- SM8150
  compatible = "qcom,sm8150"

- KONA
  compatible = "qcom,kona"

- LAHAINA
  compatible = "qcom,lahaina"

- LAHAINAP
  compatible = "qcom,lahainap"

- SHIMA
  compatible = "qcom,shima"

- LITO
  compatible = "qcom,lito"

- BENGAL
  compatible = "qcom,bengal"

- KHAJE
  compatible = "qcom,khaje"

- KHAJEP
  compatible = "qcom,khajep"

- KHAJEQ
  compatible = "qcom,khajeq"

- KHAJEG
  compatible = "qcom,khajeg"

- SDMSHRIKE
  compatible = "qcom,sdmshrike"

- SM6150
  compatible = "qcom,sm6150"

- QCS405
  compatible = "qcom,qcs405"

- QCS403
  compatible = "qcom,qcs403"

- SDXPRAIRIE
  compatible = "qcom,sdxprairie"

- SDXLEMUR
  compatible = "qcom,sdxlemur"

- SDMMAGPIE
  compatible = "qcom,sdmmagpie"

- HOLI
  compatible = "qcom,holi"

- WAIPIO
  compatible = "qcom,waipio", "qcom,waipiop"

- KALAMA
  compatible = "qcom,kalama", "qcom,kalamap"

- KAKA
  compatible = "qcom,kaka"

- CINDER
  compatible = "qcom,cinder"

- DIWALI
  compatible = "qcom,diwali"

- SDXPINN
  compatible = "qcom,sdxpinn"

- SA410M
  compatible = "qcom,sa410m"

- LEMANS
  compatible = "qcom,lemans"

- MONACO
  compatible = "qcom,monaco", "qcom,monacop"

- SDXBAAGHA
  compatible = "qcom,sdxbaagha"

Generic board variants:

- CDP device:
  compatible = "qcom,cdp"

- IDP device:
  compatible = "qcom,idp"

- MTP device:
  compatible = "qcom,mtp"

- ATP device:
  compatible = "qcom,atp"

- FLUID device:
  compatible = "qcom,fluid"

- LIQUID device:
  compatible = "qcom,liquid"

- Dragonboard device:
  compatible = "qcom,dragonboard"

- SBC device:
  compatible = "qcom,sbc"

- SURF device:
  compatible = "qcom,surf"

- QRD device:
  compatible = "qcom,qrd"

- ADP device:
  compatible = "qcom,adp"

- Simulator device:
  compatible = "qcom,sim"

- RUMI device:
  compatible = "qcom,rumi"

- IOT device:
  compatible = "qcom,iot"

- HDK device:
  compatible = "qcom,hdk"

- HHG device:
  compatible = "qcom,hhg"

- RCM device:
  compatible = "qcom,rcm"

- X100 device:
  compatible = "qcom,x100"

- CCARD device:
  compatible = "qcom,ccard"

Boards (SoC type + board variant):

compatible = "qcom,apq8016"
compatible = "qcom,apq8084-cdp"
compatible = "qcom,apq8084-liquid"
compatible = "qcom,apq8084-mtp"
compatible = "qcom,apq8084-sbc"
compatible = "qcom,apq8094-cdp"
compatible = "qcom,apq8096-cdp"
compatible = "qcom,apq8096-mtp"
compatible = "qcom,apq8096-dragonboard"
compatible = "qcom,apq8096-sbc"
compatible = "qcom,apq8096-liquid"
compatible = "qcom,msm8916-cdp"
compatible = "qcom,msm8916-mtp"
compatible = "qcom,msm8916-qrd-skuh"
compatible = "qcom,msm8916-qrd-skuhf"
compatible = "qcom,msm8916-qrd-skui"
compatible = "qcom,msm8916-qrd-skuic"
compatible = "qcom,msm8916-qrd-skuid"
compatible = "qcom,msm8916-qrd-skut1"
compatible = "qcom,msm8916-rumi"
compatible = "qcom,msm8916-sim"
compatible = "qcom,msm8960-cdp"
compatible = "qcom,msm8974-cdp"
compatible = "qcom,msm8974-fluid"
compatible = "qcom,msm8974-liquid"
compatible = "qcom,msm8974-mtp"
compatible = "qcom,msm8974-rumi"
compatible = "qcom,msm8974-sim"
compatible = "qcom,msm8996-rumi"
compatible = "qcom,msm8996-sim"
compatible = "qcom,msm8996-cdp"
compatible = "qcom,msm8996-dtp"
compatible = "qcom,msm8996-fluid"
compatible = "qcom,msm8996-liquid"
compatible = "qcom,msm8996-mtp"
compatible = "qcom,msm8996-adp"
compatible = "qcom,sm8150-rumi"
compatible = "qcom,sm8150-mtp"
compatible = "qcom,sm8150-cdp"
compatible = "qcom,sm8150-qrd"
compatible = "qcom,sm8150p-cdp"
compatible = "qcom,sm8150p-mtp"
compatible = "qcom,sm8150p-qrd"
compatible = "qcom,sa8155-adp"
compatible = "qcom,sa8155p-adp"
compatible = "qcom,sa8155-adp-star"
compatible = "qcom,sa8155p-adp-star"
compatible = "qcom,sa8155-adp-air"
compatible = "qcom,sa8155-v2-adp-air"
compatible = "qcom,sa8155p-v2-adp-air"
compatible = "qcom,sa8195p-adp-star"
compatible = "qcom,sa8195p-adp-star"
compatible = "qcom,sa8195p-adp-air"
compatible = "qcom,adp-air"
compatible = "qcom,kona-rumi"
compatible = "qcom,kona-mtp"
compatible = "qcom,kona-cdp"
compatible = "qcom,kona-qrd"
compatible = "qcom,lahaina-rumi"
compatible = "qcom,lahaina-atp"
compatible = "qcom,lahaina-mtp"
compatible = "qcom,lahaina-cdp"
compatible = "qcom,lahaina-qrd"
compatible = "qcom,lahaina-qrd-module"
compatible = "qcom,lahaina-hdk"
compatible = "qcom,lahainap-mtp"
compatible = "qcom,lahainap-cdp"
compatible = "qcom,lahainap-atp"
compatible = "qcom,lahainap-qrd"
compatible = "qcom,shima-rumi"
compatible = "qcom,shima-idp"
compatible = "qcom,shima-atp"
compatible = "qcom,shima-qrd"
compatible = "qcom,lito-rumi"
compatible = "qcom,lito-mtp"
compatible = "qcom,lito-cdp"
compatible = "qcom,lito-atp"
compatible = "qcom,lito-qrd"
compatible = "qcom,bengal-rumi"
compatible = "qcom,sdmshrike-rumi"
compatible = "qcom,sdmshrike-mtp"
compatible = "qcom,sdmshrike-cdp"
compatible = "qcom,sm6150-rumi"
compatible = "qcom,sm6150-mtp"
compatible = "qcom,sm6150-cdp"
compatible = "qcom,sm6150-qrd"
compatible = "qcom,sm6150-idp"
compatible = "qcom,qcs405-rumi"
compatible = "qcom,qcs405-iot"
compatible = "qcom,qcs403-iot"
compatible = "qcom,sa8150-adp-star"
compatible = "qcom,adp-star"
compatible = "qcom,sdxprairie-rumi"
compatible = "qcom,sdxprairie-mtp"
compatible = "qcom,sdxprairie-cdp"
compatible = "qcom,sdxlemur-rumi"
compatible = "qcom,sdxlemur-mtp"
compatible = "qcom,sdxlemur-cdp"
compatible = "qcom,sdmmagpie-rumi"
compatible = "qcom,sdmmagpie-idp"
compatible = "qcom,sdmmagpie-qrd"
compatible = "qcom,holi-rumi"
compatible = "qcom,holi-mtp"
compatible = "qcom,holi-cdp"
compatible = "qcom,holi-qrd"
compatible = "qcom,holi-atp"
compatible = "qcom,waipio-rumi"
compatible = "qcom,waipio-mtp"
compatible = "qcom,waipio-atp"
compatible = "qcom,waipio-cdp"
compatible = "qcom,waipio-qrd"
compatible = "qcom,waipiop-hdk"
compatible = "qcom,waipiop-mtp"
compatible = "qcom,waipiop-cdp"
compatible = "qcom,waipiop-qrd"
compatible = "qcom,diwali-rumi"
compatible = "qcom,kalama-rumi"
compatible = "qcom,kalama-mtp"
compatible = "qcom,kalama-atp"
compatible = "qcom,kalama-cdp"
compatible = "qcom,kalama-qrd"
compatible = "qcom,kalama-rcm"
compatible = "qcom,kalamap-mtp"
compatible = "qcom,kalamap-cdp"
compatible = "qcom,kalamap-qrd"
compatible = "qcom,kalamap-hdk"
compatible = "qcom,kalamap-hhg"
compatible = "qcom,kaka-rumi"
compatible = "qcom,cinder-rumi"
compatible = "qcom,cinder-idp"
compatible = "qcom,cinder-x100"
compatible = "qcom,sa6155"
compatible = "qcom,sa6155p"
compatible = "qcom,sa6155-adp-air"
compatible = "qcom,sa6155-adp-star"
compatible = "qcom,sa6155p-adp-air"
compatible = "qcom,sa6155p-adp-star"
compatible = "qcom,khaje-idp"
compatible = "qcom,khaje-qrd"
compatible = "qcom,khaje-atp"
compatible = "qcom,khajep-idp"
compatible = "qcom,khajep-qrd"
compatible = "qcom,khajep-atp"
compatible = "qcom,khajeq-idp"
compatible = "qcom,khajeq-qrd"
compatible = "qcom,khajeq-atp"
compatible = "qcom,khajeg-idp"
compatible = "qcom,khajeg-qrd"
compatible = "qcom,khajeg-atp"
compatible = "qcom,sdxpinn-rumi"
compatible = "qcom,sdxpinn-idp"
compatible = "qcom,sa410m-rumi"
compatible = "qcom,quinvm"
compatible = "qcom,sdxbaagha-rumi"
compatible = "qcom,sdxbaagha-mtp"
compatible = "qcom,sdxbaagha-cdp"
compatible = "qcom,sa410m-idp"
compatible = "qcom,sa410m-qrd"
compatible = "qcom,sa410m-ccard"
compatible = "qcom,lemans-rumi"
compatible = "qcom,lemans-ivi"
compatible = "qcom,lemans-ivi-adp-air"
compatible = "qcom,lemans-ivi-adp-star"
compatible = "qcom,lemans-adas-high"
compatible = "qcom,lemans-adas-high-adp-air"
compatible = "qcom,lemans-adas-high-adp-star"
```

## Documentation/devicetree/bindings/arm/msm/qcom,gh-secure-vm-loader.yaml
```yaml
%YAML 1.2
---
$id: http://devicetree.org/schemas/arm/msm/qcom,gh-secure-vm-loader.yaml#
$schema: http://devicetree.org/meta-schemas/core.yaml#

title: Gunyah Secure Virtual Machine Loader

maintainers:
  - Prakruthi Deepak Heragu <pheragu@quicinc.com>
  - Sreenad Menon <sreemeno@qti.qualcomm.com>

description: |+
  Secure VM loader driver is used for loading the Secure Virtual Machine
  images into memory and conveying the memory details to Resource Manager.

properties:
  compatible:
    const: qcom,gh-secure-vm-loader

  qcom,vmid:
    $ref: '/schemas/types.yaml#/definitions/uint32'
    description: Virtual Machine ID of the current virtual machine.

  qcom,pas-id:
    $ref: '/schemas/types.yaml#/definitions/uint32'
    description: Peripheral authentication ID of the subsystem.

  qcom,firmware-name:
    $ref: '/schemas/types.yaml#/definitions/string'
    description: Virtual machine name.

  memory-region:
    $ref: '/schemas/types.yaml#/definitions/phandle'
    description: Virtual machine memory region.

  virtio-backends:
    $ref: '/schemas/types.yaml#/definitions/phandle'
    description: Virtio backend devices of VM.

required:
  - compatible
  - qcom,pas-id
  - qcom,vmid
  - qcom,firmware-name
  - memory-region
  - virtio-backends

additionalProperties: false

examples:
  - |
    gh-secure-vm-loader@0 {
      compatible = "qcom,gh-secure-vm-loader";
      qcom,pas-id = <28>;
      qcom,vmid = <45>;
      qcom,firmware-name = "trustedvm";
      memory-region = <&trust_ui_vm_mem>;
      virtio-backends = <&trust_ui_vm_virt_be0>;
    };
```

## Documentation/devicetree/bindings/arm/msm/qcom,llcc.txt
```
== Introduction==

LLCC (Last Level Cache Controller) provides last level of cache memory in SOC,
that can be shared by multiple clients. Clients here are different cores in the
SOC, the idea is to minimize the local caches at the clients and migrate to
common pool of memory. Cache memory is divided into partitions called slices
which are assigned to clients. Clients can query the slice details, activate
and deactivate them.

Properties:
- compatible:
	Usage: required
	Value type: <string>
	Definition: must be "qcom,sdm845-llcc" or "qcom,sm8150-llcc" or
                    "qcom,lahaina-llcc" or "qcom,shima-llcc" or "qcom,waipio-llcc"
			or "qcom,sdxlemur-llcc" or "qcom,diwali-llcc"
			or "qcom,kalama-llcc" or "qcom,cinder-llcc"
			or "qcom,sdmshrike-llcc".
		    "qcom,llcc-v2" must be appended for V2 hardware or
		    "qcom,llcc-v21" for V2.1 or "qcom,llcc-v41" for V4.1.

- reg:
	Usage: required
	Value Type: <prop-encoded-array>
	Definition: The first element specifies the llcc base start address and
		    the size of the register region. The second element specifies
		    the llcc broadcast base address and size of the register region.
		    The third element is optional and specifies the feature register
		    used to decide which llcc configuration to use if multiple are
		    available.

- reg-names:
        Usage: required
        Value Type: <stringlist>
        Definition: Register region names. Must be "llcc_base", "llcc_broadcast_base".
		    The third element is needed only if multiple llcc configurations
		    are available and must be "multi_ch_reg".

- interrupts:
	Usage: required
	Definition: The interrupt is associated with the llcc edac device.
			It's used for llcc cache single and double bit error detection
			and reporting.

- multi-ch-off:
	Usage: optional
	Value Type: <prop-encoded-array>
	Definition: If this exists, then the device has the potential to be configured
		    with different numbers of ddr channels at runtime. The value here
		    specifies the offset in bits into the "multi_ch_reg" register and
		    and the number of bits used to decied which llcc configuration to
		    use.

- max-banks
	Usage: optional
	Value Type: <prop-encoded-array>
	Definition: If this exists, then the device has a potential to only use a
		    certain number of banks. This caps the number of banks used
		    at the value set.

Example:

	cache-controller@1100000 {
		compatible = "qcom,sdm845-llcc";
		reg = <0x1100000 0x200000>, <0x1300000 0x50000> ;
		reg-names = "llcc_base", "llcc_broadcast_base";
		interrupts = <GIC_SPI 582 IRQ_TYPE_LEVEL_HIGH>;
	};

LLCC Performance Monitor
===

- compatible:
	Usage: required
	Value type: <string>
	Definition: must be "qcom,llcc-perfom"

- clocks:
	Usage: required
	Value type: <prop-encoded-array>
	Definition:  List of phandles and clock specifier pairs for the llcc perfmon
		     trace feature support.

- clock-names:
	Usage: required
	Value type: <stringlist>
	Definition: List of clock input name strings sorted in the same
		    order as the clocks property. Definition must have
		    "qdss_clk"
Example:

	cache-controller@1100000 {
		...
		llcc-perfmon {
			compatible = "qcom,llcc-perfmon";
			clocks = <&aoss_qmp QDSS_CLK>;
			clock-names = "qdss_clk";
		};
		...
	};
```

## Documentation/devicetree/bindings/arm/msm/tz-gpio.txt
```
* TZGPIO (Trust Zone GPIO)

The /sys/private/ is a sysfs interface added for showing and changing
gpio's configuration. It's usefual to debug bottom-rock current by
comparing and setting gpio's configuration before suspend. Because TZ
has restricted some gpios' accessing from AP, linux kernel will crash
if these gpios are accessed in AP. The gpio list here is used for AP
not to access them and avoid linux kernel's crash.

Required properties:
- compatible : Should be "qcom,tz-gpio"
- tlmm-tz    : List of GPIOs protected by TZ

Example:

	qcom, tz_gpio {
		compatible = "qcom,tz_gpio";
		tlmm-tz = <111>,
			<126>;
	};
```

## Documentation/devicetree/bindings/arm/pmu.txt
```
* ARM Performance Monitor Units
ARM cores often have a PMU for counting cpu and cache events like cache misses
and hits. The interface to the PMU is part of the ARM ARM. The ARM PMU
representation in the device tree should be done as under:-

Required properties:
- compatible : should be one of
		"arm,armv8-pmuv3"
		
- interrupts : 1 combined interrupt or 1 per core. If the interrupt is a per-cpu
		interrupt (PPI) then 1 interrupt should be specified.
		
Optional properties:

- qcom,no-pc-write : Indicates that this PMU doesn't support the 0xc and 0xd
events.

Example:

pmu {
	compatible = "arm,armv8-pmu3";
	interrupts = <GIC_PPI 7 IRQ_TYPE_LEVEL_HIGH>;
};
```
