## Documentation/devicetree/bindings/input/misc/epl8802.txt
```
ELAN epl8802 ambient light + proximity combo driver.

Required properties:

 - compatible					: Should be "epl,epl8802".
 - reg						: i2c slave address of the device.
 - epl,irq-gpio				: The gpio pin for the interrupt.
 - pinctrl-names				: The pinctrl configration names of this sensor driver. Should be
						"epl8802_default" and "epl8802_suspend".
 - pinctrl-0					: Should specify pin control groups used for this controller.
 - pinctrl-1					: Should specify pin control groups used for this controller.
 - vdd-supply					: Power supply needed to power up the device.
 - vio-supply					: IO power supply needed for IO and I2C.
 - epl,wait_time				: the wait time of the sensor
 - epl,st_gain					: the tuning value for PROX saturation
 - epl,als_c_gain				: the als gain of the sensoor
 - epl,ps_eg_sign				: the tuning value of Proximity CT value
 - epl,ps_intt					: the Prox integration time of the sensor
 - epl,ps_gain					: the Prox gain of the sensor
 - epl,ps_cycle				: the Prox cycle of the sensor
 - epl,ps_ir_drive				: the Prox IR current of the sensor
 - epl,ps_low_threshold			: the Prox low threshold to trigger for far interrupt
 - epl,ps_high_threshold			: the Prox high threshold to trigger for close interrupt
 - epl,ps_max_ct				: the Prox MAX ct for auto calibration
 - epl,ps_dyn_l_offset				: the Prox low offset of the threshold for auto calibration
 - epl,ps_dyn_h_offset				: the Prox high offset of the threshold for auto calibration
 - epl,ps_rs					: the Prox rs of the sensor

 Example:

&i2c_4 { /* BLSP1 QUP4 */
	 elan@49 {
		compatible = "epl,epl8802";
		reg = <0x49>;
		epl,irq-gpio = <&msm_gpio 113 0x00>;
		pinctrl-names = "epl8802_default", "epl8802_suspend";
		pinctrl-0 = <&epl8802_active>;
		pinctrl-1 = <&epl8802_suspend>;
        vdd-supply = <&pm8916_l17>;
        vio-supply = <&pm8916_l6>;
		epl,wait_time = <0x09>;
		epl,st_gain = <9>;
		epl,als_c_gain = <100>;
		epl,ps_eg_sign = <1>;
		epl,ps_intt = <5>;
		epl,ps_gain = <0x01>;
		epl,ps_cycle = <0x04>;
		epl,ps_ir_drive = <0x02>;
		epl,ps_low_threshold = <9200>;
		epl,ps_high_threshold = <10000>;
		epl,ps_max_ct = <20000>;
		epl,ps_dyn_l_offset = <900>;
		epl,ps_dyn_h_offset = <1700>;
		epl,ps_rs = <0>;
	};
};
```

## Documentation/devicetree/bindings/input/misc/et320.txt
```
Egis Technology Inc fingerprint  driver
et320 is a fps sensor in front of the phone, it connects to mainboard via SPI.

Required properties:
- compatible: Should be "egistec,et320"
- gpio_irq :  GPIO used for interrupt
- gpio_rst:   GPIO used for et320 reset
- gpio_ldo1p8_en : GPIO used to enable vdd 1.8v
- gpio_ldo3p3_en : GPIO used to enable vcc 3.3v
- pinctrl-names,pinctrl-0: the pincontrol setting to configure muxing properly
			for pins that connect to et320.

Optional properties:
- fp,gpio-id :GPIO of FPS ID pin which is used to detect fp sensor runtime.
		      When dual sensor is supported, GPIO return low means et320 is connected,
		      GPIO return High means fpc fps sensor is connected.

Example:
	et320: et320{
		compatible = "egistec,et320";
		status = "ok";
		reg = <0>;
		interrupt-parent = <&tlmm>;
		interrupts = <128 0x0>;
		egistec,gpio_irq    = <&tlmm 128 0x1>;
		egistec,gpio_rst    = <&tlmm 127 0x2>;
		egistec,gpio_ldo1p8_en = <&tlmm 132 0x0>;
		egistec,gpio_ldo3p3_en = <&tlmm 133 0x0>;
		pinctrl-names = "default", "suspend";
		pinctrl-0 = <&rst_active &int_active &ldo_en_active &ldo3_en_active>;
		pinctrl-1 = <&rst_suspend &int_suspend &ldo_en_suspend &ldo3_en_suspend>;
	};
	fp_id: fp_id {
		status = "ok";
		compatible = "fp_id,fp_id";
		interrupt-parent = <&tlmm>;
		fp,gpio-id = <&tlmm 25 0x0>;
	};
```

## Documentation/devicetree/bindings/input/misc/fpc1020.txt
```
FPC fingerprint sensor driver.

Required properties:

 - compatible		: Should be "fpc,fpc1020".
 - reg			: spi slave address of the device.
 - pinctrl-names	: Pinctrl configuration names of this sensor driver.
				Should be "default".
 - pinctrl-0		: The pinctrl node corresponding to "default",
				Should be <&fpc1020_default>.
 - interrupt-parent	: Parent of interrupt.
 - interrupts		: Accelerometer interrupt to indicate new data ready or events.
 - vdd_io-supply	: Digital IO power supply needed for sensor.

Example:
&spi_7 { /* BLSP2 QUP4 */
	fpc_fpc1020@0{
		compatible = "fpc,fpc1020";
		reg = <0>;
		interrupts = <42 0x0>;
		fpc,gpio_irq = <42>;
		fpc,gpio_reset = <47>;
		fpc,gpio_cs0 = <98>;
		pinctrl-names = "default", "active";
		pinctrl-0 = <&fps_rst_default &fps_int_default>;
		pinctrl-1 = <&fps_rst_active &fps_int_active>;
		fpc,enable-on-boot;
		fpc,txout_boost_enable;
		vdd_io-supply  = <&pm8950_l6>;
	};
};
```
