## Documentation/devicetree/bindings/gpio/gpio-pm8xxx-mpp.txt
```
PM8xxx MPP GPIO Controllers by Qualcomm, Inc.

This is for the QC PM8xxx MPP GPIO controller found on various Qualcomm
PowerICs such as: pm8921, pm8038, etc.

Required properties:
- compatible : "qcom,msm-pm8xxx-mpps"
- #gpio-cells : Should be two.  The first cell is the pin number and the
  second cell is used to specific optional parameters (unused).
- gpio-controller : Marks the port as a GPIO controller.

Optional children nodes:
- mux : defines pin mux control for the MPP controller, and has following
  required and optional properties.

  Required properties:
  - qcom,pm8xxx-mpp-pin : the MPP pin number, must match the range of valid
    pin numbers for the specific chip (ex: 1-12 for 8921, 1-6 on 8038, etc)

  Optional properties (will default to value of '0' if not specified):
  - qcom,pm8xxx-mpp-type : the function of the MPP pin, can be following:
          PM8XXX_MPP_TYPE_D_INPUT         0
          PM8XXX_MPP_TYPE_D_OUTPUT        1
          PM8XXX_MPP_TYPE_D_BI_DIR        2
          PM8XXX_MPP_TYPE_A_INPUT         3
          PM8XXX_MPP_TYPE_A_OUTPUT        4
          PM8XXX_MPP_TYPE_SINK            5
          PM8XXX_MPP_TYPE_DTEST_SINK      6
          PM8XXX_MPP_TYPE_DTEST_OUTPUT    7

 - qcom,pm8xxx-mpp-level : the meaning of level depends on the type above:
          - if type = PM8XXX_MPP_TYPE_D_INPUT, PM8XXX_MPP_TYPE_D_OUTPUT,
                    PM8XXX_MPP_TYPE_D_BI_DIR, or PM8XXX_MPP_TYPE_DTEST_OUTPUT:
              - specifies the digital logic level to use for the MPP:
                  PM8XXX_MPP_DIG_LEVEL_VIO_0   0
                  PM8XXX_MPP_DIG_LEVEL_VIO_1   1
                  PM8XXX_MPP_DIG_LEVEL_VIO_2   2
                  PM8XXX_MPP_DIG_LEVEL_VIO_3   3
                  PM8XXX_MPP_DIG_LEVEL_VIO_4   4
                  PM8XXX_MPP_DIG_LEVEL_VIO_5   5
                  PM8XXX_MPP_DIG_LEVEL_VIO_6   6
                  PM8XXX_MPP_DIG_LEVEL_VIO_7   7

                  /* PM8921 */
                  PM8921_MPP_DIG_LEVEL_S4         1
                  PM8921_MPP_DIG_LEVEL_L15        3
                  PM8921_MPP_DIG_LEVEL_L17        4
                  PM8921_MPP_DIG_LEVEL_VPH        7

                  /* PM8038 */
                  PM8038_MPP_DIG_LEVEL_L20        0
                  PM8038_MPP_DIG_LEVEL_L11        1
                  PM8038_MPP_DIG_LEVEL_L5         2
                  PM8038_MPP_DIG_LEVEL_L15        3
                  PM8038_MPP_DIG_LEVEL_L17        4
                  PM8038_MPP_DIG_LEVEL_VPH        7
          - if type = PM8XXX_MPP_TYPE_A_INPUT
              - specifies where the analog input value should be routed to:
                  PM8XXX_MPP_AIN_AMUX_CH5         0
                  PM8XXX_MPP_AIN_AMUX_CH6         1
                  PM8XXX_MPP_AIN_AMUX_CH7         2
                  PM8XXX_MPP_AIN_AMUX_CH8         3
                  PM8XXX_MPP_AIN_AMUX_CH9         4
                  PM8XXX_MPP_AIN_AMUX_ABUS1       5
                  PM8XXX_MPP_AIN_AMUX_ABUS2       6
                  PM8XXX_MPP_AIN_AMUX_ABUS3       7
          - if type = PM8XXX_MPP_TYPE_A_OUTPUT
              - specifies the output analog voltage reference level:
                  PM8XXX_MPP_AOUT_LVL_1V25        0
                  PM8XXX_MPP_AOUT_LVL_1V25_2      1
                  PM8XXX_MPP_AOUT_LVL_0V625       2
                  PM8XXX_MPP_AOUT_LVL_0V3125      3
                  PM8XXX_MPP_AOUT_LVL_MPP         4
                  PM8XXX_MPP_AOUT_LVL_ABUS1       5
                  PM8XXX_MPP_AOUT_LVL_ABUS2       6
                  PM8XXX_MPP_AOUT_LVL_ABUS3       7
          - if type = PM8XXX_MPP_TYPE_SINK or PM8XXX_MPP_TYPE_DTEST_SINK:
              - speicifes the output current level:
                  PM8XXX_MPP_CS_OUT_5MA           0
                  PM8XXX_MPP_CS_OUT_10MA          1
                  PM8XXX_MPP_CS_OUT_15MA          2
                  PM8XXX_MPP_CS_OUT_20MA          3
                  PM8XXX_MPP_CS_OUT_25MA          4
                  PM8XXX_MPP_CS_OUT_30MA          5
                  PM8XXX_MPP_CS_OUT_35MA          6
                  PM8XXX_MPP_CS_OUT_40MA          7

 - qcom,pm8xxx-mpp-ctrl : the meaning of control depends on the type above:
          - if type = PM8XXX_MPP_TYPE_D_INPUT
              - specifies how the digital input should be routed in the chip:
                  PM8XXX_MPP_DIN_TO_INT           0
                  PM8XXX_MPP_DIN_TO_DBUS1         1
                  PM8XXX_MPP_DIN_TO_DBUS2         2
                  PM8XXX_MPP_DIN_TO_DBUS3         3
          - if type = PM8XXX_MPP_TYPE_D_OUTPUT
              - specifies how the digital output value:
                  PM8XXX_MPP_DOUT_CTRL_LOW        0
                  PM8XXX_MPP_DOUT_CTRL_HIGH       1
                  PM8XXX_MPP_DOUT_CTRL_MPP        2
                  PM8XXX_MPP_DOUT_CTRL_INV_MPP    3
          - if type = PM8XXX_MPP_TYPE_D_BI_DIR
              - specifies the pullup resistor value
                  PM8XXX_MPP_BI_PULLUP_1KOHM      0
                  PM8XXX_MPP_BI_PULLUP_OPEN       1
                  PM8XXX_MPP_BI_PULLUP_10KOHM     2
                  PM8XXX_MPP_BI_PULLUP_30KOHM     3
          - if type = PM8XXX_MPP_TYPE_A_INPUT
              - unused, should be 0
          - if type = PM8XXX_MPP_TYPE_A_OUTPUT
              - specifies if analog output is enabled:
                  PM8XXX_MPP_AOUT_CTRL_DISABLE            0
                  PM8XXX_MPP_AOUT_CTRL_ENABLE             1
                  PM8XXX_MPP_AOUT_CTRL_MPP_HIGH_EN        2
                  PM8XXX_MPP_AOUT_CTRL_MPP_LOW_EN         3
          - if type = PM8XXX_MPP_TYPE_SINK
              - specifies if current sinking is enabled:
                  PM8XXX_MPP_CS_CTRL_DISABLE      0
                  PM8XXX_MPP_CS_CTRL_ENABLE       1
                  PM8XXX_MPP_CS_CTRL_MPP_HIGH_EN  2
                  PM8XXX_MPP_CS_CTRL_MPP_LOW_EN   3
          - if type = PM8XXX_MPP_TYPE_DTEST_SINK
              - specifies if current sinking is enabled:
                  PM8XXX_MPP_DTEST_CS_CTRL_EN1    0
                  PM8XXX_MPP_DTEST_CS_CTRL_EN2    1
                  PM8XXX_MPP_DTEST_CS_CTRL_EN3    2
                  PM8XXX_MPP_DTEST_CS_CTRL_EN4    3
          - if type = PM8XXX_MPP_TYPE_DTEST_OUTPUT
              - specifies which DTEST bus value to output:
                  PM8XXX_MPP_DTEST_DBUS1          0
                  PM8XXX_MPP_DTEST_DBUS2          1
                  PM8XXX_MPP_DTEST_DBUS3          2
                  PM8XXX_MPP_DTEST_DBUS4          3

Example of gpio-controller nodes for PM8921:

	qcom,msm-pm8921-mpps {
		compatible = "qcom,msm-pm8xxx-mpps";
		gpio-controller;
		#gpio-cells = <2>;
	};

Example using the option "mux" child node:

	pm8921_mpp: qcom,msm-pm8921-mpps {
		mux {
			mpp@12 {
				qcom,pm8xxx-mpp-pin = <12>;
				qcom,pm8xxx-mpp-type = <2>;    /* D_BI_DIR */
				qcom,pm8xxx-mpp-level = <4>;   /* L17 */
				qcom,pm8xxx-mpp-ctrl = <0>;    /* PULLUP_1K */
			};
	};
```

## Documentation/devicetree/bindings/haptic/ti-drv2605.txt
```
* TI DRV2505

DRV2605 is a haptic driver for ERM and LRA motors with build-in haptic effects
library and intelegent control engine.

Required properties:
	- compatible:
		the string of "ti,drv2605"
	- reg:
		the i2c slave address of the IC
	- gpios:
		<0> enable - the enable gpio
		<1> trigger - optional, external trigger or PWM/Audio in gpio
	- external_trigger:
		can be one of
		<0> - disable external trigger mode
		<1> - enable external trigger pin in stand-by mode
		<2> - do external trigger confuration but keep stand-by mode
	- default_effect:
		the library effect ID for the trigger pin activated vibes
	- rated_voltage:
		rated voltage for the motor
	- overdrive_voltage:
		overdrive voltage for the motor
Example:

	i2c@1a200000 {
		status = "okay";

		qcom,i2c-bus-freq = <400000>;
		qcom,i2c-src-freq = <24000000>;

		drv2605@5A {
			compatible = "ti,drv2605";
			reg = <0x5A>;
			gpios = <&pm8921_gpio 4 0>, /* EN_GPIO */
				<&msmgpio 79 0>;    /* Trigger */

			external_trigger = <1>;
			default_effect = <19>;      /* Strong Click 3 60% */
			rated_voltage = <0x6D>;
			overdrive_voltage = <0xF0>;
		};
	};
```

## Documentation/devicetree/bindings/i2c/qcom,i2c-slave-test.txt
```
I2c Slave test: Qualcomm Technologies Inc Universal Peripheral.

Required properties:
 - compatible: Should be: "qcom,i2c-slave-test".
 - reg: Should contain slave address.

Optional property:

Example:

i2c_slave_test {
        compatible = "qcom,i2c-slave-test";
        reg = <0x64>;
        status = "ok";
};
```

## Documentation/devicetree/bindings/i2c/qcom,i2c-slave.txt
```
I2c Slave: Qualcomm Technologies Inc Universal Peripheral.

Required properties:
 - compatible: Should be: "qcom,i2c-slave".
 - reg: Should contain base register address and length.
 - interrupts: Should contain I2C slave interrupt.
 - clocks: AHB clock and XO clocks needed by the device.
 - pinctrl-names/pinctrl-0/1: The GPIOs assigned to this core. The names
   should be "active" and "sleep" for the pin confuguration when core is active
   or when entering sleep state.

Optional property:

Child nodes should conform to i2c bus binding.

Example:

i2c_slave{
        compatible = "qcom,i2c-slave";
        reg = <0x088ca000 0x64>;
        interrupt-names = "smbus_alert";
        interrupts = <GIC_SPI 535 IRQ_TYPE_LEVEL_HIGH>;
        clock-names = "sm_bus_xo_clk", "sm_bus_ahb_clk";
        clocks = <&gcc GCC_SM_BUS_XO_CLK>, <&gcc GCC_SM_BUS_AHB_CLK>;
        pinctrl-names = "default", "sleep";
        pinctrl-0 = <&i2c_slave_sda_active>, <&i2c_slave_scl_active>;
        pinctrl-1 = <&i2c_slave_sleep>;
        status = "ok";
};
```

## Documentation/devicetree/bindings/input/akm-akm8963.txt
```
AK8963C Magnetometer

AK8963C is a 3-axis electronic compass to measure earths geomagnetism
to determine azimuth.
It is connected to the host processor on the I2C interface.

Required properties:
- compatible:		Must be "akm,akm8963"
- reg:			Specifies the I2C address of the part.
- interrupt-parent:	The parent interrupt controller
- interrupts:		Interrupt line connected to the main SoC
- akm,gpio-irq:		IRQ GPIO
- akm,layout:		physical orientation layout of sensor.
- akm,outbit:		set number of data bits reported by the sensor.

Optional Properties:
- akm,gpio-rst:		RESET GPIO
- akm8963_vdd-supply:	regulator suppy to VDD

Example:

	ak8963@0c {
		compatible = "akm,akm8963";
		reg = <0x0c>;
		akm8963_vdd-supply = <&pm8226_l19>;
		interrupt-parent = <&msmgpio>;
		interrupts = <66 0x2>;
		akm,gpio-irq = <&msmgpio 66 0>;
		akm,gpio-rst = <&msmgpio 62 0>;
		akm,layout = <1>;
		akm,outbit = <1>;
	};
```

## Documentation/devicetree/bindings/input/misc/ak09912.txt
```
AKM AK09912 3-axis electronic compass driver

Required properties:

 - compatible		: Should be "ak,ak09912".
 - reg			: i2c address of the device.
 - gpios                : Reset and IRQ pins.
 - pinctrl-names	: The pinctrl configration names of this sensor driver.
 - pinctrl-0		: The pinctrl node(s).
 - ak,layout		: The physical orientation of the ecompass sensor chip.

Optional properites:
 - vdd-supply           : Analog power supply needed to power up the device.
 - vio-supply           : Digital IO power supply needed for IO and I2C.

Example:
	ak09912@0c {
			compatible = "ak,ak09912";
			reg = <0x0c>;
			gpios = <&msm_gpio 90 0>, /* RESET */
			        <&msm_gpio 50 0>; /* IRQ */
			pinctrl-names = "default";
			pinctrl-0 = <&ak09912_reset_default &ak09912_irq_default>;
			vdd-supply = <&pm8916_l17>;
			vio-supply = <&pm8916_l6>;
			ak,layout = <0x0>;
	};
```

## Documentation/devicetree/bindings/input/misc/bma25x.txt
```
BOSCH bma2x2 3-axis accelerometer sensor driver.

Required properties:

 - compatible		: Should be "bosch,bma253".
 - reg			: i2c slave address of the device.
 - pinctrl-names	: Pinctrl configuration names of this sensor driver.
				Should be "default".
 - pinctrl-0		: The pinctrl node corresponding to "default",
				should be <&bma25x_int1_default &bma25x_int2_default>.
 - interrupt-parent	: Parent of interrupt.
 - interrupts		: Accelerometer interrupts to indicate new data ready or events.
 - vdd-supply		: Analog power supply needed to power device.
 - vio-supply		: Digital IO power supply needed for IO and I2C.
 - bosch,init-interval	: Initial data polling interval in millisecond.
 - bosch,place		: The placing of the accelerometer on board. There are 8
				patterns of placing described as below:
				0: 1st pin is right down
				1: 1st pin is left down
				2: 1st pin is left top
				3: 1st pin is right top
				4: 1st pin is left down (from top view)
				5: 1st pin is left top (from top view)
				6: 1st pin is right top (from top view)
				7: 1st pin is right down (from top view)

Optional properties:

 - bosch,gpio-int1	: 1st irq gpio which is to provide interrupts
				to host, interrupt events can be route to any of
				these two irq pins according device configuration.
 - bosch,gpio-int2	: 2nd irq gpio which is to provide interrupts
				to host.

Example:
&i2c_4 { /* BLSP1 QUP2 */
	 bosch@19 { /* Accelerometer sensor */
		compatible = "bosch,bma253";
		reg = <0x19>;
		pinctrl-names = "default";
		pinctrl-0 = <&bma25x_int1_default &bma25x_int2_default>;
		interrupt-parent = <&msm_gpio>;
		interrupts = <96 0x2002>;
		vdd-supply = <&pm8916_l17>;
		vio-supply = <&pm8916_l6>;
		bosch,init-interval = <200>;
		bosch,place = <1>;
		bosch,gpio-int1 = <&msm_gpio 96 0x2002>;
	};
};
```

## Documentation/devicetree/bindings/input/misc/bmi160.txt
```
BOSCH 6-axis accelerometer and gyroscope sensor driver.

Required properties:

 - compatible		: Should be "bosch,bmi160".
 - reg			: i2c slave address of the device.
 - pinctrl-names	: Pinctrl configuration names of this sensor driver.
				Should be "default".
 - pinctrl-0		: The pinctrl node corresponding to "default",
				should be <&bmi160_int1_default &bmi160_int2_default>.
 - interrupt-parent	: Parent of interrupt.
 - interrupts		: Accelerometer interrupts to indicate new data ready or events.
 - vdd-supply		: Analog power supply needed to power device.
 - vio-supply		: Digital IO power supply needed for IO and I2C.
 - bosch,init-interval	: Initial data polling interval in millisecond.
 - bosch,place		: The placing of the accelerometer on board. There are 8
				patterns of placing described as below:
				0: 1st pin is right down
				1: 1st pin is left down
				2: 1st pin is left top
				3: 1st pin is right top
				4: 1st pin is left down (from top view)
				5: 1st pin is left top (from top view)
				6: 1st pin is right top (from top view)
				7: 1st pin is right down (from top view)

Optional properties:

 - bosch,gpio-int1	: 1st irq gpio which is to provide interrupts
				to host, interrupt events can be route to any of
				these two irq pins according device configuration.
 - bosch,gpio-int2	: 2nd irq gpio which is to provide interrupts
				to host.
Example:
&i2c_0 { /* BLSP1 QUP2 */
	 bosch@68 { /* Accelerometer and Gyroscope sensor */
		compatible = "bosch,bmi160";
		reg = <0x68>;
		pinctrl-names = "default";
		pinctrl-0 = <&bmi160_int1_default>;
		interrupt-parent = <&msm_gpio>;
		interrupts = <96 0x2002>;
		vdd-supply = <&pm8916_l17>;
		vio-supply = <&pm8916_l6>;
		bosch,init-interval = <200>;
		bosch,place = <1>;
		bosch,gpio-int1 = <&msm_gpio 96 0x2002>;
	};
};
```
