## Documentation/devicetree/bindings/power/battery-tm.txt
```
Battery Temperature Monitor

The battery temperature monitor can restrict charging
behavior according to the temperature threshold.
It use the qpnp-adc-tm driver for threshold notification
and power supply framework interface to control charging
behavior.

Required properties:

 - compatible : should be "battery_tm"
 - qcom,batt-tm-adc-tm = phandle of qpnp-adc-tm
 - qcom,charger = phandle of qpnp-charger
 - tm,low-vreg-mv = reduced battery regulation voltage in mV
 - tm,low-current-ma = reduced battery charging current in mA
 - tm,warm-cfg = array of warm temp threshold, action and health

		< (thr) (next_cool_thr) (next_warm_thr) action  health >

		thr : current temp threshold in 0.1 Celsius degree
		next_cool_thr : next cool threshold in 0.1 Celsius degree
		next_warm_thr : next warm threshold in 0.1 Celsius degree
		action :
			CHG_ENABLE = 0
			CHG_DECREASE = 1
			CHG_STOP = 2
			CHG_SHUTDOWN = 3
		health :
			POWER_SUPPLY_HEALTH_UNKNOWN = 0
			POWER_SUPPLY_HEALTH_GOOD = 1
			POWER_SUPPLY_HEALTH_OVERHEAT = 2
			POWER_SUPPLY_HEALTH_COLD = 7

 - tm,cool-cfg = array of cool temp threshold, action and health

		< (thr) (next_cool_thr) (next_warm_thr) action  health >

		thr : current temp threshold in 0.1 Celsius degree
		next_cool_thr : next cool threshold in 0.1 Celsius degree
		next_warm_thr : next warm threshold in 0.1 Celsius degree
		action :
			CHG_ENABLE = 0
			CHG_DECREASE = 1
			CHG_STOP = 2
			CHG_SHUTDOWN = 3
		health :
			POWER_SUPPLY_HEALTH_UNKNOWN = 0
			POWER_SUPPLY_HEALTH_GOOD = 1
			POWER_SUPPLY_HEALTH_OVERHEAT = 2
			POWER_SUPPLY_HEALTH_COLD = 7

Example:
	battery_tm {
		compatible = "battery_tm";
		status = "ok";
		qcom,batt-tm-adc_tm = <&pm8226_adc_tm>;
		qcom,charger = <&pm8226_chg>;
		tm,low-vreg-mv = <4100>;
		tm,low-current-ma = <200>;
		tm,warm-cfg = <
			 (-50) (-100) (450) 0 1
			 (450)  (430) (550) 1 2
			 (550)  (430) (600) 2 2
			 (600)  (430) (790) 3 2>;
		tm,cool-cfg = <
			(-100) (-300) (-50) 2 7
			 (430) (-100) (450) 0 1>;
	};
```

## Documentation/devicetree/bindings/power/gpio-charger.txt
```
GPIO charger

Required properties:
- compatible:		Must be "gpio-charger".
- gpio:			GPIO indicating charging status.
- charger-type:		Type of the charger from enum power_supply_type defined in linux/power_supply.h.

Optional properties:
- pinctrl-names:	The definition can be found at pinctrl/pinctrl-bindings.txt.
- pinctrl-0:		The definition can be found at pinctrl/pinctrl-bindings.txt.
- charger-name:		Name for the chargers power_supply device.
- gpio_active_low:	Define this property if GPIO is active low.
- supplied_to:		Strings with battery names to which this charger supplies power.
- switch_name:		String with the charger GPIO switch name (sys/class/switch/<switch_name>).
			Switch requires a valid IRQ for the GPIO indicating charging status.

Example:

	gpio-charger {
		compatible = "gpio-charger";
		pinctrl-names = "default";
		pinctrl-0 = <&charge_pin>;
		gpio = <&gpio6 16 0>;
		charger-type = <3>; /* POWER_SUPPLY_TYPE_MAINS */
	};
```

## Documentation/devicetree/bindings/power/mmi-suspend_dbg.txt
```
* MMI_SUSPEND_DBG (MMI Suspend Debug)

The /sys/private/ is a sysfs interface added for showing and changing
gpio's configuration. It's usefual to debug bottom-rock current by
comparing and setting gpio's configuration before suspend. Because GKI
has restricted the change of suspend.c in common, add a platform device
and do the debugging work in noirq suspend callbacks.

Required properties:
- compatible : Should be "mmi,suspend_dbg"

Example:

	motorola, private {
		compatible = "mmi,suspend_dbg";
	};
```

## Documentation/devicetree/bindings/power/mmi-wls-charger.txt
```
MMI Wireless charger

MMI Wireless Charger can support various TI Inductive charging Chips

The MMI Wireless Charger interface is via I2C bus.

Required Properties:
- compatible:			Must be "mmi,wls-charger-XXXXX" were XXXXX is the TI Part number.
- reg:				The device 7-bit I2C address.

- gpios	        		This indicates the GPIOS that are connected
				to the chip for control and information.

- gpio-names			This list is the names used for exporting the
				gpios in the above field.

Optional Properties:
- mmi,priority		 	This is the Priority for the Charge Path when both
				Wired and Wireless and present.
				Program using:
				enum mmi_wls_charger_priority {
				     MMI_WLS_CHRG_WIRELESS = 0,
				     MMI_WLS_CHRG_WIRED,
				};
				Driver Defaults to MMI_WLS_CHRG_WIRED.

- mmi,resume-soc	 	Indicates the State of Charge to Re-Enable
				the Wireless Pad.
				Units are Percentage
				Driver Defaults to 99%.

- mmi,resume-vbatt-mv		Indicates the Battery Voltage to Re-Enable
				the Wireless Pad.
				Units are milliVolts
				Driver Defaults to 0 mV.

- mmi,hot-temp-thresh		Indicates the Hot Battery Temperature for Disabling
				the Wireless Pad.
				Units are Degrees Celsius
				Driver Defaults to 60 C.

- mmi,cold-temp-thresh		Indicates the Cold Battery Temperature for Disabling
				the Wireless Pad.
				Units are Degrees Celsius
				Driver Defaults to -20 C.

Example:
	i2c@f9967000 {
		     mmi_wls_chrg@6d {
				     compatible = "mmi,wls-charger-bq51021";
				     reg = <0x6d>;
				     gpios = <&pma8084_gpios 1 0x1>, /* GPIOF_IN */
				     	     <&pma8084_mpps 4 0x2>, /* GPIOF_OUT_INIT_HIGH */
					     <&msmgpio 66 0x0>; /* GPIOF_OUT_INIT_LOW */
				     gpio-names = "pad_detect_n",
						"charge_complete_n",
						"charger_terminate";
				     mmi,priority = <1>;
				     mmi,resume-soc = <99>;
				     mmi,resume-vbatt-mv = <4270>;
				     mmi,hot-temp-thresh = <60>;
				     mmi,cold-temp-thresh = <(-20)>;
			};
	};
```
