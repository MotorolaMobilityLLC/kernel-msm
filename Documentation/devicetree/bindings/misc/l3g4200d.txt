## Documentation/devicetree/bindings/mmi/mmi-gpiomux.txt
```
mmi-pinmux

NOTE: this is included in the mmi (motorola) directory
rather than a gpio, or more correctly pinctl subdirectory
because it only represents an interim solution that does
not accurately fit in the upstream categories.

This is a mechanism to use the standard device tree
to define msm pinmuxing in a non-standard way.  This
definition ties into the existing msm board files.

The mmi-pinmux is a platform driver that installs the
defined tlmm settings through the existing gpiomux_install
interface.

Required properties:
- compatible: "qcom,msm8x26-pinmux"

- reg: should contain the address of the gpio first gpio
       configuration register.  (fd510000 + 0x10 * gpio_num).
       Their are 16 registers for each gpio so the size will
       always be 0x10.

- #address-cells: should always be <1>

- #size-cells: should always be <1>

All other properties are optional, but useful if you want to actually
do something.  The msm gpiomux_install allows a suspended and an
active setting for each pin.  If only one setting is needed then
defining the suspended setting is sufficient.  Within a setting
the following properties are available:

qcom,func:    Each pin can have multiple functions.  The first <0>
              function is a gpio but, each pin will
              have a varied number of possible functions.
              This will default to <0>, or GPIO.

qcom,pull:    This can be on of:
                    <0> - no pull
                    <1> - pull down
                    <2> - pull keeper
                    <3> - pull up

              Default = <0>  no pull

qcom,drv:     Defines the drive string of the pin:
                    <0> -  2 mA
                    <1> -  4 mA
                    <2> -  6 mA
                    <3> -  8 mA
                    <4> - 10 mA
                    <5> - 12 mA
                    <6> - 14 mA
                    <7> - 16 mA

              Default = <0>  2 mA

qcom,dir:     Only applicable for qcom,func = <0>.  Defines
              the direction of the gpio and for a output
              gpio defines the initial state.
                    <0> - input
                    <1> - output high
                    <2> - output low

Example:

qcom,pinmux@fd510000 {
	compatible = "qcom,msm8x26-pinmux";
	#address-cells = <1>;
	#size-cells = <1>;

	pin@fd510000 {
		reg = <0xfd510000 0x10>;
		qcom,pin-num = <0>;
		qcom,active@0 {
			qcom,func = <1>;  /* gsm_tx_lb_clk          */
			qcom,pull = <3>;  /* up                     */
			qcom,drv = <3>;   /*                        */
		};
		qcom,suspended@1 {
			qcom,func = <0>;
			qcom,pull = <3>; /* up                      */
			qcom,drv = <3>;
			qcom,dir = <0>;
		};
	};
};
```

## Documentation/devicetree/bindings/net/qcom-qrtr-genpool.yaml
```yaml
%YAML 1.2
---
$id: "http://devicetree.org/schemas/net/qrtr-genpool.yaml#"
$schema: "http://devicetree.org/meta-schemas/core.yaml#"

title: QRTR Genpool FIFO Transport Configuration

maintainers:
  - Tony Truong <truong@quicinc.com>

description: |
  Configuration properties for the QRTR Genpool FIFO Transport. This
  configuration is to instantiate a transport for IPC Router protocol
  communication between Virtual Machine and Digital Signal Processor subsystem.

properties:
  compatible:
    const: qcom,qrtr-genpool

  gen-pool:
    $ref: /schemas/types.yaml#/definitions/phandle
    maxItems: 1
    description:
      Phandle reference to a client which has a dedicated memory region for
      sharing between Virtual Machine and Digital Signal Processor subsystem.

  genpool-poll:
    $ref: /schemas/types.yaml#/definitions/flag
    description:
      If set, enables polling mode for RX.

  genpool-poll-sleep:
    $ref: /schemas/types.yaml#/definitions/uint32
    maxItems: 1
    description:
      Sleep (ms) between each poll. If not set, the default interval is 100ms.

required:
  -compatible
  -gen-pool

examples:
  - |
    qrtr-genpool {
        compatible = "qcom,qrtr-genpool";
        gen-pool = <&fastrpc_compute_cb1>;
        genpool-poll;
        genpool-poll-sleep = <1000>;
    };
```

## Documentation/devicetree/bindings/nfc/brcm-bcm2079x.txt
```
* BRCM BCM2079x

BCM2079x is NFC compliant highly integrated, low power, low cost 40nm NFC
controller with EEPROM.

Required properties:
	- compatible:
		the string of "brcm,bcm2079x"
	- reg:
		the i2c slave address of the IC
	- interrupts:
		there is one interrupt line connected to the main SoC
	- interrupt-parent:
		The parent interrupt controller
	- gpios:
		an array specifiying the required GPIO for operation
			- WAKE GPIO
			- IRQ GPIO
			- ENABLE GPIO
Optional:
	- nfc_vddswp-supply:
		regulator suppy to VDD_SWP
Example:

	&i2c_3 {
	status = "ok";
	bcm2079x@77 {
		compatible = "brcm,bcm2079x";
		reg = <0x77>;
		interrupt-parent = <&msmgpio>;
		interrupts = <21 0x2>;
		gpios = <&msmgpio 20 0x0>, /* WAKE */
			<&msmgpio 21 0x0>, /* IRQ */
			<&msmgpio 22 0x0>; /* EN */
		nfc_vddswp-supply = <&pm8226_l22>;
	};
```

## Documentation/devicetree/bindings/nfc/nxp-pnxxx.txt
```
* NXP NFC PN544, PN650 Controller

The NXP NFC family of products are connected to the host processor via i2c for
commands and have various GPIOs connected to control reset, irq, and firmware
downloading.

Required properties:
 - compatible:
        one of the following strings "nxp,pn544", or "nxp,pn65O"
 - reg:
        the i2c slave address of the IC
 - interrupts:
        there is one interrupt line connected to the main SoC
 - interrupt-parent:
        The parent interrupt controller
 - gpios:
        an array specifying the three required GPIOs for operation. They must
        be specified in exact order:
           - IRQ GPIO
           - VEN GPIO - the enable/reset line to the IC
           - Firmware GPIO - GPIO used to toggle the initiation of a firmware
             download.

Optional properties:
 - nxp,pnxxx-discharge-delay:
        the minimum time (in milliseconds) for which we need to hold the VEN
        gpio in the reset/disabled state.  If this is not specified, the
        default value of 10ms is used
 - nxp,pnxxx-ven-inv-polarity:
        this indicates that the VEN GPIO has an inverse polarity. If set to 0
        or not defined, the chip will be enabled when VEN GPIO is logic level 1
        and disabled when logic level 0.  If this is set to 1, it indicates an
        active low configuration: VEN GPIO is enabled when logical level 0.
             0 - active high for enable
             1 - active low for enable
 - vdd-supply:
	this is for the power supply for nfc chip.
Example:

	i2c@1a200000 {
		status = "okay";

		qcom,i2c-bus-freq = <400000>;
		qcom,i2c-src-freq = <24000000>;

		pnxxx@28 {
			compatible = "nxp,pn544";
			reg = <0x28>;
			interrupt-parent = <&msmgpio>;
			interrupts = <106 0>;
			gpios = <&msmgpio 106 0>,     /* IRQ */
				<&pm8921_gpio 33 0>,  /* VEN */
				<&pm8921_gpio 16 0>;  /* Firmware */

			nxp,pnxxx-discharge-delay = <2000>;
			nxp,pnxxx-ven-inv-polarity = <0>;
			vdd-supply = <&pm8226_l22>;
		};
	};
```
