## Documentation/devicetree/bindings/pinctrl/qcom,scuba_auto-pinctrl.txt
```
Qualcomm Technologies, Inc. SCUBA_AUTO TLMM block

This binding describes the Top Level Mode Multiplexer block found in the
SCUBA_AUTO platform.

- compatible:
	Usage: required
	Value type: <string>
	Definition: must be "qcom,sm8150-pinctrl"

- reg:
	Usage: required
	Value type: <prop-encoded-array>
	Definition: the base address and size

- interrupts:
	Usage: required
	Value type: <prop-encoded-array>
	Definition: should specify the TLMM summary IRQ.

- interrupt-controller:
	Usage: required
	Value type: <none>
	Definition: identifies this node as an interrupt controller

- #interrupt-cells:
	Usage: required
	Value type: <u32>
	Definition: must be 2. Specifying the pin number and flags, as defined
		    in <dt-bindings/interrupt-controller/irq.h>

- gpio-controller:
	Usage: required
	Value type: <none>
	Definition: identifies this node as a gpio controller

- #gpio-cells:
	Usage: required
	Value type: <u32>
	Definition: must be 2. Specifying the pin number and flags, as defined
		    in <dt-bindings/gpio/gpio.h>

- gpio-ranges:
	Usage: required
	Value type: <prop-encoded-array>
	Definition:  see ../gpio/gpio.txt

- gpio-reserved-ranges:
	Usage: optional
	Value type: <prop-encoded-array>
	Definition: see ../gpio/gpio.txt

Please refer to ../gpio/gpio.txt and ../interrupt-controller/interrupts.txt for
a general description of GPIO and interrupt bindings.

Please refer to pinctrl-bindings.txt in this directory for details of the
common pinctrl bindings used by client devices, including the meaning of the
phrase "pin configuration node".

The pin configuration nodes act as a container for an arbitrary number of
subnodes. Each of these subnodes represents some desired configuration for a
pin, a group, or a list of pins or groups. This configuration can include the
mux function to select on those pin(s)/group(s), and various pin configuration
parameters, such as pull-up, drive strength, etc.


PIN CONFIGURATION NODES:

The name of each subnode is not important; all subnodes should be enumerated
and processed purely based on their content.

Each subnode only affects those parameters that are explicitly listed. In
other words, a subnode that lists a mux function but no pin configuration
parameters implies no information about any pin configuration parameters.
Similarly, a pin subnode that describes a pullup parameter implies no
information about e.g. the mux function.


The following generic properties as defined in pinctrl-bindings.txt are valid
to specify in a pin configuration subnode:

- pins:
	Usage: required
	Value type: <string-array>
	Definition: List of gpio pins affected by the properties specified in
		    this subnode.

		    Valid pins are:
		      gpio0-gpio149
		        Supports mux, bias and drive-strength

		      sdc1_clk, sdc1_cmd, sdc1_data sdc2_clk, sdc2_cmd,
		      sdc2_data sdc1_rclk
		        Supports bias and drive-strength

		      ufs_reset
		        Supports bias and drive-strength

- function:
	Usage: required
	Value type: <string>
	Definition: Specify the alternative function to be configured for the
		    specified pins. Functions are only valid for gpio pins.
		    Valid values are:

		  msm_mux_qup0, msm_mux_gpio, msm_mux_ddr_bist, msm_mux_phase_flag0,
		  msm_mux_qdss_gpio8, msm_mux_atest_tsens, msm_mux_mpm_pwr, msm_mux_m_voc,
		  msm_mux_phase_flag1, msm_mux_qdss_gpio9, msm_mux_atest_tsens2,
		  msm_mux_phase_flag2, msm_mux_qdss_gpio10, msm_mux_dac_calib0,
		  msm_mux_atest_usb10, msm_mux_phase_flag3, msm_mux_qdss_gpio11,
		  msm_mux_dac_calib1, msm_mux_atest_usb11, msm_mux_qup1,
		  msm_mux_CRI_TRNG0, msm_mux_phase_flag4, msm_mux_dac_calib2,
		  msm_mux_atest_usb12, msm_mux_CRI_TRNG1, msm_mux_phase_flag5,
		  msm_mux_dac_calib3, msm_mux_atest_usb13, msm_mux_qup2,
		  msm_mux_phase_flag6, msm_mux_dac_calib4, msm_mux_atest_usb1,
		  msm_mux_qup3, msm_mux_pbs_out, msm_mux_PLL_BIST, msm_mux_qdss_gpio,
		  msm_mux_tsense_pwm, msm_mux_AGERA_PLL, msm_mux_pbs0,
		  msm_mux_qdss_gpio0, msm_mux_pbs1, msm_mux_qdss_gpio1, msm_mux_qup4,
		  msm_mux_tgu_ch0, msm_mux_tgu_ch1, msm_mux_qup5, msm_mux_tgu_ch2,
		  msm_mux_phase_flag7, msm_mux_qdss_gpio4, msm_mux_dac_calib5,
		  msm_mux_tgu_ch3, msm_mux_phase_flag8, msm_mux_qdss_gpio5,
		  msm_mux_dac_calib6, msm_mux_phase_flag9, msm_mux_qdss_gpio6,
		  msm_mux_dac_calib7, msm_mux_phase_flag10, msm_mux_qdss_gpio7,
		  msm_mux_dac_calib8, msm_mux_SDC2_TB, msm_mux_CRI_TRNG, msm_mux_pbs2,
		  msm_mux_qdss_gpio2, msm_mux_pwm_0, msm_mux_SDC1_TB, msm_mux_pbs3,
		  msm_mux_qdss_gpio3, msm_mux_cam_mclk, msm_mux_pbs4, msm_mux_adsp_ext,
		  msm_mux_pbs5, msm_mux_cci_i2c, msm_mux_prng_rosc, msm_mux_pbs6,
		  msm_mux_phase_flag11, msm_mux_dac_calib9, msm_mux_atest_usb20,
		  msm_mux_pbs7, msm_mux_phase_flag12, msm_mux_dac_calib10,
		  msm_mux_atest_usb21, msm_mux_CCI_TIMER1, msm_mux_GCC_GP1,
		  msm_mux_pbs8, msm_mux_phase_flag13, msm_mux_dac_calib11,
		  msm_mux_atest_usb22, msm_mux_cci_async, msm_mux_CCI_TIMER0,
		  msm_mux_pbs9, msm_mux_phase_flag14, msm_mux_dac_calib12,
		  msm_mux_atest_usb23, msm_mux_pbs10, msm_mux_phase_flag15,
		  msm_mux_dac_calib13, msm_mux_atest_usb2, msm_mux_vsense_trigger,
		  msm_mux_qdss_cti, msm_mux_CCI_TIMER2, msm_mux_pwm_1,
		  msm_mux_phase_flag16, msm_mux_dac_calib14, msm_mux_atest_char,
		  msm_mux_phase_flag17, msm_mux_dac_calib15, msm_mux_atest_char0,
		  msm_mux_GP_PDM0, msm_mux_phase_flag18, msm_mux_dac_calib16,
		  msm_mux_atest_char1, msm_mux_CCI_TIMER3, msm_mux_GP_PDM1,
		  msm_mux_phase_flag19, msm_mux_dac_calib17, msm_mux_atest_char2,
		  msm_mux_GP_PDM2, msm_mux_phase_flag20, msm_mux_dac_calib18,
		  msm_mux_atest_char3, msm_mux_phase_flag21, msm_mux_phase_flag22,
		  msm_mux_char_exec, msm_mux_NAV_GPIO, msm_mux_phase_flag23,
		  msm_mux_phase_flag24, msm_mux_phase_flag25, msm_mux_pbs14,
		  msm_mux_qdss_gpio14, msm_mux_vfr_1, msm_mux_pbs15,
		  msm_mux_qdss_gpio15, msm_mux_PA_INDICATOR, msm_mux_pwm_2,
		  msm_mux_gsm1_tx, msm_mux_SSBI_WTR1, msm_mux_pll_bypassnl,
		  msm_mux_pll_reset, msm_mux_phase_flag26, msm_mux_ddr_pxi0,
		  msm_mux_gsm0_tx, msm_mux_phase_flag27, msm_mux_GCC_GP2,
		  msm_mux_qdss_gpio12, msm_mux_ddr_pxi1, msm_mux_GCC_GP3,
		  msm_mux_qdss_gpio13, msm_mux_dbg_out, msm_mux_uim2_data,
		  msm_mux_pwm_3, msm_mux_uim2_clk, msm_mux_uim2_reset, msm_mux_pwm_4,
		  msm_mux_uim2_present, msm_mux_pwm_5, msm_mux_uim1_data,
		  msm_mux_uim1_clk, msm_mux_uim1_reset, msm_mux_uim1_present,
		  msm_mux_dac_calib19, msm_mux_mdp_vsync, msm_mux_mdp_vsync_out_0,
		  msm_mux_mdp_vsync_out_1, msm_mux_dac_calib20, msm_mux_dac_calib21,
		  msm_mux_pwm_6, msm_mux_atest_bbrx1, msm_mux_pbs11, msm_mux_usb_phy,
		  msm_mux_atest_bbrx0, msm_mux_pwm_7, msm_mux_mss_lte, msm_mux_pbs12,
		  msm_mux_pbs13, msm_mux_wlan1_adc0, msm_mux_wlan1_adc1,
		  msm_mux_sd_write, msm_mux_JITTER_BIST,
		  msm_mux_atest_gpsadc_dtest0_native, msm_mux_atest_gpsadc_dtest1_native,
		  msm_mux_phase_flag28, msm_mux_dac_calib22, msm_mux_ddr_pxi2,
		  msm_mux_phase_flag29, msm_mux_dac_calib23, msm_mux_phase_flag30,
		  msm_mux_dac_calib24, msm_mux_ddr_pxi3, msm_mux_pwm_8,
		  msm_mux_phase_flag31, msm_mux_dac_calib25, msm_mux_pwm_9, msm_mux_NA

- bias-disable:
	Usage: optional
	Value type: <none>
	Definition: The specified pins should be configured as no pull.

- bias-pull-down:
	Usage: optional
	Value type: <none>
	Definition: The specified pins should be configured as pull down.

- bias-pull-up:
	Usage: optional
	Value type: <none>
	Definition: The specified pins should be configured as pull up.

- output-high:
	Usage: optional
	Value type: <none>
	Definition: The specified pins are configured in output mode, driven
		    high.
		    Not valid for sdc pins.

- output-low:
	Usage: optional
	Value type: <none>
	Definition: The specified pins are configured in output mode, driven
		    low.
		    Not valid for sdc pins.

- drive-strength:
	Usage: optional
	Value type: <u32>
	Definition: Selects the drive strength for the specified pins, in mA.
		    Valid values are: 2, 4, 6, 8, 10, 12, 14 and 16

Example:

    tlmm: pinctrl@500000 {
      compatible = "qcom,scuba_auto-pinctrl";
      reg = <0x500000 0x300000>;
      interrupts = <GIC_SPI 227 IRQ_TYPE_LEVEL_HIGH>;
      gpio-controller;
      #gpio-cells = <2>;
      interrupt-controller;
      #interrupt-cells = <2>;
      wakeup-parent = <&pdc>;
    };
```

## Documentation/devicetree/bindings/pinctrl/qcom,sdxpinn-pinctrl.yaml
```yaml
# SPDX-License-Identifier: (GPL-2.0-only OR BSD-2-Clause)
%YAML 1.2
---
$id: http://devicetree.org/schemas/bindings/pinctrl/qcom,sdxpinn-pinctrl.yaml#
$schema: http://devicetree.org/meta-schemas/core.yaml#

title: Qualcomm Technologies, Inc. SDXPINN TLMM block

maintainers:
  - Sayan Dey <sayand@qti.qualcomm.com>

description: |
  This binding describes the Top Level Mode Multiplexer block.

properties:
  compatible:
    const: qcom,sdxpinn-pinctrl

  reg:
    items:
      - description: Base address of TLMM register space
      - description: Size of TLMM register space

  interrupts:
    minItems: 0
    maxItems: 1
    items:
      - const: TLMM summary IRQ

  interrupt-controller: true

  '#interrupt-cells':
    const: 2

  gpio-controller: true

  '#gpio-cells':
    const: 2

  wakeup-parent:
    maxItems: 1
    description:
      Please refer to ../gpio/gpio.txt and ../interrupt-controller/interrupts.txt for
      a general description of GPIO and interrupt bindings.

      Please refer to pinctrl-bindings.txt in this directory for details of the
      common pinctrl bindings used by client devices, including the meaning of the
      phrase "pin configuration node".

      The pin configuration nodes act as a container for an arbitrary number of
      subnodes. Each of these subnodes represents some desired configuration for a
      pin, a group, or a list of pins or groups. This configuration can include the
      mux function to select on those pin(s)/group(s), and various pin configuration
      parameters, such as pull-up, drive strength, etc.


# PIN CONFIGURATION NODES
patternPropetries:
  '^.*$':
    if:
      type: object
    then:
      properties:
        pins:
          description:
            List of gpio pins affected by the properties specified in
            this subnode.
          items:
            oneOf:
              - pattern: "^gpio([0-9]|[1-9][0-9]|1[0-9][0-9]|20[0-9])"
              - enum: [ sdc2_clk, sdc2_cmd, sdc2_data, ufs_reset ]
            minItems: 1
            maxItems: 36
        function:
          description:
            Specify the alternative function to be configured for the
            specified pins. Functions are only valid for gpio pins.
          enum: [gpio, ETH0_MDC, ETH0_MDIO, ETH1_MDC, ETH1_MDIO, QLINK0_WMSS_RESET,
            QLINK1_WMSS_RESET, RGMII_RXC, RGMII_RXD0, RGMII_RXD1, RGMII_RXD2, RGMII_RXD3,
            RGMII_RX_CTL, RGMII_TXC, RGMII_TXD0, RGMII_TXD1, RGMII_TXD2, RGMII_TXD3,
            RGMII_TX_CTL, adsp_ext_vfr, atest_char_start, atest_char_status0, atest_char_status1,
            atest_char_status2, atest_char_status3, audio_ref_clk, bimc_dte_test0, bimc_dte_test1,
            char_exec_pending, char_exec_release, coex_uart2_rx, coex_uart2_tx, coex_uart_rx,
            coex_uart_tx, cri_trng_rosc, cri_trng_rosc0, cri_trng_rosc1, dbg_out_clk,
            ddr_bist_complete, ddr_bist_fail, ddr_bist_start, ddr_bist_stop, ddr_pxi0_test,
            ebi0_wrcdc_dq2, ebi0_wrcdc_dq3, ebi2_a_d, ebi2_lcd_cs, ebi2_lcd_reset, ebi2_lcd_te,
            emac0_mcg_pst0, emac0_mcg_pst1, emac0_mcg_pst2, emac0_mcg_pst3, emac0_ptp_aux,
            emac0_ptp_pps, emac1_mcg_pst0, emac1_mcg_pst1, emac1_mcg_pst2, emac1_mcg_pst3,
            emac1_ptp_aux0, emac1_ptp_aux1, emac1_ptp_aux2, emac1_ptp_aux3, emac1_ptp_pps0,
            emac1_ptp_pps1, emac1_ptp_pps2, emac1_ptp_pps3, emac_cdc_dtest0, emac_cdc_dtest1,
            emac_pps_in, ext_dbg_uart, gcc_125_clk, gcc_gp1_clk, gcc_gp2_clk, gcc_gp3_clk,
            gcc_plltest_bypassnl, gcc_plltest_resetn, i2s_mclk, jitter_bist_ref, ldo_en,
            ldo_update, m_voc_ext, mgpi_clk_req, native0, native1, native2, native3,
            native_char_start, native_tsens_osc, native_tsense_pwm1, nav_dr_sync, nav_gpio_0,
            nav_gpio_1, nav_gpio_2, nav_gpio_3, pa_indicator_1, pci_e_rst, pcie0_clkreq_n,
            pcie1_clkreq_n, pcie2_clkreq_n, pll_bist_sync, pll_clk_aux, pll_ref_clk,
            pri_mi2s_data0, pri_mi2s_data1, pri_mi2s_sck, pri_mi2s_ws, prng_rosc_test0,
            prng_rosc_test1, prng_rosc_test2, prng_rosc_test3, qdss_cti_trig0, qdss_cti_trig1,
            qdss_gpio_traceclk, qdss_gpio_tracectl, qdss_gpio_tracedata0, qdss_gpio_tracedata1,
            qdss_gpio_tracedata10, qdss_gpio_tracedata11, qdss_gpio_tracedata12,
            qdss_gpio_tracedata13, qdss_gpio_tracedata14, qdss_gpio_tracedata15,
            qdss_gpio_tracedata2, qdss_gpio_tracedata3, qdss_gpio_tracedata4, qdss_gpio_tracedata5,
            qdss_gpio_tracedata6, qdss_gpio_tracedata7, qdss_gpio_tracedata8, qdss_gpio_tracedata9,
            qlink0_b_en, qlink0_b_req, qlink0_l_en, qlink0_l_req, qlink1_l_en, qlink1_l_req,
            qup_se0_l0, qup_se0_l1, qup_se0_l2, qup_se0_l3, qup_se1_l2, qup_se1_l3, qup_se2_l0,
            qup_se2_l1, qup_se2_l2, qup_se2_l3, qup_se3_l0, qup_se3_l1, qup_se3_l2, qup_se3_l3,
            qup_se4_l2, qup_se4_l3, qup_se5_l0, qup_se5_l1, qup_se6_l0, qup_se6_l1, qup_se6_l2,
            qup_se6_l3, qup_se7_l0, qup_se7_l1, qup_se7_l2, qup_se7_l3, qup_se8_l2, qup_se8_l3,
            sdc1_tb_trig, sdc2_tb_trig, sec_mi2s_data0, sec_mi2s_data1, sec_mi2s_sck, sec_mi2s_ws,
            sgmii_phy_intr0, sgmii_phy_intr1, spmi_coex_clk, spmi_coex_data, spmi_vgi_hwevent,
            tgu_ch0_trigout, tri_mi2s_data0, tri_mi2s_data1, tri_mi2s_sck, tri_mi2s_ws, uim1_clk,
            uim1_data, uim1_present, uim1_reset, uim2_clk, uim2_data, uim2_present, uim2_reset,
            usb2phy_ac_en, vsense_trigger_mirnat]
        drive-strength:
          enum: [2, 4, 6, 8, 10, 12, 14, 16]
          default: 2
          description:
            Selects the drive strength for the specified pins, in mA.
        bias-pull-down: true
        bias-pull-up: true
        bias-disable: true
        output-high: true
        output-low: true
      required:
        - pins
        - function
      additionalProperties: false

examples:
  - |
    tlmm: pinctrl@03000000 {
      compatible = "qcom,sdxpinn-pinctrl";
      reg = <0x03000000 0xdc2000>;
      interrupts = <0 208 0>;
      gpio-controller;
      #gpio-cells = <2>;
      interrupt-controller;
      #interrupt-cells = <2>;
      wakeup-parent = <&pdc>;
    };
```
