## Documentation/devicetree/bindings/misc/l3g4200d.txt
```
l3g4200d Gyro sensor

The L3G4200D is a low-power three-axis angular
rate sensor able to provide unprecedented
stablility of zero rate level and sensitivity over
temperature and time. It includes a sensing
element and an IC interface capable of providing
the measured angular rate to the external world
through a digital interface (I2C/SPI).

Required properties:
	- compatible:	Must be "stm,l3g4200d"
	- reg:		Specifies the I2C address of the part.
	- poll-interval:polling interval in ms.
	- gpios:
			an array specifiying the three required GPIOs for operation.
	Optional Properties:
	- vdd-supply:;       regulator suppy to VDD.

	Example:

		l3g4200d@6A {
			compatible = "stm,l3g4200d";
			reg = <0x6A>;
			vdd-supply = <&pm8226_l19>;
			stm,poll-interval = <200>;
			gpios = <&msmgpio 64 0>; /* DRDY/INT2 */
		};
```

## Documentation/devicetree/bindings/misc/mmi,modbus_switch.txt
```
MMI,MODBUS_SWITCH

The MMI,MODBUS_SWITCH provides ability to control a pair of TS3USB3031 switches
that control the routing of certain data paths on the mod connector to either
the host I2S, MPHY, or USB SS pins.

Required properties:
- compatible : should be "mmi,modbus_switch"
- gpios : should be two selector gpios into SEL0 and SEL1 of the part
- mmi,mod-switch-gpio-labels : should be the labels of the GPIOs to export

Example:
	modbus_switch {
		compatible = "mmi,modbus_switch";

		gpios = <&pm8998_gpios 2 2>,
			<&tlmm 98 2>;

		mmi,mod-switch-gpio-labels = "MOD_MPHY_SEL0",
						"MOD_MPHY_SEL1";
	};
```

## Documentation/devicetree/bindings/misc/mmi,muc-svc.txt
```
Motorola Mobility LLC MUC SVC Device

Required Properties:
- compatible: mmi,muc_svc
- mmi,endo-mask: 16-bit value
	Specifies the mask to pass to the greybus core when describing our
	simulated software 'endo' which describes which interfaces are available
	in the device.

Optional Properties:
- mmi,use-authentication: boolean
	Specify this property to enable authentication of a module's manifest.
	When enabled, the SVC Hotplug message will not be sent until user
	space directs the module to do so via sysfs interface. If left out,
	authentication is disabled by default.

Example:
	muc_svc@0 {
		compatible = "mmi,muc_svc";

		mmi,use-authentication;
		mmi,endo-mask = <0x4755>;
	};
```

## Documentation/devicetree/bindings/misc/moto-slice.txt
```
Motorola Slice detachable battery accessory

This device describes the interface used when connecting a Slice accessory.

Required properties:
 - compatible: Should be "mmi,slice-accessory".
 - qcom,slice-detect-gpio: phandle to a GPIO node corresponding to the input
                         signal indicating when the slice is connected
 - qcom,usb-host: phandle to the i2c bus adapter connected to the slice port

Optional properties:
```

## Documentation/devicetree/bindings/misc/smelt-dock.txt
```
Smelt dock detection

Required properties:
- compatible:		Must be "mmi,smelt-dock".
- gpio:			GPIO indicating docked status.

Optional properties:
- charger-name:		Name of wireless charger power_supply device.
- switch-name:		Name of dock switch device.
- active_low:		Define this property if GPIO is active low.
- supplied_to:		Names of the batteries this charger supplies power to.
- num_supplicants:	Number of entries in the supplied_to array.
- debounce_window,s:	Duration debouncing is enabled when turned on (in sec).
- debounce_duration,ms: Debounce duration for an undock event (in ms).
- suspend_delay,ms:	Duration device suspend is prevented after dock/undock events (in ms).

Example:

	dock {
		compatible = "mmi,smelt-dock";
		charger-name = "wireless";
		switch-name = "dock";
		gpio = <&msmgpio 54 0>;
		active_low;
		supplied_to = "max170xx_battery";
		debounce-window,s = <3>;
		debounce-duration,ms = <1800>;
		suspend-delay,ms = <2000>;
	};
```

## Documentation/devicetree/bindings/misc/ti-drv2624.txt
```
* TI DRV2624

DRV2624 Ultra Low Power Closed-Loop LRA/ERM Haptic Driver with Internal Memory

Required properties:
- compatible: the string of "ti,drv2624"
- reg: the i2c slave address of the IC
- ti,rated_voltage: 8 bit, rated voltage register setting
- ti,overdrive_voltage: 8 bit, overdrive voltage register setting

Optional:
- ti,nrst-gpio: GPIO connected to DRV2624 NRST. If not in use NRST should be connected to Vdd
- ti,intz-gpio: GPIO connected to DRV2624 TRIG/INTZ. If not in use INTZ should be connected to ground
- ti,auto_cal: boolean, enable boot-up calibration. Disabled by default
- ti,lra_drive: boolean, when selected configures LRA actuator type, otherwise actuator type is ERM
- ti,open_loop: boolean, when selected configures open loop drive, otherwise closed loop drive
- ti,nvctrl-gpio: GPIO to indicate state for context aware vibration experience
- ti,rated_voltage_reduced: 8 bit, reduced value of rated voltage register setting
- ti,overdrive_voltage_reduced: 8 bit, reduced value of overdrive voltage register setting
- ti,sample_time: 8 bit, sample time register setting
- ti,drive_time; 8 bit, drive time register setting (applied by mask 0x1F)

Example:

drv2624@5A {
	compatible = "ti,drv2624";
	reg = <0x5A>;
	ti,rated_voltage = /bits/ 8 <0x6D>;
	ti,overdrive_voltage = /bits/ 8 <0xF0>;
	ti,lra_drive;
	ti,auto_cal;
};
```

## Documentation/devicetree/bindings/misc/ti-msp430.txt
```
* TI MSP430

The MSP430 microcontrollers are Ultra-Low-Power mixed signal, 16-Bit RISC Core devices.

Required properties:
 - compatible:
        the string of "ti,msp430"
 - reg:
        the i2c slave address of the IC
 - gpios:
        an array specifiying the three required GPIOs for operation. They must
        be specified in exact order:
           - IRQ GPIO
           - RESET GPIO
           - BSLEN GPIO
           - WakeIRQ
                Optional GPIO, If this line is not connected, input <0> here
           - MIPI_REQ
                Optional GPIO, If this line is not connected, input <0> here
           - MIPI_BUSY
                Optional GPIO, If this line is not connected, input <0> here

 - lux_table:
        an array to define the ambiment light lux level, according to this
        lux level, if the LCD brightness set as automatic, the LCD brightness
        will be set according to the value defined in brightness_table

 - brightness_table:
        an array to define which the LCD brightness(0~255 scale) will be set
        according to the ambient light strength (in lux) defined in lux_table

 - bslen_pin_active_value:
        specify bslen pin active high or active low for enable

Example:

	msp430@48 {
		compatible = "ti,msp430";
		reg = <0x48>;
		gpios = <&msmgpio 69 0>,     /* IRQ */
			<&msmgpio 92 0>,     /* RESET */
			<&msmgpio 51 0>,     /* BSLEN */
			<&pm8921_gpio 7 0>,  /* WakeIRQ */
			<&pm8921_gpio 11 0>, /* MIPI_REQ */
			<&pm8921_gpio 12 0>; /* MIPI_BUSY */
		lux_table = <5 50 100 3000 8000>;
		brightness_table = <25 42 68 127 178 246>;
		bslen_pin_active_value = <1>;
	};
```

## Documentation/devicetree/bindings/misc/tusb1064.txt
```
TUSB1064-MISC

TUSB1064-MISC provides a way to configure TUSB1064 part.

Required properties:
- compatible : should be "ti,tubs1064"
- reg : address of i2c of tusb1064.

Optional properties:
Example:
	tusb1064@10 {
		compatible = "ti,tusb1064";
		reg = <0x10>;
	};
```

## Documentation/devicetree/bindings/misc/utags.txt
```
MMI utags driver provides procfs access to the utags partition.

Required properties:
- compatible		: string should be "mmi,utags"
- mmi,utoags-main	: string, path to the utags main partition
Optional properties:
- mmi,utags-backup	: string, path to the utags backup partition
- mmi,dir-name		: string, override for directory in procfs root to be used

Example:

utags@1 {
	compatible = "mmi,utags";
	status = "okay";
	mmi,dir-name = "hwid";
	mmi,utags-main = "/dev/block/bootdevice/by-name/utags";
	mmi,utags-backup = "/dev/block/bootdevice/by-name/utagsBackup";
};
```

## Documentation/devicetree/bindings/misc/vxr7200.txt
```
VXR7200-MISC

VXR7200-MISC provides a way to configure VXR7200 part.

Required properties:
- compatible : should be "synaptics,vxr7200"
- reg : address of i2c of vxr7200.

Optional properties:
Example:
	vxr7200@39 {
		compatible = "synaptics,tvxr7200";
		reg = <0x39>;
	};
```

## Documentation/devicetree/bindings/misc/xr-smrtvwr-misc.txt
```
XR-SMRTVWR-MISC

XR-SMRTVWR-MISC provides a way to configure xrsmrtvwr-misc driver.

Required properties:
- compatible : should be "qcom,xr-smrtvwr-misc"

Optional properties:
Example:
	qcom,xr-smrtvwr-misc {
		compatible = "qcom,xr-smrtvwr-misc";
	};
```

## Documentation/devicetree/bindings/mmi/Display.txt
```
Display

The device tree bindings for Motorola's handling of display panels
represent a direct copy from the legacy code.  This definition will
(hopefully) be in flux as it is brought in-line with current practice.

Multiple Display nodes (currently up to 10) can be defined, but only
one will be used based on the matching panel_name.

Required properties:

- panel_name:  parallels the general use of the compatible node.
      This entry is compared with the /chosen/mmi,panel_name entry and
      only the Display node with the matching panel_name will be registered.

- disp_intf: determines if this display is command mode (4) or
      video mode (6).

The rest of the parameters model gpio input pins.  These fall into three classes
reset (rst), fixed regulators (reg) and mipi selection (mipi_d0_sel).  For each
class the same set of gpio properties are supported, so much of the content below
is not only vague but also redundant.

- num_disp_rst: defines the number of reset entries that will follow, if this
      parameter is not defined it is assumed one stanza of "rst" entries will
      follow.

- rst_gpio_<n>: the gpio number for this reset line.
- rst_gpio_type_<n>: the gpio source will either be 0, for a standard gpio or 1
      for a pmic gpio.
- rst_init_state_<n>: initial state of the pin (0 or 1)
- rst_en_state_<n>: state, 0 or 1, representing enabled
- rst_en_pre_delay_<n>: time in millisec to delay before enabling this pin
- rst_en_post_delay_<n>: time in millisec to delay after enabling this pin
- rst_dis_pre_delay_<n>: time in millisec to delay before disabling this pin
- rst_dis_post_delay_<n>: time in millisec to delay after disabling this pin

- num_disp_reg: defines the number of regulator entries that will follow, if this
      parameter is not defined it is assumed one stanza of "reg" entries will
      follow.  stanza for class = reg

- reg_gpio_<n>: the gpio number for this gpio regulator-like device.
- reg_gpio_type_<n>: the gpio source will either be 0, for a standard gpio or 1
      for a pmic gpio.
- reg_init_state_<n>: initial state of the pin (0 or 1)
- reg_en_state_<n>: state, 0 or 1, representing enabled
- reg_en_pre_delay_<n>: time in millisec to delay before enabling this pin
- reg_en_post_delay_<n>: time in millisec to delay after enabling this pin
- reg_dis_pre_delay_<n>: time in millisec to delay before disabling this pin
- reg_dis_post_delay_<n>: time in millisec to delay after disabling this pin
- reg_shared_gpio_en_<n>: ?

num_disp_mipi_d0_sel: defines the number of mipi_d0_sel entries that will follow, if
       this parameter is not defined it defaults to 1.

- mipi_d0_sel_gpio_<n>: the gpio number associated.
- mipi_d0_sel_gpio_type_<n>: the gpio source will either be 0, for a standard gpio
        or 1 for a pmic gpio.
- mipi_d0_sel_init_state_<n>: initial state of the pin (0 or 1)
- mipi_d0_sel_en_state_<n>: state, 0 or 1, representing enabled
- mipi_d0_sel_en_pre_delay_<n>: time in millisec to delay before enabling this pin
- mipi_d0_sel_en_post_delay_<n>: time in millisec to delay after enabling this pin
- mipi_d0_sel_dis_pre_delay_<n>:  time in millisec to delay before disabling this pin
- mipi_d0_sel_dis_post_delay_<n>:  time in millisec to delay after disabling this pin
- mipi_d0_sel_shared_gpio_en_<n>:

- partial_mode_supported:

Example:

	System@0 {
		Display@0 {
			panel_name = "mipi_mot_cmd_smd_hd_465";
			disp_intf = <4>;  /* MIPI_VP_CM */

			num_disp_rst = <1>;

			rst_gpio_1 = <37>;
			rst_gpio_type_1 = <1>;   /* PM_GPIO */
			rst_init_state_1 = <1>;
			rst_en_state_1 = <1>;
			rst_en_pre_delay_1 = <15>;
			rst_en_post_delay_1 = <15>;
			rst_dis_post_delay_1 = <10>;

			num_disp_reg = <3>;

			/* Display's VDDIO reg */
			reg_id_1 = "dsi_s4";
			reg_name_1 = "VDD_DISP_CONN";
			reg_min_mv_1 = <1800000>;
			reg_max_mv_1 = <1800000>;
			reg_gpio_en_1 = <12>;
			reg_gpio_name_1 = "DISP_V2_EN";
			reg_gpio_en_type_1 = <0>;   /* MSM_GPIO */
			reg_gpio_en_init_state_1 = <1>;
			reg_gpio_en_state_1 = <1>;

			/* Display's VCI reg */
			reg_id_2 = "disp_vci";
			reg_name_2 = "VCI_DISP_CONN";
			reg_min_mv_2 = <3100000>;
			reg_max_mv_2 = <3100000>;
			reg_gpio_en_2 = <0x90>;
			reg_gpio_name_2 = "DISP_V3_EN";
			reg_gpio_en_type_2 = <0>;   /* MSM_GPIO */
			reg_gpio_en_init_state_2 = <1>;
			reg_gpio_en_state_2 = <1>;

			reg_id_3 = "";
			reg_name_3 = "VBATT_DISP_CONN";
			reg_gpio_en_3 = <13>;
			reg_gpio_name_3 = "DISP_V1_EN";
			reg_gpio_en_init_state_3 = <1>;
			reg_gpio_en_state_3 = <1>;
			reg_gpio_en_type_3 = <0>;

			mipi_d0_sel_gpio_1 = <10>;
			mipi_d0_sel_name_1 = "mipi_d0_sel";
			mipi_d0_sel_gpio_type_1 = <1>;  /* PM_GPIO */
			mipi_d0_sel_init_state_1 = <0>;
			mipi_d0_sel_en_state_1 = <0>;
			mipi_d0_sel_en_pre_delay_1 = <0>;
			mipi_d0_sel_en_post_delay_1 = <0>;
			mipi_d0_sel_dis_pre_delay_1 = <0>;
			mipi_d0_sel_dis_post_delay_1 = <0>;

			partial_mode_supported = <1>;
		};
	};
```

## Documentation/devicetree/bindings/mmi/mmi-factory-driver.txt
```
mmi-factory-driver

This is a mechanism to use the standard device tree to export the GPIOs
required in factory test environments. It is dependent upon environment
variable of /chosen/mmi,factory-cable being present.  If the property
does not exist, the platform driver will not probe.

Required properties:
- compatible: "mmi,factory-support-msm8960"

- gpios: array of GPIOs and GPIOF flags to request, configure, and export by
    the driver.  The flags are standard GPIO flag bitmasks:

        GPIOF_DIR_OUT           (0 << 0)
        GPIOF_DIR_IN            (1 << 0)
        GPIOF_INIT_LOW          (0 << 1)
        GPIOF_INIT_HIGH         (1 << 1)
        GPIOF_OPEN_DRAIN        (1 << 2)
        GPIOF_OPEN_SOURCE       (1 << 3)

- gpio-names: matching label to apply to the above GPIO list. It must contain
    same number of entries as the gpio array.

Example:

factory_support {
	compatible = "mmi,factory-support-msm8960";

	gpios = <&msmgpio 75 0x2>, /* GPIOF_DIR_OUT | GPIOF_INIT_HIGH */
		<&msmgpio 98 0x1>; /* GPIOF_DIR_IN */
	gpio-names = "factory_kill_disable",
		     "temp_sensor";
};
```
