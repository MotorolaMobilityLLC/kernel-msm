## Documentation/devicetree/bindings/usb/qcom,usb-m31-eusb2-phy.txt
```
Qualcomm Technologies, Inc. eUSB2 M31 USB HSPHY

Required properties:
 - compatible: Should be "qcom,usb-m31-eusb2-phy"
 - reg: Address and length of the register set for the device
   Required regs are:
	"eusb2_phy_base" : the base register for the PHY
	"eud_detect_reg" : VIOCTL_EUD_DETECT register

 - <supply-name>-supply: phandle to the regulator device tree node
   Required "supply-name" examples are:
	"vdd" : vdd supply for HSPHY digital circuit operation
	"vdda12" : 1.2v supply for HSPHY
 - clocks: a list of phandles to the PHY clocks. Use as per
   Documentation/devicetree/bindings/clock/clock-bindings.txt
   Required clocks are:
	"ref_clk_src" : the XO clock for eusb2_phy
	"ref_clk"     : the repeater/receiver(abstracted as clock)

 - clock-names: Names of the clocks in 1-1 correspondence with the "clocks"
   property. "ref_clk_src" & "ref_clk" are mandatory clocks.
 - qcom,vdd-voltage-level: This property must be a list of three integer
   values (no, min, max) where each value represents either a voltage in
   microvolts or a value corresponding to voltage corner.
 - resets: reset specifier pair consists of phandle for the reset controller
   and reset lines used by this controller.
 - reset-names: reset signal name strings sorted in the same order as the resets
   property.
 - usb-repeater: phandle to eUSB2 repeater which is used with eUSB2 HSPHY for USB
   functionality.
 - reg-names: Names of the registers in 1-1 correspondence with "reg".

Optional properties:
 - qcom,param-override-seq: parameter override sequence with value, reg offset
   pair.
 - reg: Address and length of the register set for the device
   Optional regs are:
        "eud_enable_reg" : register address to read eud enable/disable status.
 - dummy-supply: phandle to eUSB2 repeater for enforcing probe ordering for
   eUSB2 repeater and eUSB2 PHY driver.

Example:
	hsphy@88e3000 {
		compatible = "qcom,usb-m31-eusb2-phy";
		reg = <0x88e3000 0x154>;
		reg-names = "eusb2_phy_base";
		vdd-supply = <&pm8841_s2_corner>;
		vdda12-supply = <&pm8941_l6>;
		qcom,vdd-voltage-level = <0 880000 880000>;
		qcom,param-override-seq = <0x43 0x70>;
		usb-repeater= <&pm8550b_eusb2_repeater>;
		clocks = <&rpmhcc RPMH_CXO_PAD_CLK>,
			<&tcsrcc TCSR_USB2_CLKREF_EN>;
		clock-names = "ref_clk_src", "ref_clk";
		resets = <&gcc GCC_QUSB2PHY_PRIM_BCR>;
		reset-names = "phy_reset";
	};
```

## Documentation/devicetree/bindings/video/backlight/ti-lm3630a.txt
```
Texas Instrument LM3630A Backlight Controller

Required Properties:
 - compatible:
        Should be set to "ti,lm3630a"
 - reg:
        The i2c slave address of the IC

Optional Properties:
 - ti,vddio-name:
        Regulator supply name for the IC's VDD if required
 - ti,irq-gpio:
        Interrupt gpio pin for the IC's INTN if required
 - ti,hwen-gpio:
        Hardware enable pin for the IC's HWEN if required
 - ti,pwm-gpio:
        PWM gpio pin for the IC's PWM control if required
 - ti,leda-ctrl:
        The settings are related to LEDA enable/disable and output
        mode, which will be programmed to REG_CTRL (0x00) bit 2 and
        bit 4.
 - ti,ledb-ctrl:
        The settings are related to LEDB enable/disable and output
        mode, which will be programmed to REG_CTRL (0x00) bit 0,
        bit 1 and bit 3.
 - ti,boost-ctrl:
        The settings are related to over-voltage, over-current and
        boost frequency etc, which will be programed to REG_BOOST
        (0x02).
 - ti,pwm-ctrl:
        The PWM settings to enable/disable and active level, and
        will be programed to REG_CONFIG (0x01) 3 lowest bits.
 - ti,leda-init-brt:
        LEDA power up brightness to set during first initialization.
        If not supplied it will be set to 0xFF. This value is
        programmed to the REG_BRT_A (0x03) register.
 - ti,ledb-init-brt:
        LEDB power up brightness to set during first initialization.
        If not supplied it will be set to 0xFF. This value is
        programmed to the REG_BRT_B (0x04) register.
 - ti,leda-max-brt:
        Maximum allowable brightness value to program to REG_BRT_A
        (0x03). If not supplied 0xFF will be used.
 - ti,ledb-max-brt:
        Maximum allowable brightness value to program to REG_BRT_B
        (0x04). If not supplied 0xFF will be used.
 - ti,leda-max-cur:
        Maximum allowable current value while setting backlight
        brightness value as 0xFF. It will be programmed to REG_I_A
        (0x05) 5 lowest bits.
 - ti,ledb-max-cur:
        Maximum allowable current value while setting backlight
        brightness value as 0xFF. It will be programmed to REG_I_B
        (0x06) 5 lowest bits.

Example:
	lm3630a@38 {
		status = "okay";
		compatible = "ti,lm3630a";
		reg = <0x38>;

		/* 2 string LEDs controled by LEDA */
		ti,leda-ctrl = <0x14>;
		ti,ledb-ctrl = <0x01>;
		ti,leda-max-brt = <0xff>;
		ti,ledb-max-brt = <0xff>;
		ti,leda-init-brt = <0xf0>;
		ti,ledb-init-brt = <0xf0>;
		ti,leda-max-cur = <0x19>;
		ti,ledb-max-cur = <0x19>;
		ti,boost-ctrl = <0x20>;
		ti,pwm-ctrl = <0x00>;
		ti,irq-gpio = <&msmgpio 4 0>;
		ti,hwen-gpio = <&msmgpio 5 0>;
		ti,vddio-name = "vddio_bl";
		vddio_bl-supply = <&pm8226_l6>;
	};
```

## Documentation/devicetree/bindings/video/backlight/ti-lmu-backlight.txt
```
TI LMU backlight device tree bindings

Required properties:
  - compatible: One of lists below with "ti,lmu-backlight" should be set.
    "ti,lm3532-backlight"
    "ti,lm3631-backlight"
    "ti,lm3633-backlight"
    "ti,lm3695-backlight"
    "ti,lm3697-backlight"
  - hvled1-used, hvled2-used, hvled3-used: Backlight string configuration.
    Each backlight child node should include this information about
    which backlight string is used.

Optional properties
  - bl-name: Backlight device name
  - max-current-milliamp: Max current setting. Unit is mA.
  - initial-brightness: Backlight initial brightness
  - ramp-up: Light effect for ramp up rate. Unit is msec.
  - ramp-down: Light effect for ramp down rate. Unit is msec.
  - pwm-period: PWM period. Only valid for PWM brightness control mode.
  - pwms, pwm-names: For the PWM user nodes, please refer to
    Documentation/devicetree/bindings/pwm/pwm.txt

Examples:

lm3532@38 {
	compatible = "ti,lm3532";
	reg = <0x38>;

	ti,enable-gpio = <&gpio5 6 GPIO_ACTIVE_HIGH>;

	backlight {
		compatible = "ti,lmu-backlight", "ti,lm3532-backlight";

		lcd {
			hvled1-used;
			hvled2-used;
			hvled3-used;

			max-current-milliamp = /bits/ 8 <20>;
		};
	};
};

lm3631@29 {
	compatible = "ti,lm3631";
	reg = <0x29>;

	ti,enable-gpio = <&gpio5 6 GPIO_ACTIVE_HIGH>;

	backlight {
		compatible = "ti,lmu-backlight", "ti,lm3631-backlight";

		lcd_bl {
			bl-name = "lcd";
			hvled1-used;
			hvled2-used;
			ramp-up = <100>;
		};
	};
};

lm3633@36 {
	compatible = "ti,lm3633";
	reg = <0x36>;

	ti,enable-gpio = <&gpio5 6 GPIO_ACTIVE_HIGH>;

	backlight {
		compatible = "ti,lmu-backlight", "ti,lm3633-backlight";

		main {
			bl-name = "main_lcd";
			hvled2-used;
			hvled3-used;
			max-current-milliamp = /bits/ 8 <20>;
		};

		front {
			bl-name = "front_lcd";
			hvled1-used;
			max-current-milliamp = /bits/ 8 <10>;
		};
	};
};

lm3695@63 {
	compatible = "ti,lm3695";
	reg = <0x63>;

	ti,enable-gpio = <&gpio5 6 GPIO_ACTIVE_HIGH>;

	backlight {
		compatible = "ti,lmu-backlight", "ti,lm3695-backlight";

		lcd {
			hvled1-used;
			hvled2-used;
		};
	};
};

lm3697@36 {
	compatible = "ti,lm3697";
	reg = <0x36>;

	ti,enable-gpio = <&gpio5 6 GPIO_ACTIVE_HIGH>;

	pwms = <&pwm3943 1 10000>;
	pwm-names = "lmu-backlight";
	backlight {
		compatible = "ti,lmu-backlight", "ti,lm3697-backlight";

		lcd {
			hvled1-used;
			hvled2-used;
			hvled3-used;

			max-current-milliamp = /bits/ 8 <20>;
			initial-brightness = /bits/ 8 <10>;

			ramp-up = <500>;
			ramp-down = <500>;
			pwm-period = <10000>;
		};
	};
};
```

## Documentation/devicetree/bindings/video/backlight/ti-lp8556.txt
```
Texas Instrument LP8556 Backlight Controller

Required Properties:
 - compatible:
        should be set to "ti,lp8556"
 - reg:
        the i2c slave address of the IC
 - gpios:
        entry specifying the enable pin (EN_VDDIO) of the IC.

Optional Properties:
 - vddio-supply:
        phandle to the IC's regulator supply for VDD if required
 - ti,lp8556-initial-brightness:
        power up brightness to set during first initialization. If not
        supplied it will be set to 0x00. This value is programmed to
        the BRT_CTRL_REG (0x00) register.
 - ti,lp8556-dev-ctrl-config:
        initial setting for device control register.  If it is not
        supplied 0x00 will be used. This value is programmed to the
        DEVICE_CTRL_REG (0x01) register.
 - ti,lp8556-direct-ctrl:
        initial setting for the direct control register.  If it is not
        supplied 0x00 will be programmed.  The value is programmed into
        the DIRECT_CTRL_REG (0x04) register.
 - ti,lp8556-eeprom-settings:
        initial firmware control register array.  This is an array of
        register address and value pairs to be progammed into the EEPROM
        register space [registers 0x98 to 0xaf].  They should be of the
        format of: <addr> <value>.

Example:

lp8556@2c {
	compatible = "ti,lp8556";
	reg = <0x2c>;
	gpios = <&msmgpio 52 0>;  /* enable GPIO */

	ti,lp8556-initial-brightness = <0x3a>;
	ti,lp8556-dev-ctrl-config = <0x84>;
	ti,lp8556-eeprom-settings = <0x9e 0x02
				     0xa5 0x3c
				     0xa6 0x40
				     0xa7 0xfc>;
};
```

## Documentation/devicetree/bindings/virtio/qcom,virtio-mem.yaml
```yaml
%YAML 1.2
---
$id: "http://devicetree.org/schemas/soc/qcom/qcom,secure-buffer.yaml#"
$schema: "http://devicetree.org/meta-schemas/core.yaml#"

title: Qualcomm Technologies, Inc. Virtio-Mem bindings

description: |
  QCOM virtio mem driver supports Guest initiated memory hotplug operations
  which transfer memory from Host to Guest.

properties:
  compatible:
    items:
      - const: qcom,virtio-mem

  reg:
    description:
      Physical address and size of hotpluggable region. Must be aligned
      to memory_block_size_bytes() - 128 Mb on arm64.

  qcom,block_size:
    description:
      Minimum transfer size in bytes. Should be multiple of PAGE_SIZE.

required:
  - compatible
  - qcom,block-size

example:
	virtio_mem_device {
		compatible = "qcom,virtio-mem";
		reg = <0x60000000 0x10000000>;
		qcom,block_size = <0x400000>;
	};
```

## Kconfig
```kconfig
#
# For a description of the syntax of this configuration file,
# see Documentation/kbuild/kconfig-language.txt.
#
mainmenu "Linux/$ARCH $KERNELVERSION Kernel Configuration"

config SRCARCH
	string
	option env="SRCARCH"

config PARSE_RECOVERY_RESET_COMMAND
	bool "Redirect recovery factory reset to asus oem factory reset"

source "arch/$SRCARCH/Kconfig"
```
