## Documentation/devicetree/bindings/sound/nxp-tfa9890.txt
```
* NXP TFA9890

The TFA9890 is a high efficiency class-D audio amplifier with a sophisticated
SpeakerBoost protection algorithm

Required properties:
 - compatible:
		the string of "nxp,tfa9890"
 - reg:
		the i2c slave address of the IC
 - gpios:
		an array specifiying the two required GPIOs for operation.
			- RESET GPIO
 - tfa_vd-supply:
		specify the regulator it uses.
 - tfa-dev:
		specifies if its a Left IC or Right IC in stereo configuration

Example:
		tfa9890@34 {
			compatible = "nxp,tfa9890";
			reg = <0x34>;
			gpios = <&pm8921_gpio 18 0>;     /* RESET */
			tfa_vdd-supply = <&rpm_8921_s4>;
			nxp,tfa-dev = "left";
		};
```

## Documentation/devicetree/bindings/sound/ospl2xx.txt
```
Motorola interface driver for Opalum Speaker Protection

This device supports interfacing between the module in DSP and the client in AP.

Required properties:

- compatible : "mmi,ospl2xx";
- mmi,ospl-afe-port-id : module rx port id and module tx port id
- mmi,ospl-left-feedback and/or mmi,ospl-right-feedback : at least one of feedback
  channel at module tx port should be specified.

Optional properties:

- mmi,ospl-tune-index : indexes for the tuning table in Qualcomm DSP, if not
  specified, default tuning tables located at first index will be used.
- mmi,ospl-volume-control : OSPL in DSP supports volume control

Examples:

ospl {
	compatible = "mmi,ospl2xx";
	status = "ok";
	mmi,ospl-tune-index = <4 5 6 7>;
	mmi,ospl-afe-port-id = <16384 16387>;
	mmi,ospl-left-feedback;
	mmi,ospl-volume-control;
};
```

## Documentation/devicetree/bindings/sound/qcom-audio-dev.txt
```
Qualcomm audio devices for ALSA sound SoC

* msm-pcm

Required properties:

 - compatible : "qcom,msm-pcm-dsp"

* msm-pcm-routing

Required properties:

 - compatible : "qcom,msm-pcm-routing"

* msm-pcm-lpa

Required properties:

 - compatible : "qcom,msm-pcm-lpa"

* msm-compr-dsp

Required properties:

 - compatible : "qcom,msm-compr-dsp"

* msm-voip-dsp

Required properties:

 - compatible : "qcom,msm-voip-dsp"

* msm-stub-codec

Required properties:

 - compatible : "qcom,msm-stub-codec"

* msm-dai-fe

Required properties:

 - compatible : "qcom,msm-dai-fe"

* msm-dai-q6

[First Level Nodes]

Required properties:

 - compatible : "msm-dai-q6"

[Second Level Nodes]

Required properties:

 - compatible : "qcom,msm-dai-q6-dev"
 - qcom,msm-dai-q6-dev-id : The slimbus multi channel port ID
                            Value is from 16384 to 16393

* msm-auxpcm

[First Level Nodes]

Required properties:

 - compatible :                           "qcom,msm-auxpcm-resource"

 - qcom,msm-cpudai-auxpcm-clk:            clock for auxpcm

 - qcom,msm-cpudai-auxpcm-mode:           mode information
                                          0 - for PCM

 - qcom,msm-cpudai-auxpcm-sync:           sync information

 - qcom,msm-cpudai-auxpcm-frame:          No.of bytes per frame
                                          5 - 256BPF

 - qcom,msm-cpudai-auxpcm-quant:          Type of quantization
                                          2 - Linear quantization

 - qcom,msm-cpudai-auxpcm-slot:           Slot number for multichannel scenario
                                          Value is 1

 - qcom,msm-cpudai-auxpcm-data:           Data field - 0

 - qcom,msm-cpudai-auxpcm-pcm-clk-rate:   Clock rate for pcm - 2048000

[Second Level Nodes]

Required Properties:

 - qcom,msm-auxpcm-dev-id:                This property specifies the device
                                          port id.
                                          For Rx device, the port id is 4106
                                          and for Tx device, the port id is 4107

 - compatible:                            "qcom,msm-auxpcm-dev"

* msm-pcm-hostless

Required properties:

 - compatible : "qcom,msm-pcm-hostless"

* msm-ocmem-audio

Required properties:

 - compatible :                            "qcom,msm-ocmem-audio"

 - qcom,msm_bus,name:                      Client name

 - qcom,msm_bus,num_cases:                 Total number of use cases

 - qcom,msm_bus,active_only:               Context flag for requests in active or
                                           dual (active & sleep) contex

 - qcom,msm_bus,num_paths:                 Total number of master-slave pairs

 - qcom,msm_bus,vectors:                   Arrays of unsigned integers representing:
                                           master-id, slave-id, arbitrated bandwidth,
                                           instantaneous bandwidth
Example:

        qcom,msm-pcm {
                compatible = "qcom,msm-pcm-dsp";
        };

        qcom,msm-pcm-routing {
                compatible = "qcom,msm-pcm-routing";
        };

        qcom,msm-pcm-lpa {
                compatible = "qcom,msm-pcm-lpa";
        };

        qcom,msm-compr-dsp {
                compatible = "qcom,msm-compr-dsp";
        };

        qcom,msm-voip-dsp {
                compatible = "qcom,msm-voip-dsp";
        };

        qcom,msm-stub-codec {
                compatible = "qcom,msm-stub-codec";
        };

        qcom,msm-dai-fe {
                compatible = "qcom,msm-dai-fe";
        };

	qcom,msm-dai-q6 {
		compatible = "qcom,msm-dai-q6";
		qcom,msm-dai-q6-sb-0-rx {
			compatible = "qcom,msm-dai-q6-dev";
			qcom,msm-dai-q6-dev-id = <16384>;
		};

		qcom,msm-dai-q6-sb-0-tx {
			compatible = "qcom,msm-dai-q6-dev";
			qcom,msm-dai-q6-dev-id = <16385>;
		};
	};

        qcom,msm-auxpcm {
                compatible = "qcom,msm-auxpcm-resource";
                qcom,msm-cpudai-auxpcm-clk = "pcm_clk";
                qcom,msm-cpudai-auxpcm-mode = <0>;
                qcom,msm-cpudai-auxpcm-sync = <1>;
                qcom,msm-cpudai-auxpcm-frame = <5>;
                qcom,msm-cpudai-auxpcm-quant = <2>;
                qcom,msm-cpudai-auxpcm-slot = <1>;
                qcom,msm-cpudai-auxpcm-data = <0>;
                qcom,msm-cpudai-auxpcm-pcm-clk-rate = <2048000>;

                qcom,msm-auxpcm-rx {
                        qcom,msm-auxpcm-dev-id = <4106>;
                        compatible = "qcom,msm-auxpcm-dev";
                };

                qcom,msm-auxpcm-tx {
                        qcom,msm-auxpcm-dev-id = <4107>;
                        compatible = "qcom,msm-auxpcm-dev";
                };
        };

        qcom,msm-pcm-hostless {
                compatible = "qcom,msm-pcm-hostless";
        };

	qcom,msm-ocmem-audio {
		compatible = "qcom,msm-ocmem-audio";
		qcom,msm_bus,name = "audio-ocmem";
		qcom,msm_bus,num_cases = <2>;
		qcom,msm_bus,active_only = <0>;
		qcom,msm_bus,num_paths = <1>;
		qcom,msm_bus,vectors =
			<11 604 0 0>,
			<11 604 32505856 325058560>;
	};
```

## Documentation/devicetree/bindings/sound/qcom-msm8960-asoc.txt
```
* MSM8960 ASoC Machine driver

Required properties:
- compatible : "qcom,msm8960-soc-audio"

Optional properties:
- qcom,msm8960-card-longname :
    This property will be used to fill in the long_name of the standard
    snd_soc_card structures.  It is visible in the /proc/asound/cards entry
    for user space to identify specific codecs available to it
- gpios-pri-i2s :
    This GPIO list is used to request the necessary GPIOs for the Primary I2S
    TX Path.  It should consist of the neccessary GPIOs to be requested and
    placed in their active configuration.  The necessary GPIOs can vary based
    on the device.
- gpios-pri-i2s-names :
    This is a required property if gpios-pri-i2s is provided above.  It must
    provide the corresponding GPIO labels to match with the above defined
    GPIOs.
- gpios-mi2s :
    This GPIO list is used to request the necessary GPIOs for the MI2S Path. It
    should consist of the necessary GPIOs to be requested and placed in their
    active configuration.  The necessary GPIOs can vary based on the device.
- gpios-mi2s-names :
    This is a required property if gpios-mi2s is provided above.  It must
    provide the corresponding GPIO labels to match with the above defined GPIOS

Optional Children:

* DAI Links:

Required properties:
- compatible :
    "qcom,msm8960-dai-link"
- qcom,msm8960-codec-name :
    codec name to match in dynamic DAI link table that can differ from device
    to device.  This string needs to match the 'codec_dai_name' field in order
    for the link to be initialized.

Example:

sound {
	status = "okay";
	compatible = "qcom,msm8960-soc-audio";

	qcom,msm8960-card-longname = "msm8960-snd-card-wcd,tfa9890_codec";

	/* Primary I2S TX */
	gpios-pri-i2s = <&msmgpio 55 0>, /* SCK */
			<&msmgpio 56 0>, /* WS */
			<&msmgpio 57 0>; /* DIN */
	gpios-pri-i2s-names = "pri-i2s-sck",
			      "pri-i2s-ws",
			      "pri-i2s-din";

	/* MI2S */
	gpios-mi2s = <&msmgpio 47 0>, /* WS   */
		     <&msmgpio 48 0>, /* SCK  */
		     <&msmgpio 49 0>, /* DIN  */
		     <&msmgpio 50 0>, /* DOUT */
		     <&msmgpio 53 0>; /* MCLK */
	gpios-mi2s-names = "mi2s_ws",
			  "mi2s_sck",
			  "mi2s_din",
			  "mi2s_dout",
			  "mi2s_mclk";

	/* DAI Links */
	dai-msm-stub-tx {
		compatible = "qcom,msm8960-dai-link";
		qcom,msm8960-codec-name = "msm-stub-tx";
	};

	dai-tfa9890 {
		compatible = "qcom,msm8960-dai-link";
		qcom,msm8960-codec-name = "tfa9890_codec";
	};
};

* MSM DAI Q6 MI2S

Required properties:
- compatible :
    "qcom,msm-dai-q6-mi2s"
- qcom,msm-mi2s-rx-lines :
    This property describes the SD lines allocated to RX on the MI2S interface.
    This should be expressed as a bitmask and should not overlap those
    allocated in the TX definition.  The masks are defined with the following:
        MSM_MI2S_SD0    1
        MSM_MI2S_SD1    2
        MSM_MI2S_SD2    4
        MSM_MI2S_SD3    8
- qcom,msm-mi2s-tx-lines :
    This property describes the SD lines allocated to TX on the MI2S interface.
    This should be expressed as a bitmask and should not overlap those
    allocated in the RX definition.  The masks are defined with the following:
        MSM_MI2S_SD0    1
        MSM_MI2S_SD1    2
        MSM_MI2S_SD2    4
        MSM_MI2S_SD3    8

Example:

qcom,msm-dai-q6-mi2s {
	compatible = "qcom,msm-dai-q6-mi2s";
	qcom,msm-mi2s-rx-lines = <4>; /* MSM_MI2S_SD2 */
};


* MSM DAI Q6

Required properties:
- compatible :
    "qcom,msm-dai-q6"
- qcom,msm-dai-q6-dev-id :
    This property determines which snd_soc_dai_driver the MSM audio driver will
    register with the sound framework. It will also be used to determine the
    device's name in the format of: msm-dai-q6.<dev_id>

Example:

qcom,msm-dai-q6 {
	compatible = "qcom,msm-dai-q6";
	qcom,msm-dai-q6-dev-id = <1>; /* PRIMARY_I2S_TX */
};
```

## Documentation/devicetree/bindings/sound/tas2560-algo.txt
```
Tas2560 algo driver

Required properties:

  - compatible : "ti,tas2560-algo"

  - tas2560-port-id : afe port id for the mi2s used for tas2560.

Example:

ti,tas2560-algo {
	compatible = "ti,tas2560-algo";
	ti,tas2560-port-id = <0x1016>, <0x1017>;
};
```

## Documentation/devicetree/bindings/sound/tas2560.txt
```
Tas2560 audio CODEC

Required properties:

  - compatible : "ti,tas2560"

  - reg : the I2C address of the device for I2C.

Optional properties:

  - reset-gpios : a GPIO spec for the reset pin.

  - irq-gpio : a GPIO spec for chip irq

  - ear-switch-gpio : a GPIO spec for analog switch of handset path when 2-in-1 speaker is used

  - pll : pll src. 0 for PLL_BCLK_1P536_48KSR, 1 for PLL_BCLK_3P072_48KSR

  - asi-format : 0 for i2s, 1 for dsp

  - load : load resistance, 0 for 80hm, 1 for 60hm, 2 for 40 hm

  - ppg : digital gain attenuation, 0(-110db)~110(0db)

Example:

tas2560@4c {
	compatible = "ti,tas2560";
	reg = <0x4c>;
	ti,reset-gpio = <&tlmm 89 0>;
	ti,irq-gpio = <&tlmm 90 0>;
	ti,ear-switch-gpio = <&tlmm 116 0>;
	ti,pll = <0>; /* refer to tas2560.h for more details */
	ti,asi-format = <0>; /* 0, i2S; 1, DSP;  */
	ti,load = <1>; /* 0, 8Ohm; 1, 6Ohm; 2, 4Ohm */
	ti,ppg = <110>; /*attenuation,0(-110db)~110(0db) */
};
```

## Documentation/devicetree/bindings/sound/ti-tlv320aic3253.txt
```
* TI TLV320AIC3253

The TLV320AIC3253 is a flexible, low-power, low-voltage stereo audio codec
with programmable outputs, fully-programmable miniDSP, fixed predefined and
parameterizable signal processing blocks, integrated PLL, integrated LDO and
flexible digital interfaces, it is connected to the host processor via i2c for
commands and have various GPIOs connected to control reset, mclk selection.

Required properties:
 - compatible:
		the string of "ti,aic3253"
 - reg:
		the i2c slave address of the IC
 - gpios:
		an array specifiying the two required GPIOs for operation. They must
		be specified in exact order:
			- RESET GPIO
			- MCLK - the mclk selection gpio

Example:

	/* GSBI10 - I2C */
	&i2c10 {
		/* TI tlv320aic3253 */
		aic3253@18 {
			compatible = "ti,aic3253";
			reg = <0x18>;
			gpios = <&pm8921_gpio 18 0>, /* RESET */
				<&pm8921_gpio 8 0>;  /* MCLK  */
		};
	};
```

## Documentation/devicetree/bindings/sound/ti-tpa6165a2.txt
```
* TI TPA6165A2

TPA6165A2 is a headset interface IC with a high-performance, low-power
DirectPath variable-attenuation Class-G stereo headphone amplifier,
variable=gain microphone pre-amplifier with bias, and advanced accessory
detection circuitry.

Required properties:
	- compatible:
		the string of "ti,tpa6165"
	- reg:
		the i2c slave address of the IC
	- interrupts:
		there is one interrupt line connected to the main SoC
	- interrupt-parent:
		The parent interrupt controller
	- gpios:
		an array specifiying the required GPIO for operation
			- IRQ GPIO
Optional properties:
	- ti,tpa6165-always-on-micbias:
		this property indicates that mic bias is always turned ON when
		headset is plugged in. This should be set by products which has
		low power dsp support for always on voice recognition and continous
		noise estimates.
	- ti,tpa6165-jack-detect-config:
		this property allow to set custom default value for the jack
		detection test hardware settings register (0x18).
		The value bits are :
		BIT 7 - Maximum Impedance During Short
			Defines maximum impedance below which pin is considered
			short.This information is used while detecting whether
			PIN2_ROUT is ground.
			0 = 4 Ω
			1 = 7 Ω
		BIT 6 - Threshold Impedance to Distinguish Between Headphone and
			Lineout Load.Defines impedance below which load is Headphone
			and above is Lineout.
			0 = 700 Ω
			1 = 1.5 kΩ
		BITS 5-0 - Reserved
Example:

	i2c@1a200000 {
		status = "okay";

		qcom,i2c-bus-freq = <400000>;
		qcom,i2c-src-freq = <24000000>;

		tpa6165xx@40 {
			compatible = "ti,tpa6165";
			reg = <0x40>;
			interrupt-parent = <&pm8921_gpio>;
			interrupts = <38 0>;
			gpios = <&pm8921_gpio 38 0>;     /* IRQ */
			ti,tpa6165-always-on-micbias = <1>;
			ti,tpa6165-jack-detect-config = <0xC0>;
		};
	};
```

## Documentation/devicetree/bindings/spi/qcom,si5518-clk.txt
```
Binding for SPI slave to control si5518 clock and respective clock buffer.

SPI includes two chip selects, CS0 is used for si5518 clock and CS1 is used for clock buffer.

Required properties:
- compatible:	  Should contain "qcom,si5518-clk"
- reg:		  Should contain base register location and length
- spi-max-frequency: Specifies maximum SPI clock frequency,
		     Units - Hz. Definition as per
		     Documentation/devicetree/bindings/spi/spi-bus.txt

Example:

	&qupv3_se14_spi {
		status = "ok";
		spidev@0 {
			compatible = "qcom,si5518-clk";
			spi-max-frequency = <1000000>;
			reg = <0>;
		};
		spidev@1 {
			compatible = "qcom,si5518-clk";
			spi-max-frequency = <1000000>;
			reg = <1>;
		};

	};
```
