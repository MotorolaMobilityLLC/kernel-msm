## Documentation/devicetree/bindings/staging/nanohub.txt
```
GOOGLE nanohub sensorhub

Required properties:
- compatible : should be "nanohub"

Example:

&spi_7 {
	sensorhub@0 {
		compatible = "nanohub";
		reg = <0>;
		spi-max-frequency = <25000000>;
		spi-cpol;
		spi-cpha;

		interrupt-parent = <&msm_gpio>;
		interrupts = <66 0x2>;
		sensorhub,nreset-gpio = <&msm_gpio 59 0>;
		sensorhub,boot0-gpio = <&msm_gpio 60 0>;
		sensorhub,wakeup-gpio = <&msm_gpio 65 0>;
		sensorhub,irq1-gpio = <&msm_gpio 66 0>;
		sensorhub,spi-cs-gpio = <&msm_gpio 43 0>;
		sensorhub,bl-addr = <0x08000000>;
		sensorhub,kernel-addr = <0x0800C000>;
		sensorhub,shared-addr = <0x08020000>;
		sensorhub,flash-banks = <0 0x08000000 0x04000>,
			<3 0x0800C000 0x04000>,
			<4 0x08010000 0x10000>,
			<5 0x08020000 0x20000>;
		sensorhub,num-flash-banks = <4>;

		pinctrl-names = "default";
		pinctrl-0 = <&sensorhub_ctrl_active
				&sensorhub_int1_active
				&sensorhub_int2_active>;
```

## Documentation/devicetree/bindings/switch/madera.txt
```
Cirrus Logic Madera class audio codecs switch driver

The switch configuration settings are a child node of type "cirrus,accdet"
within the parent MFD driver devicetree binding.
See Documentation/devicetree/bindings/mfd/madera.txt

This node contains one or more child nodes to describe the accessory detect
configuration.

Mandatory properties:
  - #address-cells : must be 1
  - #size-cells : must be 0


Child node mandatory properties:
  - reg : output number this configuration applies to, 1=OUT1, 2=OUT2, ...

Child node optional properties:
  - cirrus,micd-pol-gpios : GPIO specifier for the GPIOs controlling the headset
    polarity if one exist. Up to 2 gpios can be configured.
    If 2 gpios are configured their values will be set opposite to each other.

  - cirrus,micd-detect-debounce-ms : Additional software microphone detection
    debounce specified in milliseconds

  - cirrus,micd-manual-debounce : Additional software button detection
    debounce specified as a number

  - cirrus,micd-bias-start-time : Time allowed for MICBIAS to startup prior to
    performing microphone detection, specified as per the MICD_BIAS_STARTTIME
    bits in the register MIC_DETECT_1

  - cirrus,micd-rate : Delay between successive microphone detection
    measurements, specified as per the MICD_RATE bits in the register
    MIC_DETECT_1

  - cirrus,micd-dbtime : Microphone detection hardware debounce level, specified
    as per the MICD_DBTIME bits in the register MIC_DETECT_1

  - cirrus,micd-timeout-ms : Timeout for microphone detection, specified in
    milliseconds

  - cirrus,micd-force-micbias : Force MICBIAS continuously on during microphone
    detection and button detection

  - cirrus,micd-software-compare : Use a software comparison to determine mic
    presence

  - cirrus,jd-use-jd2 : Use JD2 input with JD1 for dual jack detection.

  - cirrus,jd-alt-jd2 : Use JD1 as primary irq source and JD2 as backup
    for jack detection. The option can not be combined with jd-use-jd2.

  - cirrus,jd-wake-time : Specifies a length of time that a wake lock will be
    held for during jack detection operations.

  - cirrus,gpsw : Settings for the general purpose switches, set as per the
    SWn_MODE bits in the GP Switch 1 register.
    First cell is the value for the SW1_MODE
    Second cell is the value for the SW2_MODE (cs47l90, cs47l91)

  - cirrus,report-to-input : Report headset detection events to input queue.

  - cirrus,disable-jd2-on-lineout : Disable JD2 pin when lineout jack detected.

  - cirrus,fixed-hpdet-imp : Do not perform any headphone detection, just use
    the fixed value specified here as the headphone impedance. Value is in
    hundredths-of-an-ohm (ohms * 100)

  - cirrus,hpdet-ext-res : Impedance of external series resistor on hpdet.
    Value is in hundredths-of-an-ohm (ohms * 100)

  - cirrus,hpdet-short-circuit-imp : Specifies the maximum impedance in ohms
    that will be considered as a short circuit

  - cirrus,hpdet-channel : When this property is set then right channel is used
    for headphone impedance measurement else the left headphone channel is
    used

  - cirrus,micd-clamp-mode : Specifies the logic of the micdetect clamp block

  - cirrus,hpd-pins : 4 cells specifying the clamp and sense pins to use.
	<clamp_left sense_left clamp_right sense_right>
    where clamp_x is the clamp pin for channel x and sense_x is the impedance
    sense pin for channel x, as per the HPD_OUT_SEL field of HEADPHONE_DETECT_0
    register. A value >0xFFFF means use the default.
    (cs47l90, cs47l91)

  - cirrus,micd-ranges : Microphone detection level and key configuration, this
    field can be of variable length but should always be a multiple of 2 cells
    long, each two cell group represents one button configuration
    The first cell is the maximum impedance for this button in ohms
    The second cell the key that should be reported to the input layer

  - cirrus,micd-configs : Headset polarity configurations, variable length but
    must be a multiple of 5 cells, each two cell group represents one
    polarity configuration
    first cell is the value of
       ACCDET_SRC register field (CS47L35, CS47L85, WM1840),
       MICD_SENSE_SEL register field (all other codecs)
    second cell is the accessory detection ground as per the MICD_GND_SEL
      register field
    the third cell is the MICBIAS to be used as per the MICD_BIAS_SRC register
      field
    fourth cell is the value of the micd-pol-gpio pin, a non-zero value
      indicates this should be on
    fifth cell is
      set to zero (cs47l35, cs47l85, wm1840)
      value of HPn_GND_SEL register field (all other codecs)

Example:

codec: cs47l85@0 {
	compatible = "cirrus,cs47l85";

	cirrus,accdet {
		#address-cells = <1>;
		#size-cells = <0>;

		acc@1 {
			reg = <1>;

			cirrus,micd-pol-gpios = <&gpio 0>
			cirrus,micd-detect-debounce-ms = <10>;
			cirrus,micd-bias-start-time = <0x1>;
			cirrus,micd-rate = <0x1>;
			cirrus,micd-dbtime = <0x1>;
			cirrus,micd-timeout-ms = <10>;
			cirrus,micd-force-micbias;
			cirrus,micd-ranges = <
				11 0x100
				28 0x101
				54 0x102
				100 0x103
				186 0x104
				430 0x105
			>;
			cirrus,micd-configs = <
				0x1 0 1 0 2
				0x0 0 2 1 2
			>;
			cirrus,fixed-hpdet-imp = <8>;
			cirrus,micd-clamp-mode = <0xb>;
			cirrus,gpsw = <0x3>;
		};
	};
};
```

## Documentation/devicetree/bindings/thermal/max31760.txt
```
Bindings for the Maxim MAX31760 Intelligent Fan Controller
==========================================================

The Maxim MAX31760 is a i2c device providing closed-loop, multi-channel fan
management with temperature. Various fan control features are provided,
including PWM frequency control, temperature hysteresis, dual tachometer
measurements, and fan health monitoring.

Required properties:
- compatible         : should be "maxim,max31760".
- reg                : I2C address, 0xa0.

Optional properties:
- maxim,vdd-supply   : regulator supplying the vdd pin
- maxim,vdd-max-uv   : regulator max voltage
- maxim,vdd-min-uv   : regulator min voltage
- maxim,vdd-load-ua  : regulator load current output
- maxim,vcca-supply  : regulator supplying the vcca pin
- maxim,vcca-max-uv  : regulator max voltage
- maxim,vcca-min-uv  : regulator min voltage
- maxim,vcca-load-ua : regulator load current output
- maxim,pwr-en-gpio  : fan enable gpio

Example:
	max31760@50 {
		compatible = "maxim,max31760";
		reg = <0x50>;
		maxim,vdd-supply = <&some_reg>;
		regulator-names = "maxim,vdd";
		maxim,vdd-max-uv = <3400000>;
		maxim,vdd-min-uv = <3300000>;
		maxim,vdd-load-ua = <300000>;
		maxim,vcca-supply = <&some_reg>;
		maxim,vcca-max-uv = <1800000>;
		maxim,vcca-min-uv = <1800000>;
		maxim,vcca-load-ua = <600000>;
		maxim,pwr-en-gpio = <&some_gpio>;
	};
```

## Documentation/devicetree/bindings/thermal/qcom,bcl-off-cdev.txt
```
Qualcomm Technologies, Inc. BCL OFF cooling device

The BCL OFF cooling device, will be used to disable PMIC bcl.
This cooling device will be called when modem RF calibration
is performed using external power supply.

When external power supply is used for RF calibration, ibat current
can cross the battery specs and can trigger batfet issues. So pmic bcl
should be disabled as it is for protection for battery not external
power supply.


Required Parameters:
- compatible:
	Usage: required
	Value type: <string>
	Definition: should be "qcom,bcl-off"

- reg:
	Usage: optional
	Value type: <a b>
	Definition: where 'a' is the starting register address of the PMIC
	peripheral and 'b' is the size of the peripheral address space.

- #cooling-cells:
	Usage: required
	Value type: <integer>
	Definition: Must be 2. This is required by of-thermal and refer the doc
		<devicetree/bindings/thermal/thermal.txt> for more details.

Example:

	bcl_off: bcl-off {
		compatible = "qcom,bcl-off";
		reg = <0x4700 0x100>;
		#cooling-cells = <2>;
	};
```

## Documentation/devicetree/bindings/thermal/qcom-limits-stat.txt
```
Limits stats Driver

Limits stats driver is used to collect stats. It collects CPU average and peak
current, CPUs online mask, CPUs Load percentage, CPU temperature, BCL levels,
PE current, PE thresholds etc..


Properties:

- compatible:
	Usage: required
	Value type: <string>
	Definition: shall be "qcom,limits-stat"

- reg:
	Usage: optional
	Value type: <a b>
	Definition: where 'a' is the starting register address of the RDPM PE
			HW block and 'b' is the size of RDPM PE address space.

- reg-names:
	Usage: optional
	Value type: <string>
	Definition: user defined names for the register set. These
		register names will be used by the drivers to identify the
		RDPM PE HW block.
		"rdpm_pe_mx",
		"rdpm_pe_cx",

-qcom,limits-stat-sensor-names
	Usage: required
	Value type: <string>
	Definition: This contains list of sensors which needs to be
		monitored as part of limits stat collection.

Example:

	limits_stat: limits-stat {
		compatible = "qcom,limits-stat";
		reg = <0x637000 0x1000>;
		reg-names = "rdpm_pe_mx";
		qcom,limits-stat-sensor-names = "cpu-0-0",
						"cpu-0-1",
						"cpu-0-2",
						"cpu-0-3",
						"cpu-1-0",
						"cpu-1-1",
						"cpu-1-2",
						"cpu-1-3",
						"gpuss-0",
						"gpuss-1",
						"nspss-0";
						"nspss-1";
						"nspss-2";
	};
```

## Documentation/devicetree/bindings/thermal/qti-ddr-cdev.txt
```
QTI DDR cooling device.

The DDR cooling device will be used to place a DDR frequency vote. This
cooling device will be used in those cases where all the subsystem's are
thermally throttled and DDR has to be operated with a minimum performance
level. This cooling device vote can ensure the same.

Properties:
- compatible:
	Usage: required
	Value type: <string>
	Definition: should be "qcom,ddr-cooling-device".

Bus Scaling Data:
- qcom,msm-bus,name:
	Usage: required
	Value type: <string>
	Definition: String describing DDR cooling device client. It is defined
		at Documentation/devicetree/bindings/arm/msm/msm_bus.txt.
- qcom,msm-bus,num-cases:
	Usage: required
	Value type: <integer>
	Definition: This is the number of Bus Scaling use cases
		defined in the vectors property. This must be set to more than
		one for DDR cooling device based on different levels of DDR
		frequency cooling support required. The use-case0 always should
		be a vote to take off DDR cdev votes from the system. It is
		defined at Documentation/devicetree/bindings/arm/msm/msm_bus.txt.
- qcom,msm-bus,active-only:
	Usage: optional
	Value type: <None>
	Definition: A boolean flag indicating if it is active only
		bandwidth vote. It is defined at
		Documentation/devicetree/bindings/arm/msm/msm_bus.txt.
- qcom,msm-bus,num-paths:
	Usage: required
	Value type: <integer>
	Definition: This represents total number of master-slave pairs for
		different usecases. It is defined at
		Documentation/devicetree/bindings/arm/msm/msm_bus.txt.
- qcom,msm-bus,vectors-KBps:
	Usage: required
	Value type: <array>
	Definition: A series of 4 cell properties, with a format of
		(src, dst, ab, ib). It is defined at
		Documentation/devicetree/bindings/arm/msm/msm_bus.txt.

Cooling Device Property:
- #cooling-cells:
	Usage: required
	Value type: <integer>
	Definition: Must be 2. Needed for of_thermal as cooling device
			identifier. Please refer to
			<devicetree/bindings/thermal/thermal.txt> for more
			details.
Example:
	qcom,ddr-cdev {
		compatible = "qcom,ddr-cooling-device";
		qcom,msm-bus,name = "ddr-cdev";
		qcom,msm-bus,num-cases = <2>;
		qcom,msm-bus,num-paths = <1>;
		qcom,msm-bus,vectors-KBps = <1 512 0 0>,
					<1 512 0 366000>;
		#cooling-cells = <2>;
        };
```

## Documentation/devicetree/bindings/tty/serial/msm_serial.txt
```
* Qualcomm MSM UART

Required properties:
- compatible :
	- "qcom,msm-uart", and one of "qcom,msm-hsuart" or
	  "qcom,msm-lsuart".
- reg : offset and length of the register set for the device
	for the hsuart operating in compatible mode, there should be a
	second pair describing the gsbi registers.
- interrupts : should contain the uart interrupt.

There are two different UART blocks used in MSM devices,
"qcom,msm-hsuart" and "qcom,msm-lsuart".  The msm-serial driver is
able to handle both of these, and matches against the "qcom,msm-uart"
as the compatibility.

The registers for the "qcom,msm-hsuart" device need to specify both
register blocks, even for the common driver.

Example:

	uart@19c400000 {
		compatible = "qcom,msm-hsuart", "qcom,msm-uart";
		reg = <0x19c40000 0x1000>,
		      <0x19c00000 0x1000>;
		interrupts = <195>;
	};

* Qualcomm MSM HSUART

Required properties:
- compatible : one of:
	- "qcom,msm-lsuart-v14"
- reg : offset and length of the register set for the device.
- interrupts : should contain the uart interrupt.

Example:

	serial@19c400000 {
		compatible = "qcom,msm-lsuart-v14"
		reg = <0x19c40000 0x1000">;
		interrupts = <195>;
	};

* Qualcomm MSM HS UART

Required properties:
- compatible : "qcom,msm-hsuart"
- reg : offset and length of the register set for the device
        for the hsuart operating in compatible mode, there should be a
        second pair describing the gsbi registers.
- reg-names : resources names, should be "uartdm_resource" and "gsbi_resource"
        to match up with the previous reg offset/lengths.
- interrupts : should contain the uart interrupt.

- cell-index : this is the device's ID and translate to /dev/ttyHS<n>
- qcom,msm-hs-dm-tx-crci : the crci TX for the hsuart data mover
- qcom,msm-hs-dm-rx-crci : the crci RX for the hsuart data mover
- qcom,msm-hs-dm-tx-chan : the data mover tx channel
- qcom,msm-hs-dm-rx-chan : the data mover rx channel

Example:

	serial@16440000 {
		compatible = "qcom,msm-hsuart";
		status = "okay";
		cell-index = <3>;

		reg = <0x16440000 0x1000 0x16400000 0x4>;
		reg-names = "uartdm_resouce", "gsbi_resource";
		interrupts = <0 154 0>;

		qcom,msm-hs-dm-tx-crci = <10>;
		qcom,msm-hs-dm-rx-crci = <9>;
		qcom,msm-hs-dm-tx-chan = <8>;
		qcom,msm-hs-dm-rx-chan = <7>;
	};
```

## Documentation/devicetree/bindings/usb/qcom,pmic-eusb2-repeater.txt
```
Qualcomm Technologies, Inc. eUSB2 Repeater

Required properties:
 - compatible: Should be "qcom,pmic-eusb2-repeater"
 - reg: Address and length of the register set for the device
 - <supply-name>-supply: phandle to the regulator device tree node
   Required "supply-name" examples are:
	"vdd3" : 3.v supply for eUSB2 repeater
	"vdd18" : 1.8v supply for eUSB2 repeater

Optional properties:
 - qcom,param-override-seq: parameter override sequence with value, reg offset
   pair.

Example:
	eusb2_repeater@fd00 {
		compatible = "qcom,pmic-eusb2-repeater";
		reg = <0xfd00 0xff>;
		vdd18-supply = <&pm8841_s2_corner>;
		vdd3-supply = <&pm8941_l6>;
		qcom,param-override-seq = <0x4 0x57>;
	};
```
