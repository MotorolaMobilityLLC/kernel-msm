## drivers/external_drivers/drivers/hwmon/Kconfig
```kconfig
config SENSORS_MRFL_OCD
	tristate "Basincove BCU driver for Merrifield"
	depends on INTEL_SCU_IPC
	help
	  Say yes here to enable current monitoring driver for
	  merrifield platform.

	  This driver is specific to basin cove PMIC used in the
          Merrifield platform.

config SENSORS_PSH_MRLD
        tristate "Intel PSH driver for Merrifield"
        depends on INTEL_PSH_IPC && INTEL_SCU_IPC_UTIL
        help
          Say Y here to enable PSH driver on Intel Merrifield Platform, and
          this driver depends on PSH IPC and SCU IPC driver.

          This driver can also be built as a module. If so, the module
          will be called psh.
```

## drivers/external_drivers/drivers/i2c/busses/Kconfig
```kconfig
#
# I2C buses device configuration
#

config I2C_DESIGNWARE_CORE_FORK
	tristate "Synopsys DesignWare Controller"
	help
	  If you say yes to this option, support will be included for the
	  Synopsys DesignWare adapter core. Only master mode is supported.
          You need choose platform or pci driver for its driver support.

	  This driver can also be built as a module.  If so, the module
	  will be called i2c-designware-core.

config I2C_DESIGNWARE_PCI_FORK
	tristate "Synopsys DesignWare PCI"
	depends on PCI && I2C_DESIGNWARE_CORE_FORK
	help
	  If you say yes to this option, support will be included for the
	  Synopsys DesignWare I2C adapter. Only master mode is supported.

	  This driver can also be built as a module.  If so, the module
	  will be called i2c-designware-pci.


config I2C_DW_SPEED_MODE_DEBUG
	bool "Designware I2C Speed Mode Debug"
	depends on I2C_DESIGNWARE_CORE_FORK
	help
	  If you say yes to this option, you could runtime change the I2C
	  controller bus speed mode.

config I2C_PMIC
	bool "PMIC I2C Adapter"
	depends on INTEL_SCU_IPC
	help
	  Say Y here if you have PMIC I2C adapter.

	  PMIC-I2C adapter driver to handle I2C transactions
	  in the PMIC's I2C bus.
```

## drivers/external_drivers/drivers/input/touchscreen/Kconfig
```kconfig
config TOUCHSCREEN_R69001_I2C
	tristate "JDI R69001 touchscreen"
	depends on I2C
	default n
	help
		Say Y here if you have a R69001 touchscreen
		If unsure, say N.

source "drivers/external_drivers/drivers/input/touchscreen/rmi4/Kconfig"
```

## drivers/external_drivers/drivers/misc/Kconfig
```kconfig
config SCU_LOGGING
	tristate "Intel SCU fabric debug driver"
	default n
	---help---
	 Driver that enable for debugging Intel SCU firmware fabric related error.

config UUID
	tristate "get uuid"
	default n
	---help---
	 Driver for get UUID.

config EMMC_IPANIC
	bool "Intel kernel panic diagnostics driver FOR EMMC"
	default n
	---help---
	  Driver which handles kernel panics and attempts to write
	  critical debugging data to a dedicated partition on EMMC.

config EMMC_IPANIC_PLABEL
	string "Intel kernel panic driver (EMMC_IPANIC) partition label"
	depends on EMMC_IPANIC
	default "panic"
	---help---
	  Set the default mmc partition label for EMMC_IPANIC driver.

config KCT_DAEMON
	tristate "Intel Kernel Crash Tool daemon"
	default n
	---help---
	 Driver that enables the kct daemon to handle Intel crashtool events.

config FPS_THROTTLE
	tristate "register a new cooling device for FPS throttling"
	depends on THERMAL
	---help---
	  register a new cooling device for FPS throttling.

source "drivers/external_drivers/drivers/misc/bcm-lpm/Kconfig"
source "drivers/external_drivers/drivers/misc/rawio/Kconfig"
source "drivers/external_drivers/drivers/misc/tp2e/Kconfig"
```

## drivers/external_drivers/drivers/misc/bcm-lpm/Kconfig
```kconfig
config BCM_BT_LPM
	tristate "Broadcom Bluetooth Low Power Mode"
	depends on SERIAL_MFD_HSU || SERIAL_MFD_HSU_EXT
	default n
	help
	   Select this module for Broadcom Bluetooth low power management.

config BCM_BT_LPM_DBG
	bool "Set this flag to disable LPM, for debug purpose."
	depends on BCM_BT_LPM
	default n
	help
	   Set this flag to disable LPM, for debug purpose.
```

## drivers/external_drivers/drivers/misc/rawio/Kconfig
```kconfig
#
# rawio utility drivers
#

menuconfig RAWIO
	tristate "Debug fs based raw io device read/write framework "
	depends on DEBUG_FS
	default y 
	help
	  This option enables support for reading or writing registers/memory
	  region in a io device via debug fs.
	  With this option and related rawio driver options enabled, you could
	  read configuration space of a PCI device, registers of a memory
	  mapped or port mapped device, registers of a i2c device, etc.
	  This is the just the framework driver. You need enable more
	  options to support specific device types.

	  To compile this driver as a module, choose M: the module will
	  be called rawio.

	  If you are not sure, say N here.

if RAWIO

config RAWIO_PCI
	tristate "rawio PCI driver"
	depends on RAWIO && PCI
	default y
	help
	  This option enables the rawio PCI driver.
	  With this driver, you can read or write any PCI device's
	  configuration space via debugfs.
	  To compile this driver as a module, choose M: the module will
	  be called rawio_pci.

config RAWIO_IOMEM
	tristate "rawio I/O memory driver"
	depends on RAWIO
	default y
	help
	  This option enables the rawio I/O memory driver.
	  With this driver, you can read or write registers of a memory
	  mapped I/O devices.

	  To compile this driver as a module, choose M: the module will
	  be called rawio_iomem.

config RAWIO_I2C
	tristate "rawio I2C driver"
	depends on RAWIO && I2C
	default y
	help
	  This option enables the rawio I2C driver.
	  With this driver, you can read or write any I2C device's
	  register debugfs interface.
	  To compile this driver as a module, choose M: the module will
	  be called rawio_i2c.

config RAWIO_MSGBUS
	tristate "rawio Message Bus driver"
	depends on RAWIO && X86_WANT_INTEL_MID
	default y
	help
	  This option enables the rawio Message Bus driver.
	  With this driver, you can read or write any message bus
	  register via the rawio debugfs interface.
	  To compile this driver as a module, choose M: the module will
	  be called rawio_msgbus.

config RAWIO_MSR
	tristate "rawio MSR driver"
	depends on RAWIO && X86
	default y
	help
	  This option enables the rawio MSR driver.
	  With this driver, you can read or write any MSR register
	  on X86 platform via the rawio debugfs interface.
	  To compile this driver as a module, choose M: the module will
	  be called rawio_msr.

endif # RAWIO
```

## drivers/external_drivers/drivers/misc/tp2e/Kconfig
```kconfig
config TRACEPOINT_TO_EVENT
	tristate "Tracepoint To Event (tp2e)"
	depends on TRACEPOINTS && KCT_DAEMON
	help
	  This module enable bindings between tracepoints and specific
	  events.
	  Tracepoint probes (bindings) are defined in headers doing
	  matching between tracepoint elements and event
	  fields. Including those headers in the module declares and
	  registers the probe.
```

## drivers/external_drivers/drivers/platform/x86/Kconfig
```kconfig
#
# X86 Platform Specific Drivers
#
config GPIO_INTEL_MSIC
	bool "Intel MSIC GPIO support"
	depends on INTEL_SCU_IPC && GPIOLIB
	---help---
	  MSIC provides a GPIO subsystem containing several input
	  output pins.
	  Say Y here to support GPIO via the SCU IPC interface
	  on Intel MID platforms.

config INTEL_MID_OSIP
	tristate "osip driver for Intel MID platforms"
	default y
	help
	  This driver modifies the osip header when rebooting,
	  so that one can type 'reboot bootloader' to fall back
	  in kboot mode.

	  If unsure, say N.

config INTEL_MID_OSIP_DEBUG_FS
	tristate "osip driver debug fs"
	depends on INTEL_MID_OSIP && DEBUG_FS
	default y
	help
	  This driver adds debugfs interface.
	  The main feature of that interface is to be able to modify the kernel
	  cmdline directly in the OSIP.
	  This has to be disabled if we have secure boot enabled by default.

	  If unsure, say N.

config INTEL_PSH_IPC
	bool "Intel PSH IPC Support"
	depends on X86_INTEL_MID
	---help---
	  PSH(Platform Services Hub) is a low frequence IA core on Tangier Platform,
	  whose power consumption is quite low. PSH runs RTOS software inside itself,
	  which independently controls and collects sensor data, pre-processes the data,
	  and communicates with Atom. Thus ATOM side could be put into low power mode
	  with more time, while all the sensor data are collected without any lost.

	  PSH IPC is used as a  bridge for OS sensor service to control and access PSH
	  sensors communications between kernel and PSH. This is not needed for PC-type
	  machines.

	  Say Y here to get Intel PSH IPC support.

config INTEL_REBOOT_TARGET
	bool "Intel Reboot Target"
	---help---
	  This driver provides a generic implementation for reboot target setting at
	  reset time.
```

## drivers/external_drivers/drivers/power/Kconfig
```kconfig
config PMIC_CCSM
	tristate "PMIC CCSM driver"
	select POWER_SUPPLY_BATTID
	depends on INTEL_SCU_IPC && IIO
	help
	  Say Y to include support for PMIC Charger Control State Machine driver
	  Driver for initializing and monitoring the CCSM in PMIC
	  This driver sets the CCSM registers and handles the PMIC
	  charger interrupts.

config BQ24261_CHARGER
	tristate "BQ24261 charger driver"
	select POWER_SUPPLY_CHARGER
	depends on I2C
	help
	  Say Y to include support for BQ24261 Charger driver. This driver
	  makes use of power supply charging framework. So the driver gives
	  the charger hardware abstraction only. Charging logic is abstracted
	  in the charging framework.
```

## drivers/external_drivers/intel_media/Kconfig
```kconfig
#
# Drm device configuration
#
# This driver provides support for the
# Direct Rendering Infrastructure (DRI) in XFree86 4.1.0 and higher.
#

config DRM_INTEL_MID
	tristate "Intel Moorestown/Medfield (load along with IMG driver)"
	depends on DRM && PCI
	select FB_CFB_COPYAREA
        select FB_CFB_FILLRECT
        select FB_CFB_IMAGEBLIT
        select DRM_KMS_HELPER
        select GENERIC_ALLOCATOR
        select DRM_TTM
	help
	  xxxxxxxxxxxxxxxxxxxxxxxxxx

choice
	prompt "Build IMG kernel service as "
	depends on DRM_INTEL_MID
	default DRM_MID_RELEASE

config DRM_MID_RELEASE
	bool "Release"
	depends on DRM_INTEL_MID
	help
	  Build IMG kernel services as release

config DRM_MID_DEBUG
	bool "Debug"
	depends on DRM_INTEL_MID
	help
	 Build IMG kernel services as debug

endchoice

config SUPPORT_HDMI
        bool "SUPPORT_HDMI"
        depends on DRM_MDFLD || DRM_CTP || DRM_I915 || DRM_MRFLD
        default n
        help
          Choose this option to support HDMI.

config INTEL_HDMI_AUDIO
	tristate "INTEL_HDMI_AUDIO"
	depends on SUPPORT_HDMI
	default y
	help
	  Controls HDMI audio support.
	  Specify option INTEL_HDMI_AUDIO as:
	  y - built-in
	  m - module
	  n - not supported.

config SUPPORT_MIPI
	bool "SUPPORT_MIPI"
	depends on DRM_MDFLD || DRM_CTP || DRM_I915 || DRM_MRFLD
	default n
	help
	  Choose this option to support MIPI.

config R63311_MIPI_VIDEO_MODE
	bool "support jdi 1920x1080 MIPI panel"
	default n

config DRM_INTEL_HANDSET
	tristate "Intel Display and IMG/RGX Graphics Driver Support"
	depends on DRM && PCI
	select FB_CFB_COPYAREA
        select FB_CFB_FILLRECT
        select FB_CFB_IMAGEBLIT
        select DRM_KMS_HELPER
        select DRM_TTM
	help
	  Specify DRM_INTEL_HANDSET to control presence of display and IMG
	  RGX graphics driver as:
	  y - built-in
	  m - module
	  n - not present

choice
	prompt "Build IMG kernel service as "
	depends on DRM_INTEL_HANDSET
	default DRM_HANDSET_RELEASE

config DRM_HANDSET_RELEASE
	bool "Release"
	depends on DRM_INTEL_HANDSET
	help
	  Build IMG kernel services as release

config DRM_HANDSET_DEBUG
	bool "Debug"
	depends on DRM_INTEL_HANDSET
	help
	  Build IMG kernel services as debug

endchoice

config GFX_RGX_BVNC
	string
	depends on DRM_INTEL_HANDSET
	prompt "IMG graphics driver BNVC specification"
	help
	    A build configuration parameter which must have the same value
	    for the IMG kernel mode driver and the IMG user mode driver.
	    The BVNC value will differ depending upon target (e.g.,
	    Merrifield vs. Moorefield) and desired build configuration.
	    Normally a value recommended by IMG is used.
	    Examples as of 2013-12-06:
	    - Merrifield - 1.14.4.4 - DDK1.2
	    - Merrifield - 1.76.4.6 - DDK1.3
	    - Moorefield - 1.72.4.12 - either DDK

config MRFL_DISPLAY
	tristate "Intel Merrifield Generic Framebuffer Driver"
	depends on PCI && X86_MRFLD && !DRM_MDFLD && FB
	default n
	select FB_CFB_COPYAREA
        select FB_CFB_FILLRECT
        select FB_CFB_IMAGEBLIT
	help
	   Basic support for Generic Framebuffer Driver for Merrifield.

config DRM_MRFLD
        tristate "Intel Merrifield Graphics Driver Support with IMG"
        depends on DRM_INTEL_HANDSET && PCI
        select FB_CFB_COPYAREA
        select FB_CFB_FILLRECT
        select FB_CFB_IMAGEBLIT
        select DRM_KMS_HELPER
        select GENERIC_ALLOCATOR
        help
          Choose this option if you have a Merrifield platform.
          If M is selected the module will be called mid_gfx.

config PDUMP
        bool "Enable pdump in Merrifield graphics driver"
        depends on DRM_MRFLD
        default n
        help
          Choose this option to enable pdump on Merrifield.

config MID_DSI_DSR
	bool "Support DSI Fullscreen Display Self Refreshment "
	depends on DRM_INTEL_HANDSET && !MID_DSI_DPU
	default y
	help
	  Choose this option if you have a Type1 MIPI panel.

config MID_DSI_DPU
	bool "Support DSI Display Partial Update"
	depends on DRM_INTEL_HANDSET
	default n
	help
	  xxxxxx

config GFX_RTPM
	bool "Enable GFX runtime_pm"
	depends on DRM_INTEL_HANDSET
	default n
	help
          xxxxxx

config SUPPORT_VSP
        bool "SUPPORT_VIDEO_VSP"
        depends on DRM_MRFLD
        default n
        help
          xxxxxx

config GFX_RGX_DEVFREQ
	tristate "IMG Rogue Graphics DEVFREQ Driver"
	default y
	depends on PM_DEVFREQ && DRM_INTEL_HANDSET
	select DEVFREQ_GOV_SIMPLE_ONDEMAND
	select DEVFREQ_GOV_PERFORMANCE
	select DEVFREQ_GOV_POWERSAVE
	help
	  This adds the DEVFREQ driver for Imagination Technologies (IMG)
	  Rogue/Hood graphics (RGX).  This driver helps control GPU clock
	  speed in order to provide high performance on demand and power
	  savings when not busy or when thermal conditions suggest.

config MOOREFIELD
	bool "Build option for the Moorefield platform"
	depends on DRM_INTEL_HANDSET
	default n
	help
	  For the GFX block of TNG/ANN, its power islands' power on/off sequences are:
	  1. Power on:  SLC_LDO -> SLC -> Sidekick -> Rascal/Dust;
	  2. Power off: Rascal/Dust -> Sidekick -> SLC -> SLC_LDO;
	  So we should follow the sequence, and VED/VEC/VSP power islands just depend
	  on the SLC power island.
	  And it would distinguish the Display Class implementation.
```

## drivers/firmware/qcom/Kconfig
```kconfig
# SPDX-License-Identifier: GPL-2.0-only
#
# see Documentation/kbuild/kconfig-language.rst.
#

source "drivers/firmware/qcom/si_core/Kconfig"
```

## drivers/gud/Kconfig
```kconfig
#
# Trustonic drivers configuration
#
config TRUSTONIC_TEE
    tristate "Trustonic TEE Driver"
    depends on ARM || ARM64
    default y
    ---help---
      Enable Trustonic TEE support

config TRUSTONIC_TEE_LPAE
    bool "Trustonic TEE uses LPAE"
    depends on TRUSTONIC_TEE
    default y if ARM64
    default n if ARM
    ---help---
      Enable Trustonic TEE 64-bit physical addresses support

config TRUSTONIC_TEE_DEBUG
    bool "Trustonic TEE driver debug mode"
    depends on TRUSTONIC_TEE
    default n
    ---help---
      Enable the debug mode in the Trustonic TEE Driver.

config TRUSTONIC_TRUSTED_UI
    tristate "Trustonic Trusted UI"
    depends on TRUSTONIC_TEE
    ---help---
      Enable Trustonic Trusted User Interface

config TRUSTONIC_TRUSTED_UI_FB_BLANK
    bool "Trustonic Trusted UI with fb_blank"
    depends on TRUSTONIC_TRUSTED_UI
    ---help---
    Blank the framebuffer before starting a TUI session
```
