## drivers/haptics/Kconfig
```kconfig
config TI_VIBRATOR
	tristate "Vibrator support for DRV2605"
	depends on I2C
	help
	  This option enables device driver support for the vibrator

config HAPTICS_DRV2605
	bool "Vibrator driver device type"
	depends on TI_VIBRATOR
	help
	  This option enables device driver support for the vibrator
	  
config HAPTICS_ERM_HW
	bool "Vibrator actor type"
	depends on TI_VIBRATOR
	help
	  This option enables device driver support for the vibrator	  
```

## drivers/input/fingerprint/Kconfig
```kconfig
#
# fpc fingerprint configuration
#
config FINGERPRINT_FPC
	tristate "fpc fingerprint"
	default n
	help
	  If you say yes here you get support for fpc fingerprint.
```

## drivers/input/touchscreen/cyttsp5/Kconfig
```kconfig
#
# Cypress cyttsp5 touchscreen driver configuration
#

config TOUCHSCREEN_CYTTSP5
	tristate "Cypress TrueTouch Gen5 Touchscreen Driver"
	depends on I2C
	default n
	help
	  Core driver for Cypress TrueTouch(tm) Standard Product
	  Geneartion5 touchscreen controllers.

	  Say Y here if you have a Cypress Gen5 touchscreen.
	  If unsure, say N.
	  To compile this driver as a module, choose M here.
```

## drivers/input/touchscreen/focaltech_mmi/Kconfig
```kconfig
#
# Focaltech touchscreen driver configuration
#
menuconfig TOUCHSCREEN_FOCALTECH_MMI
	bool "Focaltech touchscreen in MMI revision"
	help
	  Say Y here if you have a Focaltech touchscreen connected
	  to your system.
	  This revision supports MMI features.

	  If unsure, say N.

if TOUCHSCREEN_FOCALTECH_MMI

config TOUCHSCREEN_FOCALTECH_CORE_MMI
       tristate "FocalTech touchscreens"
       depends on I2C
       help
         Say Y here if you have a focaltech touchscreen.
	 Focaltech controllers are multi touch controllers.

         If unsure, say N.

         To compile this driver as a module, choose M here: the
         module will be called focaltech_ts.

config TOUCHSCREEN_FOCALTECH_UPGRADE_MMI
	bool "New firmware upgrade code for Focaltech Touchscreen"
	depends on TOUCHSCREEN_FOCALTECH_CORE_MMI
	help
	  Say Y here to add new Focaltech firmware upgrade code.
	  This new firmware upgrade code will create a generic
	  firmware upgrade framework.
	  If new IC need to be supported, only need to accomplish
	  some callback functions

	  If unsure, say N.

config TOUCHSCREEN_FOCALTECH_UPGRADE_8716_MMI
	bool "Add ft8716 IC support for Focaltech Touchscreen"
	depends on TOUCHSCREEN_FOCALTECH_CORE_MMI
	select TOUCHSCREEN_FOCALTECH_UPGRADE_MMI
	help
	  Say Y here will
	  -Add FT8716 IC upgrade support.
	  -Add new Focaltech firmware upgrade code.

	  If unsure, say N.

config TOUCHSCREEN_FOCALTECH_UPGRADE_5X46_MMI
	bool "Add ft5x46 IC support for Focaltech Touchscreen"
	depends on TOUCHSCREEN_FOCALTECH_CORE_MMI
	select TOUCHSCREEN_FOCALTECH_UPGRADE_MMI
	help
	  Say Y here will
	  -Add FT5x46 IC upgrade support.
	  -Add new Focaltech firmware upgrade code.

	  If unsure, say N.

config TOUCHSCREEN_FOCALTECH_UPGRADE_8006U_MMI
	bool "Add ft8006u IC support for Focaltech Touchscreen"
	depends on TOUCHSCREEN_FOCALTECH_UPGRADE_MMI
	help
	  Say Y here will
	  -Add FT8006U IC upgrade support.
	  -Add new Focaltech firmware upgrade code.

	  If unsure, say N.

config TOUCHSCREEN_FOCALTECH_SECURE_TOUCH_MMI
	bool "Secure Touch support for Focaltech Touchscreen"
	depends on TOUCHSCREEN_FOCALTECH_CORE_MMI
	help
	  Say Y here
	  -Focaltech touch driver is connected
	  -To enable secure touch for Focaltech touch driver

	  If unsure, say N.

endif
```

## drivers/input/touchscreen/focaltech_touch/Kconfig
```kconfig
#
# Focaltech Touchscreen driver configuration
#
# MMI_STOPSHIP <kernel>: Product hawao touch bringup

config TOUCHSCREEN_FTS
    bool "Focaltech Touchscreen"
    default n
    help
      Say Y here if you have Focaltech touch panel.
      If unsure, say N.

config TOUCHSCREEN_FTS_DIRECTORY
    string "Focaltech ts directory name"
    default "focaltech_touch"
    depends on TOUCHSCREEN_FTS
```

## drivers/input/touchscreen/ft3519/Kconfig
```kconfig
#
# Focaltech Touchscreen driver configuration
#

config TOUCHSCREEN_FT3519
    bool "Focaltech Touchscreen"
    default n
    help
      Say Y here if you have Focaltech touch panel.
      If unsure, say N.

config TOUCHSCREEN_FT3519_DIRECTORY
    string "Focaltech ts directory name"
    default "ft3519"
    depends on TOUCHSCREEN_FT3519
```

## drivers/input/touchscreen/goodix_gtx8_mmi/Kconfig
```kconfig
#
# Goodix touchscreen driver configuration
#
menuconfig TOUCHSCREEN_GOODIX_GTX8_MMI
	bool "Goodix GTx8 touchscreen"
	depends on I2C
	default y
	help
	  Say Y here if you have a Goodix GTx5xx touchscreen connected
	  to your system.

	  If unsure, say N.

if TOUCHSCREEN_GOODIX_GTX8_MMI


config TOUCHSCREEN_GOODIX_GTX8_MMI_UPDATE
	tristate "Goodix GTx8 firmware update module"
	default y
	help
	  Say Y here to enable support for doing firmware update.

	  If unsure, say N.

	  To compile this driver as a module, choose M here.

config TOUCHSCREEN_GOODIX_GTX8_MMI_GESTURE
	tristate "Goodix GTx8 gesture wakeup feature"
	default n
	help
	  Say Y here to enable support for gesture wakeup feature..

	  If unsure, say N.

	  To compile this driver as a module, choose M here.

config TOUCHSCREEN_GOODIX_GTX8_MMI_TOOLS
	tristate "Goodix touch tools support"
	default y
	help
	  Say Y here to enable debug tools.

	  If unsure, say N.

	  To compile this driver as a module, choose M here.

endif
```

## drivers/input/touchscreen/hxchipset_spi/Kconfig
```kconfig
#
# Himax Touchscreen driver configuration
#

config TOUCHSCREEN_HIMAX_COMMON
        tristate "HIMAX chipset i2c touchscreen"
        depends on TOUCHSCREEN_HIMAX_CHIPSET_SPI
        help
        This enables support for HIMAX CHIPSET over I2C based touchscreens.


# ***************** In-cell Start *****************
config TOUCHSCREEN_HIMAX_INCELL
        tristate "HIMAX chipset in-cell function"
        depends on TOUCHSCREEN_HIMAX_COMMON
        help
        This enables support for HIMAX CHIPSET of in-cell function.


config TOUCHSCREEN_HIMAX_IC_HX83112
        tristate "HIMAX chipset HX83112 function"
        depends on TOUCHSCREEN_HIMAX_INCELL
        help
        This enables support for HIMAX CHIPSET of HX83112.

config TOUCHSCREEN_HIMAX_DEBUG
        tristate "HIMAX debug function"
        depends on TOUCHSCREEN_HIMAX_COMMON
        help
        This enables support for HIMAX debug function.

config TOUCHSCREEN_HIMAX_INSPECT
        tristate "HIMAX inspect function"
        depends on TOUCHSCREEN_HIMAX_COMMON
        help
        This enables support for HIMAX debug function.

config HMX_DB
    tristate "HIMAX driver test over Dragon Board"
    depends on TOUCHSCREEN_HIMAX_COMMON
    help
      This enables support for HIMAX driver test over Dragon Board.
```

## drivers/input/touchscreen/ilitek_mmi/Kconfig
```kconfig
#
# Ipio Touchscreen driver configuration
#

config TOUCHSCREEN_ILI9881H
    bool "Ipio Touchscreen"
    depends on I2C
    default n
    help
    Say Y here if you have Ilitek touch panel.
    If unsure, say N.
```

## drivers/input/touchscreen/nova_mmi/Kconfig
```kconfig
#
# Novatek NT36xxx touchscreen driver configuration
#
config TOUCHSCREEN_NT36xxx
	bool "Novatek NT36xxx"
	depends on TOUCHSCREEN_NOVATEK_CHIPSET
	help
	  Say Y here if you have a Novatek NT36xxx touchscreen connected
	  to your system.
```

## drivers/input/touchscreen/shtps_fts/Kconfig
```kconfig
#
# Sharp Touchscreen configuration
#

config TOUCHSCREEN_FT8607
	tristate "SHARP Touchscreen FT8607"
	default n
```
