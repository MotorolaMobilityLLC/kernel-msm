## drivers/video/msm/Kconfig
```kconfig
source "drivers/video/msm/vidc/Kconfig"

config FB_MSM
	tristate "MSM Framebuffer support"
	depends on FB && ARCH_MSM
	select FB_BACKLIGHT if FB_MSM_BACKLIGHT
	select NEW_LEDS
	select LEDS_CLASS
	select FB_CFB_FILLRECT
	select FB_CFB_COPYAREA
	select FB_CFB_IMAGEBLIT
	---help---
	  Support for MSM Framebuffer.

if FB_MSM

config FB_MSM_BACKLIGHT
	bool "Support for backlight control"
	default y
	---help---
	  Say Y here if you want to control the backlight of your display.

config FB_MSM_LOGO
	bool "MSM Frame Buffer Logo"
	default n
	---help---
	  Show /initlogo.rle during boot.

config FB_MSM_LCDC_HW
	bool
	default n

config FB_MSM_TRIPLE_BUFFER
	bool "Support for triple frame buffer"
	default n

config FB_MSM_MDP_HW
	bool
	default n

config MDP_DEBUG_FS
	depends on DEBUG_FS
	bool "MDP Debug FS"
	default n

choice
	prompt "MDP HW version"
	default FB_MSM_MDP22

config FB_MSM_MDP22
	select FB_MSM_MDP_HW
	bool "MDP HW ver2.2"
	---help---
	  Support for MSM MDP HW revision 2.2
	  Say Y here if this is msm7201 variant platform.

config FB_MSM_MDP30
	select FB_MSM_LCDC_HW
	bool "MDP HW ver3.0"
	---help---
	  Support for MSM MDP HW revision 3.0
	  Say Y here if this is msm7x25 variant platform.

config FB_MSM_MDP303
	depends on FB_MSM_MDP30
	select FB_MSM_MDP_HW
	bool "MDP HW ver3.03"
	default n
	---help---
	  Support for MSM MDP HW revision 3.03. This is a new version of
	  MDP3.0 which has the required functionality to support the features
	  required for msm7x2xA platform.
	  Say Y here if this is msm7x2xA variant platform.

config FB_MSM_MDP31
	select FB_MSM_LCDC_HW
	select FB_MSM_MDP_HW
	bool "MDP HW ver3.1"
	---help---
	  Support for MSM MDP HW revision 3.1
	  Say Y here if this is msm8x50 variant platform.

config FB_MSM_MDP40
	select FB_MSM_LCDC_HW
	select FB_MSM_MDP_HW
	bool "MDP HW ver4.0"
	---help---
	  Support for MSM MDP HW revision 4.0
	  Say Y here if this is msm7x30 variant platform.

config FB_MSM_MDSS
	bool "MDSS HW"
	---help---
	The Mobile Display Sub System (MDSS) driver supports devices which
	contain MDSS hardware block.

	The MDSS driver implements frame buffer interface to provide access to
	the display hardware and provide a way for users to display graphics
	on connected display panels.

config FB_MSM_MDP_NONE
	bool "MDP HW None"
	---help---
	  Say Y here if this is mdm platform.

endchoice

config FB_MSM_EBI2
	bool
	default n

config FB_MSM_MDDI
	bool
	default n

config FB_MSM_MIPI_DSI
	bool
	default n

config FB_MSM_LCDC
	bool
	default n

config FB_MSM_LVDS
	bool
	default n

config FB_MSM_OVERLAY
	depends on FB_MSM_MDP40 && ANDROID_PMEM
	bool "MDP4 overlay support"
	default n

config FB_MSM_DTV
	depends on FB_MSM_OVERLAY
	bool
	default n

config FB_MSM_EXTMDDI
	bool
	default n

config FB_MSM_TVOUT
	bool
	default n

config FB_MSM_MDDI_TOSHIBA_COMMON
	bool
	select FB_MSM_MDDI
	default n

config FB_MSM_MDDI_TOSHIBA_COMMON_VGA
	bool
	select FB_MSM_MDDI_TOSHIBA_COMMON
	default n

config FB_MSM_MDDI_ORISE
	bool
	select FB_MSM_MDDI
	default n

config FB_MSM_MDDI_QUICKVX
	bool
	select FB_MSM_MDDI
	default n

config FB_MSM_MDDI_AUTO_DETECT
	bool
	select FB_MSM_MDDI
	default n

config FB_MSM_LCDC_AUTO_DETECT
	bool
	select FB_MSM_LCDC
	default n

config FB_MSM_LCDC_PANEL
	bool
	select FB_MSM_LCDC
	default n

config FB_MSM_MIPI_DSI_TOSHIBA
	bool
	select FB_MSM_MIPI_DSI
	default n

config FB_MSM_MIPI_DSI_LGIT
	bool
	select FB_MSM_MIPI_DSI
	default n

config FB_MSM_MIPI_DSI_RENESAS
	bool
	select FB_MSM_MIPI_DSI
	default n

config FB_MSM_MIPI_DSI_TRULY
	bool
	select FB_MSM_MIPI_DSI

config FB_MSM_MIPI_DSI_SIMULATOR
	bool
	select FB_MSM_MIPI_DSI
	default n

config FB_MSM_MIPI_DSI_NOVATEK
        bool
        select FB_MSM_MIPI_DSI
        default n

config FB_MSM_MIPI_DSI_LG
	bool
	select FB_MSM_MIPI_DSI
	default n

config FB_MSM_MIPI_DSI_JDI
	bool
	select FB_MSM_MIPI_DSI
	default n

config FB_MSM_MIPI_DSI_NT35510
	bool
	select FB_MSM_MIPI_DSI

config FB_MSM_MIPI_DSI_ORISE
        bool
        select FB_MSM_MIPI_DSI
        default n

config FB_MSM_MIPI_DSI_NT35516
	bool
	select FB_MSM_MIPI_DSI

config FB_MSM_MIPI_DSI_TC358764_DSI2LVDS
	bool
	select FB_MSM_MIPI_DSI
	---help---
	  Support for Toshiba MIPI DSI-to-LVDS bridge.
	  The chip supports 1366x768 24-bit
	  using a single LVDS link
	  and up to WUXGA 1920x1200 18-bit
	  using a dual LVDS link.

config FB_MSM_LCDC_ST15_WXGA
    bool
    select FB_MSM_LCDC_PANEL
    default n

config FB_MSM_LCDC_ST15_PANEL
    depends on FB_MSM_LCDC_HW
    bool "LCDC ST1.5 Panel"
    select FB_MSM_LCDC_ST15_WXGA
    ---help---
      Support for ST1.5 WXGA (1366x768) panel

config FB_MSM_LCDC_PRISM_WVGA
	bool
	select FB_MSM_LCDC_PANEL
	default n

config FB_MSM_LCDC_SAMSUNG_WSVGA
	bool
	select FB_MSM_LCDC_PANEL
	default n

config FB_MSM_LCDC_CHIMEI_WXGA
	bool
	select FB_MSM_LCDC_PANEL
	default n

config FB_MSM_LCDC_GORDON_VGA
	bool
	select FB_MSM_LCDC_PANEL
	default n

config FB_MSM_LCDC_TOSHIBA_WVGA_PT
	bool
	select FB_MSM_LCDC_PANEL
	default n

config FB_MSM_LCDC_TOSHIBA_FWVGA_PT
	bool
	select FB_MSM_LCDC_PANEL
	default n

config FB_MSM_LCDC_SHARP_WVGA_PT
	bool
	select FB_MSM_LCDC_PANEL
	default n

config FB_MSM_LCDC_AUO_WVGA
	bool
	select FB_MSM_LCDC_PANEL
	default n

config FB_MSM_LCDC_TRULY_HVGA_IPS3P2335
        bool
        select FB_MSM_LCDC_PANEL
        default n

config FB_MSM_LCDC_TRULY_HVGA_IPS3P2335_PT_PANEL
        depends on FB_MSM_LCDC_HW
        bool "LCDC Truly HVGA PT Panel"
        select FB_MSM_LCDC_TRULY_HVGA_IPS3P2335
        default n
        ---help---
        Support for LCDC Truly HVGA PT panel


config FB_MSM_LCDC_SAMSUNG_OLED_PT
	bool
	select FB_MSM_LCDC_PANEL
	default n

config FB_MSM_LCDC_NT35582_WVGA
	bool
	select FB_MSM_LCDC_PANEL
	default n

config FB_MSM_LCDC_WXGA
	bool
	select FB_MSM_LCDC_PANEL
	default n

config FB_MSM_MIPI_LGIT_VIDEO_WXGA_PT
	bool
	select FB_MSM_MIPI_DSI_LGIT
	default n

config FB_MSM_LVDS_CHIMEI_WXGA
	bool
	select FB_MSM_LVDS
	default n

config FB_MSM_MIPI_TOSHIBA_VIDEO_WVGA_PT
	bool
	select FB_MSM_MIPI_DSI_TOSHIBA
	default n

config FB_MSM_MIPI_TOSHIBA_VIDEO_WSVGA_PT
	bool
	select FB_MSM_MIPI_DSI_TOSHIBA
	default n

config FB_MSM_MIPI_TOSHIBA_VIDEO_WUXGA
	bool
	select FB_MSM_MIPI_DSI_TOSHIBA
	default n

config FB_MSM_MIPI_NOVATEK_VIDEO_QHD_PT
	bool
	select FB_MSM_MIPI_DSI_NOVATEK
	default n

config FB_MSM_MIPI_NOVATEK_CMD_QHD_PT
	bool
	select FB_MSM_MIPI_DSI_NOVATEK
	default n

config FB_MSM_MIPI_NOVATEK_1080_HD_PT
	bool
	select FB_MSM_MIPI_DSI_NOVATEK
	default n

config FB_MSM_MIPI_LG_1080_HD_PT
	bool
	select FB_MSM_MIPI_DSI_LG
	default n

config FB_MSM_MIPI_JDI_1080_HD_PT
	bool
	select FB_MSM_MIPI_DSI_JDI
	default n

config FB_MSM_MIPI_ORISE_VIDEO_720P_PT
	bool
	select FB_MSM_MIPI_DSI_ORISE
	default n

config FB_MSM_MIPI_ORISE_CMD_720P_PT
	bool
	select FB_MSM_MIPI_DSI_ORISE
	default n

config FB_MSM_MIPI_RENESAS_VIDEO_FWVGA_PT
	bool
	select FB_MSM_MIPI_DSI_RENESAS
	default n

config FB_MSM_MIPI_RENESAS_CMD_FWVGA_PT
	bool
	select FB_MSM_MIPI_DSI_RENESAS
	default n

config FB_MSM_MIPI_NT35510_VIDEO_WVGA_PT
	bool
	select FB_MSM_MIPI_DSI_NT35510
	default n

config FB_MSM_MIPI_NT35510_CMD_WVGA_PT
	bool
	select FB_MSM_MIPI_DSI_NT35510
	default n

config FB_MSM_MIPI_NT35516_VIDEO_QHD_PT
        bool
        select FB_MSM_MIPI_DSI_NT35516
        default n

config FB_MSM_MIPI_NT35516_CMD_QHD_PT
        bool
        select FB_MSM_MIPI_DSI_NT35516
        default n


config FB_MSM_MIPI_CHIMEI_WXGA
	bool "LVDS Chimei WXGA Panel using Toshiba MIPI DSI-to-LVDS bridge."
	select FB_MSM_MIPI_DSI_TC358764_DSI2LVDS
	---help---
	  Support for Chimei WXGA (1366x768) panel.
	  The panel is using a serial LVDS input.
	  The panel is connected to the host
	  via Toshiba DSI-to-LVDS bridge.

config FB_MSM_MIPI_CHIMEI_WUXGA
	bool "LVDS Chimei WUXGA Panel using Toshiba MIPI DSI-to-LVDS bridge."
	select FB_MSM_MIPI_DSI_TC358764_DSI2LVDS
	---help---
	  Support for Chimei WUXGA (1920x1200) panel.
	  The panel is using a serial LVDS input.
	  The panel is connected to the host
	  via Toshiba DSI-to-LVDS bridge.

config FB_MSM_MIPI_TRULY_VIDEO_WVGA_PT
	bool
	select FB_MSM_MIPI_DSI_TRULY

config FB_MSM_MIPI_SIMULATOR_VIDEO
	bool
	select FB_MSM_MIPI_DSI_SIMULATOR
	default n

config FB_MSM_NO_MDP_PIPE_CTRL
	depends on FB_MSM_OVERLAY
	bool "Do not use mdp_pipe_ctrl"
	---help---
	  Saying 'Y' here obsoletes the mdp_pipe_ctrl function,
	  which was used to control mdp-related clocks. MDP4 vsync-driven
	  screen updates will use a different clock control mechanism if
	  this is selected.

config FB_MSM_OVERLAY0_WRITEBACK
	depends on FB_MSM_OVERLAY
        bool "MDP overlay0 write back mode enable"
	---help---
	  Support for MDP4 OVERLAY0 write back mode


config FB_MSM_OVERLAY1_WRITEBACK
        depends on FB_MSM_OVERLAY
        bool "MDP overlay1 write back mode enable"
        ---help---
          Support for MDP4 OVERLAY1 write back mode

config FB_MSM_WRITEBACK_MSM_PANEL
	depends on FB_MSM_OVERLAY
        bool "MDP overlay write back panel enable"
	---help---
	  Support for MDP4 OVERLAY write back mode

# need to config multiple mipi panels simultaneously in ASUS project

config FB_MSM_MIPI_NOVATEK_VIDEO_MODE
	bool "MIPI NOVATEK 1080P HD PT Panel"
	select FB_MSM_MIPI_NOVATEK_1080_HD_PT

config FB_MSM_MIPI_LG_VIDEO_MODE
	bool "MIPI LG 1080P HD PT Panel"
	select FB_MSM_MIPI_LG_1080_HD_PT

config FB_MSM_MIPI_JDI_CMD_MODE
	bool "MIPI JDI 1080P HD PT Panel"
	select FB_MSM_MIPI_JDI_1080_HD_PT

# end the multiple mipi panels config

# remove the choice

config LGIT_VIDEO_WXGA_CABC
	bool "Content Adaptive Backlight Control on LGIT WXGA Panel"
	default y
	depends on FB_MSM_MIPI_LGIT_VIDEO_WXGA_PT_PANEL
	help
	  Enable CABC(Content Apaptive Backlight Control) on LGIT Panel
	  to reduce power consumption

choice
	prompt "Secondary LCD Panel"
	depends on  FB_MSM_MDP31
	default FB_MSM_SECONDARY_PANEL_NONE

config FB_MSM_LCDC_EXTERNAL_WXGA
	depends on FB_MSM_MDP31
	bool "External WXGA on LCDC"
	select FB_MSM_LCDC_PANEL
	---help---
	  Support for external WXGA display (1280x720)

config FB_MSM_HDMI_SII_EXTERNAL_720P
	depends on FB_MSM_MDP31
	bool "External SiI9022 HDMI 720P"
	select FB_MSM_LCDC_PANEL
	---help---
	  Support for external HDMI 720p display (1280x720p)
	  Using SiI9022 chipset

config FB_MSM_SECONDARY_PANEL_NONE
	bool "NONE"
	---help---
	  No secondary panel
endchoice

config FB_MSM_LCDC_DSUB
	depends on FB_MSM_LCDC_SAMSUNG_WSVGA && FB_MSM_MDP40 && FB_MSM_LCDC_HW
	bool "External DSUB support"
	default n
	---help---
	  Support for external DSUB (VGA) display up to 1440x900.  The DSUB
	  display shares the same video bus as the primary LCDC attached display.
	  Typically only one of the two displays can be used at one time.

config FB_MSM_EXT_INTERFACE_COMMON
	bool
	default n

config FB_MSM_HDMI_COMMON
	bool
	default n

config FB_MSM_HDMI_3D
	bool
	default n

config FB_MSM_HDMI_ADV7520_PANEL
	depends on FB_MSM_MDP40 && FB_MSM_OVERLAY
        bool "LCDC HDMI ADV7520 720p Panel"
        select FB_MSM_DTV
        select FB_MSM_EXT_INTERFACE_COMMON
	select FB_MSM_HDMI_COMMON
	default n
        ---help---
        Support for LCDC 720p HDMI panel attached to ADV7520

config FB_MSM_HDMI_ADV7520_PANEL_HDCP_SUPPORT
        depends on FB_MSM_HDMI_ADV7520_PANEL
        bool "Use HDCP mode"
        default y
        ---help---
          Support for HDCP mode for ADV7520 HDMI 720p Panel
          Choose to enable HDCP


config FB_MSM_HDMI_MSM_PANEL
	depends on FB_MSM_MDP40
	bool "MSM HDMI 1080p Panel"
	select FB_MSM_DTV
        select FB_MSM_EXT_INTERFACE_COMMON
	select FB_MSM_HDMI_COMMON
	select FB_MSM_HDMI_3D
	default n
	---help---
	  Support for 480p/720p/1080i/1080p output through MSM HDMI

config FB_MSM_HDMI_MSM_PANEL_DVI_SUPPORT
	depends on FB_MSM_HDMI_MSM_PANEL
	bool "Use DVI mode"
	default n
	---help---
	  Support for DVI mode for MSM HDMI 1080p Panel

config FB_MSM_HDMI_MSM_PANEL_CEC_SUPPORT
	depends on FB_MSM_HDMI_MSM_PANEL
	bool "Enable CEC"
	default n
	---help---
	  Support for HDMI CEC Feature
	  Choose to enable CEC

config FB_MSM_HDMI_MHL_9244
	depends on FB_MSM_HDMI_MSM_PANEL
	bool 'SI_MHL 9244 support'
	default n
	---help---
	  Support the HDMI to MHL conversion.
	  MHL (Mobile High-Definition Link) technology
	  uses USB connector to output HDMI content

config FB_MSM_HDMI_MHL_8334
	depends on FB_MSM_HDMI_MSM_PANEL
	bool 'SI_MHL 8334 support '
	default n
	---help---
	  Support the HDMI to MHL conversion.
	  MHL (Mobile High-Definition Link) technology
	  uses USB connector to output HDMI content

choice
	depends on  (FB_MSM_MDP22 || FB_MSM_MDP31 || FB_MSM_MDP40)
	prompt "TVOut Region"
	default FB_MSM_TVOUT_NONE

config FB_MSM_TVOUT_NTSC_M
	bool "NTSC M"
	select FB_MSM_TVOUT
        select FB_MSM_EXT_INTERFACE_COMMON
	---help---
	  Support for NTSC M region (North American and Korea)

config FB_MSM_TVOUT_NTSC_J
	bool "NTSC J"
	select FB_MSM_TVOUT
        select FB_MSM_EXT_INTERFACE_COMMON
	---help---
	  Support for NTSC J region (Japan)

config FB_MSM_TVOUT_PAL_BDGHIN
	bool "PAL BDGHIN"
	select FB_MSM_TVOUT
        select FB_MSM_EXT_INTERFACE_COMMON
	---help---
	  Support for PAL BDGHIN region (Non-argentina PAL-N)

config FB_MSM_TVOUT_PAL_M
	bool "PAL M"
	select FB_MSM_TVOUT
        select FB_MSM_EXT_INTERFACE_COMMON
	---help---
	  Support for PAL M region

config FB_MSM_TVOUT_PAL_N
	bool "PAL N"
	select FB_MSM_TVOUT
        select FB_MSM_EXT_INTERFACE_COMMON
	---help---
	  Support for PAL N region (Argentina PAL-N)

config FB_MSM_TVOUT_NONE
	bool "NONE"
	---help---
	  This will disable TV Out functionality.
endchoice

config FB_MSM_TVOUT_SVIDEO
	bool "TVOut on S-video"
	depends on FB_MSM_TVOUT
	default n
	---help---
	  Selects whether the TVOut signal uses S-video.
	  Choose n for composite output.

choice
	depends on  FB_MSM_MDP22
	prompt "External MDDI"
	default FB_MSM_EXTMDDI_SVGA

config FB_MSM_EXTMDDI_SVGA
	bool "External MDDI SVGA"
	select FB_MSM_MDDI
	select FB_MSM_EXTMDDI
	---help---
	  Support for MSM SVGA (800x600) external MDDI panel

config FB_MSM_EXTMDDI_NONE
	bool "NONE"
	---help---
	  This will disable External MDDI functionality.
endchoice

choice
	prompt "Default framebuffer color depth"
	depends on FB_MSM_MDP40 || FB_MSM_MDP31 || FB_MSM_MDP303
	default FB_MSM_DEFAULT_DEPTH_RGBA8888

config FB_MSM_DEFAULT_DEPTH_RGB565
	bool "16 bits per pixel (RGB565)"

config FB_MSM_DEFAULT_DEPTH_ARGB8888
	bool "32 bits per pixel (ARGB8888)"

config FB_MSM_DEFAULT_DEPTH_RGBA8888
	bool "32 bits per pixel (RGBA8888)"

endchoice

config FB_MSM_EBI2_EPSON_S1D_QVGA_PANEL
	bool "EBI2 Epson QVGA Panel"
	select FB_MSM_EBI2
	default n
	---help---
	  Support for EBI2 Epson QVGA (240x320) panel

config FB_MSM_EBI2_PANEL_DETECT
	bool "EBI2 Panel Detect"
	select FB_MSM_EBI2_EPSON_S1D_QVGA_PANEL
	default n
	---help---
	  Support for EBI2 panel auto detect

if FB_MSM_MDSS
	source "drivers/video/msm/mdss/Kconfig"
endif
endif
```

## drivers/video/msm/mdss/Kconfig
```kconfig
config FB_MSM_MDSS_WRITEBACK
	bool "MDSS Writeback Panel"
	---help---
	The MDSS Writeback Panel provides support for routing the output of
	MDSS frame buffer driver and MDP processing to memory.

config FB_MSM_MDSS_HDMI_PANEL
	depends on FB_MSM_MDSS
	bool "MDSS HDMI Tx Panel"
	default n
	---help---
	The MDSS HDMI Panel provides support for transmitting TMDS signals of
	MDSS frame buffer data to connected hdmi compliant TVs, monitors etc.

config FB_MSM_MDSS_HDMI_MHL_SII8334
	depends on FB_MSM_MDSS_HDMI_PANEL
	bool 'MHL SII8334 support '
	default n
	---help---
	  Support the HDMI to MHL conversion.
	  MHL (Mobile High-Definition Link) technology
	  uses USB connector to output HDMI content

config FB_MSM_MDSS_UD_FLIP
	depends on FB_MSM_MDSS
	bool 'Use MDSS flip for Upside down flipped LCD'
	default n
	---help---
	  Support upside down flipped LCD
	  MDSS pipe flip operation mode is used
```
