## drivers/video/msm/msm_dba/Kconfig
```kconfig
#
# MSM DBA
#

config MSM_DBA
	bool "MSM Display Bridge Abstraction support"
	depends on ARM || ARM64
	---help---
	  Support for MSM display bridge abstraction interface. MSM display
	  drivers can use the same interface to interact with different third
	  party bridge chips. Drivers implemented for third party bridge chips
	  should support this interface to allow display driver to control the
	  bridge chip. The MSM DBA driver maintains a list of devices supported
	  on the platform and allow clients to register and access these
	  devices.

config MSM_DBA_ADV7533
	bool "ADV7533 driver support through MSM DBA interface"
	depends on MSM_DBA
	default n
	---help---
	  Support for ADV7533 DSI to HDMI display bridge driver. The driver
	  controls the ADV7533 HW through the I2C interface and configures
	  the DSI input and HDMI output video format.

config MSM_DBA_MOT_DBA
	bool "MOT DBA driver support through MSM DBA interface"
	select MSM_DBA
	default n
	---help---
	 Support for MOT DBA Framework. Since QCOM MSM DBA only support
	 single DBA driver to connect to the MSM DBA framework at a time.
	 With MOT DBA framework, it will register with QCOM MSM DBA as a
         DBA driver but it will control many other sub-DBA drivers.

config MSM_DBA_DSI_MOD_DISPLAY
	bool "DSI Mod Display driver support through MSM DBA interface"
	select MSM_DBA_MOT_DBA
	select PANEL_NOTIFICATIONS
	default n
```
