## drivers/staging/qcacld-3.0/configs/whunt_defconfig
```kconfig
#Enable 6 GHz Band
CONFIG_BAND_6GHZ := y

#Enable 11AX Feature
CONFIG_WLAN_FEATURE_11AX := y

include $(WLAN_ROOT)/configs/default_defconfig

#Enable BUS bandwidth Feature
CONFIG_WLAN_FEATURE_DP_BUS_BANDWIDTH := y

#Disable PM_QOS not supported in WHUNT
CONFIG_WLAN_CLD_PM_QOS := n
```

## drivers/staging/sep54/Kconfig
```kconfig
config DX_SEP54
	tristate "Discretix SEP driver (CC54)"
	depends on PCI && MMC
	select CRYPTO_BLKCIPHER
	help
	  Discretix SEP driver for CC54; used for the security processor subsystem
	  on board the Intel Mobile Internet Device and adds SEP availability
	  to the kernel crypto infrastructure

	  The driver's name is sep_driver.

	  If unsure, select N.
```

## drivers/staging/zram/Kconfig
```kconfig
config ZRAM
	tristate "Compressed RAM block device support"
	depends on BLOCK && SYSFS && ZSMALLOC
	select LZO_COMPRESS
	select LZO_DECOMPRESS
	default n
	help
	  Creates virtual block devices called /dev/zramX (X = 0, 1, ...).
	  Pages written to these disks are compressed and stored in memory
	  itself. These disks allow very fast I/O and compression provides
	  good amounts of memory savings.

	  It has several use cases, for example: /tmp storage, use as swap
	  disks and maybe many more.

	  See zram.txt for more information.
	  Project home: <https://compcache.googlecode.com/>

config ZRAM_LZ4_COMPRESS
	bool "Enable LZ4 algorithm support"
	depends on ZRAM
	select LZ4_COMPRESS
	select LZ4_DECOMPRESS
	default n
	help
	  This option enables LZ4 compression algorithm support, instead
	  of the default LZO.  LZ4 may be faster on some architectures
	  compared to LZO compression.

	  See https://code.google.com/p/lz4/ for more information about LZ4.

config ZRAM_DEBUG
	bool "Compressed RAM block device debug support"
	depends on ZRAM
	default n
	help
	  This option adds additional debugging code to the compressed
	  RAM block device driver.
```

## drivers/switch/Kconfig
```kconfig
menuconfig SWITCH
	tristate "Switch class support"
	help
	  Say Y here to enable switch class support. This allows
	  monitoring switches by userspace via sysfs and uevent.

if SWITCH

config SWITCH_GPIO
	tristate "GPIO Swith support"
	depends on GPIOLIB
	help
	  Say Y here to enable GPIO based switch support.

config SWITCH_MADERA
        tristate "Cirrus Logic Madera codec support"
        depends on MFD_MADERA && INPUT && SND_SOC
	help
	  Say Y here to enable support for external accessory detection
	  on Cirrus Logic Madera class codecs.

endif # SWITCH
```

## drivers/thermal/Kconfig
```kconfig
#
# Generic thermal sysfs drivers configuration
#

menuconfig THERMAL
	tristate "Generic Thermal sysfs driver"
	help
	  Generic Thermal Sysfs driver offers a generic mechanism for
	  thermal management. Usually it's made up of one or more thermal
	  zone and cooling device.
	  Each thermal zone contains its own temperature, trip points,
	  cooling devices.
	  All platforms with ACPI thermal support can use this driver.
	  If you want this support, you should say Y or M here.

config THERMAL_HWMON
	bool
	depends on THERMAL
	depends on HWMON=y || HWMON=THERMAL
	default y

config THERMAL_MSM_POPMEM
	tristate "Qualcomm MSM POP memory temperature sensor"
	depends on THERMAL
	default n
	help
	  This enables a thermal sysfs driver for MSM POP memory. It shows up in
	  sysfs as a thermal zone with one trip point. Due to hardware
	  limitations, the temperatures are reported as "Low Temperature" (20 C)
	  "Normal Temperature" (50 C) and "Out of Spec High Temperature" (85 C).
	  This driver is designed to be used in conjunction with a user space
	  application to make all policy decisions.

config THERMAL_TSENS
	tristate "Qualcomm Tsens Temperature Alarm"
	depends on THERMAL
	default n
	help
	  This enables the thermal sysfs driver for the Tsens device. It shows
	  up in Sysfs as a thermal zone with mutiple trip points. Disabling the
	  thermal zone device via the mode file results in disabling the sensor.
	  Also able to set threshold temperature for both hot and cold and update
	  when a threshold is reached.

config SPEAR_THERMAL
	bool "SPEAr thermal sensor driver"
	depends on THERMAL
	depends on PLAT_SPEAR
	help
	  Enable this to plug the SPEAr thermal sensor driver into the Linux
	  thermal framework
```

## drivers/tty/diag/Kconfig
```kconfig
menu "DIAG traffic through userspace"

config DIAG_INTERNAL
	bool "Enable DIAG traffic on tty to userspace"
        depends on ARCH_MSM
	default n
	help
	 This feature helps segregate code required for DIAG traffic to be routed to userspace.
endmenu
```

## drivers/ufs/host/Kconfig
```kconfig
# SPDX-License-Identifier: GPL-2.0+
#
# Kernel configuration file for the UFS host controller drivers.
#
# Copyright (C) 2011-2013 Samsung India Software Operations
#
# Authors:
#	Santosh Yaraganavi <santosh.sy@samsung.com>
#	Vinayak Holikatti <h.vinayak@samsung.com>

config UFS_DBG
	bool "Universal Flash Storage Debug Mode"
	depends on SCSI_UFSHCD
	help
	This selects the debug mode for ufs vendor driver.
	  Enables tracing for QTI ufs driver.
	  This also enables ftrace for ufs core and SCSI.
	  Enabling this would have an adverse performance impact on disk IO.

	  If unsure, say N.

config SCSI_UFS_QCOM
	tristate "QCOM specific hooks to UFS controller platform driver"
	depends on SCSI_UFSHCD_PLATFORM && ARCH_QCOM
	depends on GENERIC_MSI_IRQ
	depends on RESET_CONTROLLER
	select QCOM_INLINE_CRYPTO_ENGINE if SCSI_UFS_CRYPTO
	help
	  This selects the QCOM specific additions to UFSHCD platform driver.
	  UFS host on QCOM needs some vendor specific configuration before
	  accessing the hardware which includes PHY configuration and vendor
	  specific registers.

	  Select this if you have UFS controller on QCOM chipset.
	  If unsure, say N.

config SCSI_UFS_CRYPTO_QTI
	tristate "UFS Crypto Engine Support for QCOM Hardware Wrapped Keys"
	depends on SCSI_UFS_CRYPTO && SCSI_UFS_QCOM && QCOM_INLINE_CRYPTO_ENGINE
	help
	  Enable Crypto Engine Support in UFS for QCOM chipsets supporting
	  wrapped keys. This is explicitly required until wrapped keys support
	  for QCOM chipsets is part of Linux upstream.

	  Select this to enable QCOM Hardware Wrapped Key support for the
	  ICE hardware.
```

## drivers/usb/dwc3/Kconfig
```kconfig
config USB_DWC3
	tristate "DesignWare USB3 DRD Core Support"
	depends on (USB || USB_GADGET) && GENERIC_HARDIRQS
	select USB_XHCI_PLATFORM if USB_SUPPORT && USB_XHCI_HCD
	help
	  Say Y or M here if your system has a Dual Role SuperSpeed
	  USB controller based on the DesignWare USB3 IP Core.

	  If you choose to build this driver is a dynamically linked
	  module, the module will be called dwc3.ko.

if USB_DWC3

choice
	bool "DWC3 Mode Selection"
	default USB_DWC3_DUAL_ROLE if (USB && USB_GADGET)
	default USB_DWC3_HOST if (USB && !USB_GADGET)
	default USB_DWC3_GADGET if (!USB && USB_GADGET)

config USB_DWC3_HOST
	bool "Host only mode"
	depends on USB=y || USB=USB_DWC3
	help
	  Select this when you want to use DWC3 in host mode only,
	  thereby the gadget feature will be regressed.

config USB_DWC3_GADGET
	bool "Gadget only mode"
	depends on USB_GADGET=y || USB_GADGET=USB_DWC3
	help
	  Select this when you want to use DWC3 in gadget mode only,
	  thereby the host feature will be regressed.

config USB_DWC3_DUAL_ROLE
	bool "Dual Role mode"
	depends on ((USB=y || USB=USB_DWC3) && (USB_GADGET=y || USB_GADGET=USB_DWC3))
	help
	  This is the default mode of working of DWC3 controller where
	  both host and gadget features are enabled.

endchoice

comment "Platform Glue Driver Support"

config USB_DWC3_OMAP
	tristate "Texas Instruments OMAP5 and similar Platforms"
	depends on EXTCON
	default USB_DWC3
	help
	  Some platforms from Texas Instruments like OMAP5, DRA7xxx and
	  AM437x use this IP for USB2/3 functionality.

	  Say 'Y' or 'M' here if you have one such device

config USB_DWC3_EXYNOS
	tristate "Samsung Exynos Platform"
	default USB_DWC3
	help
	  Recent Exynos5 SoCs ship with one DesignWare Core USB3 IP inside,
	  say 'Y' or 'M' if you have one such device.

config USB_DWC3_PCI
	tristate "PCIe-based Platforms"
	depends on PCI
	default USB_DWC3
	help
	  If you're using the DesignWare Core IP with a PCIe, please say
	  'Y' or 'M' here.

	  One such PCIe-based platform is Synopsys' PCIe HAPS model of
	  this IP.

config USB_DWC3_OTG
	tristate "DWC3 OTG mode support"
	depends on USB && PCI
	select USB_OTG
	help
	  Say Y here to enable DWC3 OTG driver.
	  This driver implement OTG framework for DWC3 OTG controller.
	  Support role switch and charger detection feature. And maintain
	  one state machine. This driver should be work with platform
	  speical driver. Because every platform has their own hardware design.

config USB_DWC3_INTEL_MRFL
	tristate "DWC OTG 3.0 for Intel Merrifield platforms"
	depends on USB && USB_DWC3_OTG
	select USB_DWC3_DEVICE_INTEL
	help
	  Say Y here to enable DWC3 OTG driver for Intel Merrifield platforms.
	  It implement OTG feature on DWC3 OTG controller.
	  Support role switch and charger detection feature.
	  This driver is must be set if you want to enable host mode on Intel
	  Merrifield platforms.

config USB_DWC3_INTEL_BYT
	tristate "DWC OTG 3.0 for Intel Baytrail platforms"
	depends on USB && USB_DWC3_OTG
	select USB_DWC3_DEVICE_INTEL
	help
	  Say Y here to enable DWC3 OTG driver for Intel Baytrail platforms.
	  It implement OTG feature on DWC3 OTG controller.
	  Support role switch and charger detection feature.
	  This driver is must be set if you want to enable device mode on Intel
	  Baytrial platforms.

config USB_DWC3_INTEL_CHT
	tristate "DWC OTG 3.0 for Intel Cherrytrail platform"
	depends on USB && USB_DWC3_OTG
	select USB_DWC3_DEVICE_INTEL
	help
	  Say Y here to enable DWC3 OTG driver for Intel Cherrytrail platforms.
	  It implement OTG feature on DWC3 OTG controller.
	  Support role switch and charger detection feature.
	  This driver is must be set if you want to enable device mode on Intel
	  Baytrial platforms.

config USB_DWC3_DEVICE_INTEL
	bool "DWC3 Device Mode support on Intel platform"
	depends on USB_DWC3_OTG
	help
	  Support Device mode of DWC3 controller on Intel platform.
	  It implement device mode feature on DWC3 OTG controller.
	  This driver is must be set if you want to enable device mode for Intel
	  platforms(e.g Baytrail and Merrifield)

config USB_DWC3_HOST_INTEL
	bool "DWC3 Host Mode support on Intel Merrifield platform"
	depends on USB_ARCH_HAS_XHCI && USB_DWC3_INTEL_MRFL
	help
	  Support Host mode of DWC3 controller on Intel Merrifield platform.
	  It is should be enable with DWC3 INTEL driver. Because Intel platform
	  use different design with standard USB_DWC3_HOST. So if you want to
	  enable host mode on Intel platform, then you have to enable this config.

comment "Debugging features"

config USB_DWC3_DEBUG
	bool "Enable Debugging Messages"
	help
	  Say Y here to enable debugging messages on DWC3 Driver.

config USB_DWC3_VERBOSE
	bool "Enable Verbose Debugging Messages"
	depends on USB_DWC3_DEBUG
	help
	  Say Y here to enable verbose debugging messages on DWC3 Driver.

endif
```

## drivers/usb/typec/Kconfig
```kconfig
config TYPEC
	bool "support Type C feature"
	default n
	---help---
	  Say Y here to support Type C feature

source "drivers/usb/typec/tusb320/Kconfig"
```

## drivers/usb/typec/altmodes/Kconfig
```kconfig
# SPDX-License-Identifier: GPL-2.0

menu "USB Type-C Alternate Mode drivers"

config TYPEC_DP_ALTMODE
	tristate "DisplayPort Alternate Mode driver"
	help
	  DisplayPort USB Type-C Alternate Mode allows DisplayPort
	  displays and adapters to be attached to the USB Type-C
	  connectors on the system.

	  To compile this driver as a module, choose M here: the
	  module will be called typec_displayport.

config TYPEC_NVIDIA_ALTMODE
	tristate "NVIDIA Alternate Mode driver"
	depends on TYPEC_DP_ALTMODE
	help
	  Latest NVIDIA GPUs support VirtualLink devices. Select this
	  to enable support for VirtualLink devices with NVIDIA GPUs.

	  To compile this driver as a module, choose M here: the
	  module will be called typec_nvidia.

config TYPEC_QTI_ALTMODE
	tristate "DisplayPort Alternate Mode QTI DP display bridge"
	depends on TYPEC_DP_ALTMODE
	help
	  Select this option to integrate QTI DP display driver with
          generic TypeC altmode displayport implementation that may
          work with any 3rd party PD controller integrated with
          generic TypeC Policy Manager (tcpm).

	  Choose the same option as in TYPEC_DP_ALTMODE. This option
	  will only add a bridging capabilities into typec displayport.

endmenu
```

## drivers/usb/typec/tusb320/Kconfig
```kconfig
# TI Type C Connector

config TUSB320_TYPEC
	tristate "tusb320 typec connector"
	depends on TYPEC && GPIOLIB && I2C
	default n
	help
	  Say Y here to enable tusb320 Type C Connector support.
```

## drivers/video/fbdev/slimport/anx7805/Kconfig
```kconfig
config SLIMPORT_ANX7805
	tristate "Analogix Slimport transmitter ANX7805 support"
	select MSM_DBA_MOT_DBA
	help
	  Slimport Transmitter is a HD video transmitter chip over micro-USB connector for smartphone device.
```

## drivers/video/fbdev/slimport/anx7816/Kconfig
```kconfig
config SLIMPORT_ANX7816
	tristate "Analogix Slimport transmitter ANX7816 support"
	help
	  Slimport Transmitter is a 2K/4K video transmitter chip
	  over micro-USB connector for smartphone device.

config SLIMPORT_DYNAMIC_HPD
	tristate "ANX7816 support for dynamic HDMI HPD control"
	help
	  Slimport set HPD when cable is connected,
	  HDMI clk is off during slimport cable is not connected
```
