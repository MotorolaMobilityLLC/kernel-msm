## drivers/staging/qcacld-3.0/configs/genoa.sdio.perf_defconfig
```kconfig
include $(WLAN_ROOT)/configs/genoa.common

# Interface specific features
CONFIG_CLD_HL_SDIO_CORE := y
CONFIG_QCA_WIFI_SDIO := y
CONFIG_ROME_IF = sdio
CONFIG_HIF_SDIO := y
CONFIG_LINUX_QCMBR := y
CONFIG_SDIO_TRANSFER = adma
CONFIG_PLD_SDIO_CNSS2 := y

# Data Path specific features
CONFIG_ATH_11AC_TXCOMPACT := n
CONFIG_QCA_HL_NETDEV_FLOW_CONTROL := y
CONFIG_TX_RESOURCE_HIGH_TH_IN_PER := 8
CONFIG_TX_RESOURCE_LOW_TH_IN_PER := 2
CONFIG_FEATURE_HL_GROUP_CREDIT_FLOW_CONTROL := y
CONFIG_FEATURE_HL_DBS_GROUP_CREDIT_SHARING := y
CONFIG_CREDIT_REP_THROUGH_CREDIT_UPDATE := y
CONFIG_HL_DP_SUPPORT := y

# Debug specific features
CONFIG_MPC_UT_FRAMEWORK := n
CONFIG_FEATURE_EPPING := n
CONFIG_WLAN_FEATURE_P2P_DEBUG := n
CONFIG_WLAN_LOG_ENTER := n
CONFIG_WLAN_LOG_EXIT := n

# Features gets enabled on slub debug
CONFIG_FEATURE_PKTLOG := y
CONFIG_WLAN_DEBUG_CRASH_INJECT := n
CONFIG_FEATURE_MEMDUMP_ENABLE := n

ifeq ($(CONFIG_SLUB_DEBUG_ON), y)
CONFIG_WLAN_OBJMGR_DEBUG:= n
CONFIG_FEATURE_UNIT_TEST_SUSPEND := n
CONFIG_LEAK_DETECTION := n
endif

# Genoa features vs Rome
CONFIG_HTT_PADDR64 := y

CONFIG_ENABLE_SIZE_OPTIMIZE := y

# configure log buffer size
CONFIG_CFG_NUM_DP_TRACE_RECORD := 1000
CONFIG_CFG_NUM_HTC_CREDIT_HISTORY := 16
CONFIG_CFG_NUM_WMI_EVENT_HISTORY := 16
CONFIG_CFG_NUM_WMI_MGMT_EVENT_HISTORY := 16
CONFIG_CFG_NUM_TX_RX_HISTOGRAM := 16
CONFIG_CFG_NUM_RX_IND_RECORD := 1024

ifeq ($(CONFIG_FEATURE_ROAM_DEBUG), y)
CONFIG_CFG_NUM_ROAM_DEBUG_RECORD := 64
endif

CONFIG_QCA_WIFI_FTM := n
QCA_WIFI_FTM_NL80211 := n
CONFIG_LINUX_QCMBR := n
CONFIG_TGT_NUM_MSDU_DESC := 0
CONFIG_QCN7605_SUPPORT := y
CONFIG_QCA_TX_PADDING_CREDIT_SUPPORT := y
CONFIG_CFG_TGT_AST_SKID_LIMIT := 16
###################################
```

## drivers/staging/qcacld-3.0/configs/genoa.snoc.debug_defconfig
```kconfig
include $(WLAN_ROOT)/configs/genoa.common

# Interface specific features
CONFIG_ROME_IF = snoc
CONFIG_HELIUMPLUS := y
CONFIG_64BIT_PADDR := y
CONFIG_QMI_SUPPORT := y
CONFIG_WIFI_3_0_ADRASTEA := y
CONFIG_ADRASTEA_RRI_ON_DDR := y
CONFIG_ATH_PROCFS_DIAG_SUPPORT := y
CONFIG_ADRASTEA_SHADOW_REGISTERS := y
CONFIG_HTT_PADDR64 := y
CONFIG_HIF_SNOC:= y

# Genoa specific features
CONFIG_QCA_LL_TX_FLOW_CONTROL_RESIZE := y

# Data Path specific features
CONFIG_WLAN_FASTPATH := y
CONFIG_FEATURE_TSO := y
CONFIG_WLAN_NAPI := y
CONFIG_WLAN_TX_FLOW_CONTROL_V2 := y
CONFIG_ATH_11AC_TXCOMPACT := y
CONFIG_RX_OL := y
CONFIG_DESC_DUP_DETECT_DEBUG := y
CONFIG_DEBUG_RX_RING_BUFFER := y
CONFIG_LL_DP_SUPPORT := y

ifeq ($(CONFIG_INET_LRO), y)
CONFIG_WLAN_LRO := y
else
CONFIG_WLAN_LRO := n
endif

ifeq ($(CONFIG_IPA), y)
CONFIG_IPA_OFFLOAD := y
endif
ifeq ($(CONFIG_IPA3), y)
CONFIG_IPA_OFFLOAD := y
endif

ifneq ($(CONFIG_FORCE_ALLOC_FROM_DMA_ZONE), y)
CONFIG_ENABLE_DEBUG_ADDRESS_MARKING := y
endif

# Debug specific features
CONFIG_FEATURE_TSO_DEBUG := y
CONFIG_WLAN_NAPI_DEBUG := n
CONFIG_WLAN_FEATURE_P2P_DEBUG := y
CONFIG_MPC_UT_FRAMEWORK := y
CONFIG_FEATURE_EPPING := y
CONFIG_WLAN_LOG_ENTER := y
CONFIG_WLAN_LOG_EXIT := y

# Features gets enabled on slub debug
CONFIG_WLAN_OBJMGR_DEBUG:= y
CONFIG_OL_RX_INDICATION_RECORD := y
CONFIG_TSOSEG_DEBUG := y
CONFIG_FEATURE_PKTLOG := y
CONFIG_WLAN_DEBUG_CRASH_INJECT := y
CONFIG_FEATURE_MEMDUMP_ENABLE := y
CONFIG_FEATURE_UNIT_TEST_SUSPEND := y
CONFIG_LEAK_DETECTION := y

ifeq ($(CONFIG_DEBUG_FS), y)
       CONFIG_WLAN_DEBUGFS := y
       CONFIG_WLAN_POWER_DEBUGFS := y
endif

# other features
CONFIG_QCA_WIFI_FTM := y
ifeq ($(CONFIG_NL80211_TESTMODE), y)
	QCA_WIFI_FTM_NL80211 :=y
else
	QCA_WIFI_FTM_NL80211 :=n
endif
CONFIG_LINUX_QCMBR :=y

#Flag to enable Dynamic Voltage WDCVS (Config Voltage Mode)
CONFIG_WLAN_DYNAMIC_CVM := y
ifeq ($(CONFIG_CNSS2), y)
ifeq ($(CONFIG_HIF_PCI), y)
CONFIG_PLD_PCIE_CNSS_FLAG := y
CONFIG_PLD_PCIE_INIT_FLAG := y
endif
endif
###################################
```

## drivers/staging/qcacld-3.0/configs/genoa.snoc.perf_defconfig
```kconfig
include $(WLAN_ROOT)/configs/genoa.common

# Interface specific features
CONFIG_ROME_IF = snoc
CONFIG_HELIUMPLUS := y
CONFIG_64BIT_PADDR := y
CONFIG_QMI_SUPPORT := y
CONFIG_WIFI_3_0_ADRASTEA := y
CONFIG_ADRASTEA_RRI_ON_DDR := y
CONFIG_ATH_PROCFS_DIAG_SUPPORT := y
CONFIG_ADRASTEA_SHADOW_REGISTERS := y
CONFIG_HTT_PADDR64 := y
CONFIG_HIF_SNOC:= y

# Genoa specific features
CONFIG_QCA_LL_TX_FLOW_CONTROL_RESIZE := y

# Data Path specific features
CONFIG_WLAN_FASTPATH := y
CONFIG_FEATURE_TSO := y
CONFIG_WLAN_NAPI := y
CONFIG_WLAN_TX_FLOW_CONTROL_V2 := y
CONFIG_ATH_11AC_TXCOMPACT := y
CONFIG_RX_OL := y
CONFIG_DESC_DUP_DETECT_DEBUG := n
CONFIG_DEBUG_RX_RING_BUFFER := n
CONFIG_LL_DP_SUPPORT := y

ifeq ($(CONFIG_INET_LRO), y)
CONFIG_WLAN_LRO := y
else
CONFIG_WLAN_LRO := n
endif

ifeq ($(CONFIG_IPA), y)
CONFIG_IPA_OFFLOAD := y
endif
ifeq ($(CONFIG_IPA3), y)
CONFIG_IPA_OFFLOAD := y
endif

ifneq ($(CONFIG_FORCE_ALLOC_FROM_DMA_ZONE), y)
CONFIG_ENABLE_DEBUG_ADDRESS_MARKING := y
endif

CONFIG_FEATURE_TSO_DEBUG := n
CONFIG_WLAN_NAPI_DEBUG := n
CONFIG_WLAN_FEATURE_P2P_DEBUG := n
CONFIG_MPC_UT_FRAMEWORK := n
CONFIG_FEATURE_EPPING := n
CONFIG_WLAN_LOG_ENTER := n
CONFIG_WLAN_LOG_EXIT := n

CONFIG_QCA_WIFI_FTM := n
QCA_WIFI_FTM_NL80211 := n
CONFIG_LINUX_QCMBR := n

#Flag to enable Dynamic Voltage WDCVS (Config Voltage Mode)
CONFIG_WLAN_DYNAMIC_CVM := y

# Features gets enabled on slub debug
CONFIG_WLAN_OBJMGR_DEBUG:= n
CONFIG_FEATURE_MEMDUMP_ENABLE := n
CONFIG_FEATURE_UNIT_TEST_SUSPEND := n
CONFIG_OL_RX_INDICATION_RECORD := n
CONFIG_TSOSEG_DEBUG := n
CONFIG_FEATURE_PKTLOG := n
CONFIG_WLAN_DEBUG_CRASH_INJECT := n
CONFIG_LEAK_DETECTION := n

ifeq ($(CONFIG_DEBUG_FS), y)
       CONFIG_WLAN_DEBUGFS := n
       CONFIG_WLAN_POWER_DEBUGFS := n
endif

ifeq ($(CONFIG_CNSS2), y)
ifeq ($(CONFIG_HIF_PCI), y)
CONFIG_PLD_PCIE_CNSS_FLAG := y
CONFIG_PLD_PCIE_INIT_FLAG := y
endif
endif

CONFIG_ENABLE_SIZE_OPTIMIZE := y

# configure log buffer size
CONFIG_CFG_NUM_DP_TRACE_RECORD := 1000
CONFIG_CFG_NUM_HTC_CREDIT_HISTORY := 16
CONFIG_CFG_NUM_WMI_EVENT_HISTORY := 16
CONFIG_CFG_NUM_WMI_MGMT_EVENT_HISTORY := 16
CONFIG_CFG_NUM_TX_RX_HISTOGRAM := 16
CONFIG_CFG_NUM_RX_IND_RECORD := 1024

ifeq ($(CONFIG_FEATURE_ROAM_DEBUG), y)
CONFIG_CFG_NUM_ROAM_DEBUG_RECORD := 64
endif
###################################
```

## drivers/staging/qcacld-3.0/configs/genoa.usb.debug_defconfig
```kconfig
include $(WLAN_ROOT)/configs/genoa.common

# Interface specific features
CONFIG_ROME_IF := usb
CONFIG_HIF_USB := y
CONFIG_LINUX_QCMBR := y
CONFIG_PLD_USB_CNSS := y

# Data Path specific features
CONFIG_ATH_11AC_TXCOMPACT := n
CONFIG_QCA_HL_NETDEV_FLOW_CONTROL := y
CONFIG_TX_RESOURCE_HIGH_TH_IN_PER := 8
CONFIG_TX_RESOURCE_LOW_TH_IN_PER := 2
CONFIG_FEATURE_HL_GROUP_CREDIT_FLOW_CONTROL := y
CONFIG_FEATURE_HL_DBS_GROUP_CREDIT_SHARING := y
CONFIG_CREDIT_REP_THROUGH_CREDIT_UPDATE := y
CONFIG_WLAN_SUPPORT_TXRX_HL_BUNDLE := y
CONFIG_HL_DP_SUPPORT := y

# Enable Motion Detection Feature
CONFIG_FEATURE_MOTION_DETECTION := y

# Debug specific features
CONFIG_MPC_UT_FRAMEWORK := y
CONFIG_FEATURE_EPPING := y
CONFIG_WLAN_FEATURE_P2P_DEBUG := y
CONFIG_WLAN_LOG_ENTER := y
CONFIG_WLAN_LOG_EXIT := y

ifeq ($(CONFIG_DEBUG_FS), y)
       CONFIG_WLAN_DEBUGFS := y
       CONFIG_WLAN_POWER_DEBUGFS := y
endif

ifeq ($(CONFIG_NETWORK_PHY_TIMESTAMPING), y)
	CONFIG_WLAN_SYNC_TSF_PTP := y
endif

CONFIG_WLAN_SYNC_TSF_PLUS := y
CONFIG_WLAN_SYNC_TSF_PLUS_EXT_GPIO_SYNC := y

# Features gets enabled on slub debug
CONFIG_WLAN_DEBUG_CRASH_INJECT := y
CONFIG_FEATURE_MEMDUMP_ENABLE := y

ifeq ($(CONFIG_SLUB_DEBUG_ON), y)
CONFIG_WLAN_OBJMGR_DEBUG:= y
CONFIG_FEATURE_UNIT_TEST_SUSPEND := y
CONFIG_LEAK_DETECTION := y
endif

# Genoa features vs Rome
CONFIG_HTT_PADDR64 := y

CONFIG_QCA_WIFI_FTM := y
ifeq ($(CONFIG_NL80211_TESTMODE), y)
	QCA_WIFI_FTM_NL80211 :=y
else
	QCA_WIFI_FTM_NL80211 :=n
endif
CONFIG_LINUX_QCMBR :=y
CONFIG_QCN7605_SUPPORT := y
CONFIG_TGT_NUM_MSDU_DESC := 0
# For OOB wakeup
CONFIG_WLAN_FEATURE_WOW_PULSE := y
CONFIG_HTC_MAX_MSG_PER_BUNDLE_TX := 48
CONFIG_CFG_TGT_AST_SKID_LIMIT := 16
###################################
```

## drivers/staging/qcacld-3.0/configs/genoa.usb.perf_defconfig
```kconfig
include $(WLAN_ROOT)/configs/genoa.common

# Interface specific features
CONFIG_ROME_IF := usb
CONFIG_HIF_USB := y
CONFIG_LINUX_QCMBR := y
CONFIG_PLD_USB_CNSS := y

# Data Path specific features
CONFIG_ATH_11AC_TXCOMPACT := n
CONFIG_QCA_HL_NETDEV_FLOW_CONTROL := y
CONFIG_TX_RESOURCE_HIGH_TH_IN_PER := 8
CONFIG_TX_RESOURCE_LOW_TH_IN_PER := 2
CONFIG_FEATURE_HL_GROUP_CREDIT_FLOW_CONTROL := y
CONFIG_FEATURE_HL_DBS_GROUP_CREDIT_SHARING := y
CONFIG_CREDIT_REP_THROUGH_CREDIT_UPDATE := y
CONFIG_WLAN_SUPPORT_TXRX_HL_BUNDLE := y
CONFIG_HL_DP_SUPPORT := y

# Enable Motion Detection Feature
CONFIG_FEATURE_MOTION_DETECTION := y

# Debug specific features
CONFIG_MPC_UT_FRAMEWORK := n
CONFIG_FEATURE_EPPING := n
CONFIG_WLAN_FEATURE_P2P_DEBUG := n
CONFIG_WLAN_LOG_ENTER := n
CONFIG_WLAN_LOG_EXIT := n

ifeq ($(CONFIG_DEBUG_FS), y)
       CONFIG_WLAN_DEBUGFS := y
       CONFIG_WLAN_POWER_DEBUGFS := y
endif

# Features gets enabled on slub debug
CONFIG_WLAN_DEBUG_CRASH_INJECT := n
CONFIG_FEATURE_MEMDUMP_ENABLE := n

ifeq ($(CONFIG_SLUB_DEBUG_ON), y)
CONFIG_WLAN_OBJMGR_DEBUG:= n
CONFIG_FEATURE_UNIT_TEST_SUSPEND := n
CONFIG_LEAK_DETECTION := n
endif

ifeq ($(CONFIG_NETWORK_PHY_TIMESTAMPING), y)
	CONFIG_WLAN_SYNC_TSF_PTP := y
endif

CONFIG_WLAN_SYNC_TSF_PLUS := y
CONFIG_WLAN_SYNC_TSF_PLUS_EXT_GPIO_SYNC := y

CONFIG_ENABLE_SIZE_OPTIMIZE := y

# configure log buffer size
CONFIG_CFG_NUM_DP_TRACE_RECORD := 1000
CONFIG_CFG_NUM_HTC_CREDIT_HISTORY := 16
CONFIG_CFG_NUM_WMI_EVENT_HISTORY := 16
CONFIG_CFG_NUM_WMI_MGMT_EVENT_HISTORY := 16
CONFIG_CFG_NUM_TX_RX_HISTOGRAM := 16
CONFIG_CFG_NUM_RX_IND_RECORD := 1024

ifeq ($(CONFIG_FEATURE_ROAM_DEBUG), y)
CONFIG_CFG_NUM_ROAM_DEBUG_RECORD := 64
endif

# Genoa features vs Rome
CONFIG_HTT_PADDR64 := y

CONFIG_QCA_WIFI_FTM := n
QCA_WIFI_FTM_NL80211 := n
CONFIG_LINUX_QCMBR := n
CONFIG_QCN7605_SUPPORT := y
CONFIG_TGT_NUM_MSDU_DESC := 0
# For OOB wakeup
CONFIG_WLAN_FEATURE_WOW_PULSE := y
CONFIG_HTC_MAX_MSG_PER_BUNDLE_TX := 48
CONFIG_CFG_TGT_AST_SKID_LIMIT := 16
###################################
```
