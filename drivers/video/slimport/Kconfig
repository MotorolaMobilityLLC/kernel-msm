## drivers/video/slimport/Kconfig
```kconfig
source "drivers/video/slimport/anx7816/Kconfig"

config SLIMPORT_COMMON
	tristate "Analogix Slimport transmitter ANX support"
	help
	  Slimport Transmitter is a video transmitter chip
	  over micro-USB connector for smartphone device.
```

## drivers/video/slimport/anx7805/Kconfig
```kconfig
config SLIMPORT_ANX7805
	tristate "Analogix Slimport transmitter ANX7805 support"
	help
	  Slimport Transmitter is a HD video transmitter chip over micro-USB connector for smartphone device.
```

## drivers/video/slimport/anx7816/Kconfig
```kconfig
config SLIMPORT_ANX7816
	tristate "Analogix Slimport transmitter ANX7816 support"
	help
	  Slimport Transmitter is a 2K/4K video transmitter chip
	  over micro-USB connector for smartphone device.
```

## fs/esdfs/Kconfig
```kconfig
config ESD_FS
	tristate "Emulated 'SD card' file system for Android (EXPERIMENTAL)"
	help
	  Esdfs is a wrapfs-based file system, designed to implement the
	  Android "sdcard" FUSE-backed file system from within the kernel.
```

## fs/pstore/Kconfig
```kconfig
config PSTORE
	bool "Persistent store support"
	default n
	select ZLIB_DEFLATE
	select ZLIB_INFLATE
	help
	   This option enables generic access to platform level
	   persistent storage via "pstore" filesystem that can
	   be mounted as /dev/pstore.  Only useful if you have
	   a platform level driver that registers with pstore to
	   provide the data, so you probably should just go say "Y"
	   (or "M") to a platform specific persistent store driver
	   (e.g. ACPI_APEI on X86) which will select this for you.
	   If you don't have a platform persistent store driver,
	   say N.

config PSTORE_CONSOLE
	bool "Log kernel console messages"
	depends on PSTORE
	help
	  When the option is enabled, pstore will log all kernel
	  messages, even if no oops or panic happened.

config PSTORE_PMSG
	bool "Log user space messages"
	depends on PSTORE
	help
	  When the option is enabled, pstore will export a character
	  interface /dev/pmsg0 to log user space messages. On reboot
	  data can be retrieved from /sys/fs/pstore/pmsg-ramoops-[ID].

	  If unsure, say N.

config PSTORE_FTRACE
	bool "Persistent function tracer"
	depends on PSTORE
	depends on FUNCTION_TRACER
	depends on DEBUG_FS
	help
	  With this option kernel traces function calls into a persistent
	  ram buffer that can be decoded and dumped after reboot through
	  pstore filesystem. It can be used to determine what function
	  was last called before a reset or panic.

	  If unsure, say N.

config PSTORE_RAM
	tristate "Log panic/oops to a RAM buffer"
	depends on PSTORE
	depends on HAS_IOMEM
	depends on HAVE_MEMBLOCK
	select REED_SOLOMON
	select REED_SOLOMON_ENC8
	select REED_SOLOMON_DEC8
	help
	  This enables panic and oops messages to be logged to a circular
	  buffer in RAM where it can be read back at some later point.

	  Note that for historical reasons, the module will be named
	  "ramoops.ko".

	  For more information, see Documentation/ramoops.txt.

config PSTORE_RAM_ANNOTATION_APPEND
	bool "Allow appending messages to pstore ram annotation"
	default n
	depends on PSTORE_RAM
	help
	  Existing pstore ram annotation stores messages and exports them
	  after reset. Sometimes only after reset can we do some postmortem
	  analysis. This adds function which can be used to append the
	  analysis info to pstore ram annotation. The function should only
	  be used before pstore ram annotation is exported. It's safe to use
	  the function before pstore is initialized. Content will be buffered
	  and merged to annotation-ramoops file.
	  If unsure, say N.
```

## fs/sdcardfs/Kconfig
```kconfig
config SDCARD_FS
	tristate "sdcard file system"
	depends on CONFIGFS_FS
	default n
	help
	  Sdcardfs is based on Wrapfs file system.

config SDCARD_FS_FADV_NOACTIVE
	bool "sdcardfs fadvise noactive support"
	depends on FADV_NOACTIVE
	default y
	help
	  Sdcardfs supports fadvise noactive mode.

config SDCARD_FS_PARTIAL_RELATIME
	bool "sdcardfs partial relatime update support"
	depends on SDCARD_FS
	default n
	help
	  Support updating relative access time for specific path instead of
	  whole mount partition. Extended attribute "user.relatime" is
	  introduced to toggle this update. As long as relatime of top parent
	  directory is enabled, all of sub-directories and files's relatime
	  would be updated whatever their xattr is set.
```

## fs/verity/Kconfig
```kconfig
config FS_VERITY
	tristate "FS Verity (File-based authentication)"
	depends on BLOCK
	select CRYPTO
	select CRYPTO_CRC32
	select CRYPTO_SHA256
	select CRYPTO_HASH
	help
	  This option enables file-based verity feature.  The
	  filesystem checks data blocks' authenticity when reading
	  them from underlying disk, similar to how dm-verity does
	  this when reading from a block device.

	  If unsure, say N.

config FS_VERITY_DEBUG
	bool "FS Verity debugging"
	depends on FS_VERITY
	help
	  Enable debugging messages related to fs-verity.

	  Say N unless you are an fs-verity developer.

config FS_VERITY_INTEGRITY_ONLY
	bool "FS Verity integrity-only mode (EXPERIMENTAL)"
	depends on FS_VERITY
	help
	  Enable experimental integrity-only mode for fs-verity.
	  The on-disk format of such files is not stable.

	  Say N unless you are an fs-verity developer.
```

## fs/wrapfs/Kconfig
```kconfig
config WRAP_FS
	tristate "Wrapfs stackable file system (EXPERIMENTAL)"
	depends on EXPERIMENTAL
	help
	  Wrapfs is a stackable file system which simply passes its
	  operations to the lower layer.  It is designed as a useful
	  template for developing or debugging other stackable file systems,
	  and more (see Documentation/filesystems/wrapfs.txt).  See
	  <http://wrapfs.filesystems.org/> for details.
```

## lib/crypto/Kconfig
```kconfig
# SPDX-License-Identifier: GPL-2.0

menu "Crypto library routines"

config CRYPTO_LIB_AES
	tristate

config CRYPTO_LIB_ARC4
	tristate

config CRYPTO_ARCH_HAVE_LIB_BLAKE2S
	bool
	help
	  Declares whether the architecture provides an arch-specific
	  accelerated implementation of the Blake2s library interface,
	  either builtin or as a module.

config CRYPTO_LIB_BLAKE2S_GENERIC
	def_bool !CRYPTO_ARCH_HAVE_LIB_BLAKE2S
	help
	  This symbol can be depended upon by arch implementations of the
	  Blake2s library interface that require the generic code as a
	  fallback, e.g., for SIMD implementations. If no arch specific
	  implementation is enabled, this implementation serves the users
	  of CRYPTO_LIB_BLAKE2S.

config CRYPTO_LIB_DES
	tristate

config CRYPTO_LIB_SHA256
	tristate

endmenu
```

## sound/soc/intel/Kconfig
```kconfig
config SND_MOOR_MACHINE
	tristate "SOC Machine Audio driver for Intel Moorefield MID platform"
	depends on INTEL_SCU_IPC && X86
	select SND_SOC_WM8994
	select MFD_CORE
	select MFD_WM8994
	select REGULATOR_WM8994
	select SND_SST_PLATFORM
	select SND_SST_MACHINE
	select SND_INTEL_SST
	select SND_EFFECTS_OFFLOAD
	default n
	help
	  This adds support for ASoC machine driver for Intel(R) MID Moorefield platform
          used as alsa device in audio substream in Intel(R) MID devices
          Say Y if you have such a device
          If unsure select "N".

config SND_MOOR_DPCM
	bool "Use DPCM for Intel Moorefield MID platform"
	default SST_DPCM
	depends on SND_MOOR_MACHINE
	help
	  This adds an option to enable the DPCM for Intel Moorefield

config SND_INTEL_SST
       tristate

config SND_SST_PLATFORM
	tristate

config SND_SOC_COMMS_SSP
	depends on SND_INTEL_MID_I2S
	tristate "Use ASOC framework to drive AudioComms SSP BT and Modem"
	help
	  Sound SOC cards usually used for BT VOIP and MODEM MIXING use cases.
	  This will add devices for these uses cases in the list of alsa cards.
	  Say Y if you need these sound cards (BT chipset or Modem present).
	  Requires to enable the INTEL_MID_I2S low level SSP I2S driver.

config PRH_TEMP_WA_FOR_SPID
	tristate "Workaround for PRh since SPID is unavailable"

config SST_DPCM
	bool "Use DPCM based Machine Audio driver"
	default n
	help
	  This adds an option to enable the DPCM based machine driver

config SND_SST_MACHINE
	tristate
```
