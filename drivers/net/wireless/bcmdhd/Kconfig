## drivers/staging/qcacld-3.0/Kconfig
```kconfig
comment "Qualcomm Atheros CLD WLAN module"

config QCA_CLD_WLAN

	tristate "Qualcomm Atheros CLD WLAN module"
	default n
	help
	Add support for the Qualcomm Atheros CLD WLAN module

if QCA_CLD_WLAN != n

config QCACLD_WLAN_LFR3
	bool "Enable the WLAN Legacy Fast Roaming feature Version 3"
	default n

config PRIMA_WLAN_OKC
	bool "Enable the Prima WLAN Opportunistic Key Caching feature"
	default n

config WLAN_FEATURE_11W
	bool "Enable the WLAN 802.11w Protected Management Frames feature"
	default n

config WLAN_FEATURE_LPSS
	bool "Enable the WLAN LPSS feature"
	default n

config QCOM_VOWIFI_11R
	bool "Enable Fast Transition (11r) feature"
	default n

config QCACLD_FEATURE_NAN
	bool "Enable NAN feature"
	default n

config QCACLD_FEATURE_GREEN_AP
	bool "Enable Green AP feature"
	default n

config HELIUMPLUS
	bool "Enable Beeliner based descriptor structures for Helium"
	default n

config 64BIT_PADDR
	bool "Enable 37-bit physical/bus addresses"
	depends on HELIUMPLUS
	default n

config QCOM_TDLS
	bool "Enable TDLS feature"
	default n

config QCOM_LTE_COEX
	bool "Enable QCOM LTE Coex feature"
	default n

config MPC_UT_FRAMEWORK
	bool "Enable Unit test framework for multiport concurrency"
	default n

config WLAN_OFFLOAD_PACKETS
	bool "Enable offload packets feature"
	default n

config FEATURE_TSO
	bool "Enable TCP Segmentation Offload"
	depends on HELIUMPLUS
	default n

config FEATURE_TSO_DEBUG
	bool "Enable TCP Segmentation Offload with debug"
	depends on FEATURE_TSO
	default n

config WLAN_FASTPATH
	bool "Enable fastpath for datapackets"
	default n

config WLAN_NAPI
	bool "Enable NAPI - datapath rx"
	default n

config WLAN_NAPI_DEBUG
       bool "Enable debug logging on NAPI"
       depends on WLAN_NAPI
       default n

config WLAN_TX_FLOW_CONTROL_V2
	bool "Enable tx flow control version:2"
	default n

config WLAN_LRO
	bool "Enable Large Receive Offload"
	depends on HELIUMPLUS
	depends on INET_LRO
	default n

config WLAN_SYNC_TSF
	bool "Enable QCOM sync multi devices tsf feature"
	default n

config LFR_SUBNET_DETECTION
	bool "Enable LFR Subnet Change Detection"
	default n

config MCC_TO_SCC_SWITCH
	bool "Enable MCC to SCC Switch Logic"
	default n

config QCACLD_WLAN_LFR2
	bool "Enable the WLAN Legacy Fast Roaming feature Version 2"
	default n

config WLAN_FEATURE_DISA
	bool "Enable DISA certification feature"
	default n

config WLAN_FEATURE_FIPS
	bool "Enable FIPS certification feature"
	default n

config WLAN_FEATURE_11AX
	bool "Enable 11AX(High Efficiency) feature"
	default n

config ICMP_DISABLE_PS
	bool "Enable ICMP packet disable powersave feature"
	default n

config BUILD_TIMESTAMP
	bool "Embed timestamp in wlan version"
	default n

config WLAN_FEATURE_FILS
	bool "Enable FILS feature"
	default n

config NAN_CONVERGENCE
	bool "Enable NAN_CONVERGENCE feature"
	default n

config WLAN_OBJMGR_DEBUG
	bool "Enable WLAN Obj Mgr Debug services"
	default n

config WLAN_FEATURE_DFS_OFFLOAD
	bool "Enable dfs offload feature"
	default n

config WLAN_FEATURE_SARV1_TO_SARV2
	bool "Enable conversion of SAR v1 to v2 feature"
	default n

endif # QCA_CLD_WLAN
```

## drivers/staging/qcacld-3.0/configs/genoa.pci.debug_defconfig
```kconfig
include $(WLAN_ROOT)/configs/genoa.common

CONFIG_ROME_PCIE := n

# Interface specific features
CONFIG_ROME_IF = pci
CONFIG_QMI_SUPPORT := y
CONFIG_HIF_PCI := y

ifeq ($(CONFIG_PCI_MSM), y)
CONFIG_FEATURE_WLAN_D0WOW := y
endif

# Data Path specific features
CONFIG_WLAN_FASTPATH := y
CONFIG_WLAN_NAPI := y
CONFIG_ATH_11AC_TXCOMPACT := y
CONFIG_FEATURE_MONITOR_MODE_SUPPORT := y
CONFIG_QCA_LL_TX_FLOW_CONTROL_RESIZE := y
CONFIG_LL_DP_SUPPORT := y
CONFIG_DATA_CE_SW_INDEX_NO_INLINE_UPDATE := n

ifeq ($(CONFIG_IPA), y)
CONFIG_IPA_OFFLOAD := y
else
CONFIG_IPA_DISABLE_OVERRIDE=y
endif
ifeq ($(CONFIG_IPA3), y)
CONFIG_IPA_OFFLOAD := y
else
CONFIG_IPA_DISABLE_OVERRIDE=y
endif

# Debug specific features
CONFIG_MPC_UT_FRAMEWORK := y
CONFIG_FEATURE_EPPING := y
CONFIG_WLAN_NAPI_DEBUG := n
CONFIG_WLAN_FEATURE_P2P_DEBUG := y
CONFIG_WLAN_LOG_ENTER := y
CONFIG_WLAN_LOG_EXIT := y

# Features gets enabled on slub debug
CONFIG_FEATURE_PKTLOG := y
CONFIG_WLAN_DEBUG_CRASH_INJECT := y
CONFIG_FEATURE_MEMDUMP_ENABLE := y

ifeq ($(CONFIG_DEBUG_FS), y)
       CONFIG_WLAN_DEBUGFS := y
       CONFIG_WLAN_POWER_DEBUGFS := y
endif

ifeq ($(CONFIG_NETWORK_PHY_TIMESTAMPING), y)
	CONFIG_WLAN_SYNC_TSF_PLUS := y
	CONFIG_WLAN_SYNC_TSF_PTP := y
	CONFIG_WLAN_SYNC_TSF_PLUS_EXT_GPIO_IRQ := y
endif

ifeq ($(CONFIG_WLAN_DEBUGFS), y)
       CONFIG_WLAN_FEATURE_MIB_STATS := y
endif

ifeq ($(CONFIG_SLUB_DEBUG_ON), y)
CONFIG_DESC_DUP_DETECT_DEBUG := y
CONFIG_DEBUG_RX_RING_BUFFER := y
CONFIG_WLAN_OBJMGR_DEBUG:= y
CONFIG_FEATURE_UNIT_TEST_SUSPEND := y
CONFIG_LEAK_DETECTION := y
endif

# Genoa features vs Rome PCIe
ifeq ($(CONFIG_ROME_PCIE), y)
CONFIG_CHNL_MATRIX_RESTRICTION := y
CONFIG_WLAN_TX_FLOW_CONTROL_LEGACY := y
else
CONFIG_OL_RX_INDICATION_RECORD := y
CONFIG_TSOSEG_DEBUG := y
CONFIG_FEATURE_TSO_DEBUG := y
CONFIG_FEATURE_TSO := y
CONFIG_WLAN_TX_FLOW_CONTROL_V2 := y
CONFIG_HELIUMPLUS := y
CONFIG_64BIT_PADDR := y
CONFIG_WIFI_3_0_ADRASTEA := y
CONFIG_ADRASTEA_RRI_ON_DDR := y
CONFIG_ATH_PROCFS_DIAG_SUPPORT := y
CONFIG_ADRASTEA_SHADOW_REGISTERS := y
CONFIG_HTT_PADDR64 := y
CONFIG_RX_OL := y

CONFIG_QCN7605_SUPPORT := y
CONFIG_HIF_REG_WINDOW_SUPPORT := y

ifneq ($(CONFIG_X86), y)
ifeq ($(CONFIG_INET_LRO), y)
CONFIG_WLAN_LRO := y
else
CONFIG_WLAN_LRO := n
endif
endif

ifneq ($(CONFIG_FORCE_ALLOC_FROM_DMA_ZONE), y)
CONFIG_ENABLE_DEBUG_ADDRESS_MARKING := y
endif

endif # CONFIG_ROME_PCIE

ifeq ($(CONFIG_CNSS), y)
ifeq ($(CONFIG_HIF_PCI), y)
CONFIG_PLD_PCIE_CNSS_FLAG := y
endif
endif

ifeq ($(CONFIG_CNSS2), y)
ifeq ($(CONFIG_HIF_PCI), y)
CONFIG_PLD_PCIE_CNSS_FLAG := y
CONFIG_PLD_PCIE_INIT_FLAG := y
endif
endif

ifeq ($(CONFIG_CNSS2), m)
ifeq ($(CONFIG_HIF_PCI), y)
CONFIG_PLD_PCIE_CNSS_FLAG := y
CONFIG_PLD_PCIE_INIT_FLAG := y
endif
endif

CONFIG_QCA_WIFI_FTM := y
ifeq ($(CONFIG_NL80211_TESTMODE), y)
	QCA_WIFI_FTM_NL80211 :=y
else
	QCA_WIFI_FTM_NL80211 :=n
endif
CONFIG_LINUX_QCMBR :=y
###################################
```

## drivers/staging/qcacld-3.0/configs/genoa.pci.perf_defconfig
```kconfig
include $(WLAN_ROOT)/configs/genoa.common

CONFIG_ROME_PCIE := n

# Interface specific features
CONFIG_ROME_IF = pci
CONFIG_QMI_SUPPORT := y
CONFIG_HIF_PCI := y

ifeq ($(CONFIG_PCI_MSM), y)
CONFIG_FEATURE_WLAN_D0WOW := y
endif

# Data Path specific features
CONFIG_WLAN_FASTPATH := y
CONFIG_WLAN_NAPI := y
CONFIG_ATH_11AC_TXCOMPACT := y
CONFIG_QCA_LL_TX_FLOW_CONTROL_RESIZE := y
CONFIG_LL_DP_SUPPORT := y
CONFIG_DATA_CE_SW_INDEX_NO_INLINE_UPDATE := n

ifeq ($(CONFIG_IPA), y)
CONFIG_IPA_OFFLOAD := y
endif
ifeq ($(CONFIG_IPA3), y)
CONFIG_IPA_OFFLOAD := y
endif

# Debug specific features
CONFIG_MPC_UT_FRAMEWORK := n
CONFIG_FEATURE_EPPING := n
CONFIG_WLAN_NAPI_DEBUG := n
CONFIG_WLAN_FEATURE_P2P_DEBUG := n
CONFIG_WLAN_LOG_ENTER := n
CONFIG_WLAN_LOG_EXIT := n

# Features gets enabled on slub debug
CONFIG_FEATURE_PKTLOG := y
CONFIG_WLAN_DEBUG_CRASH_INJECT := n
CONFIG_FEATURE_MEMDUMP_ENABLE := n

ifeq ($(CONFIG_DEBUG_FS), y)
       CONFIG_WLAN_DEBUGFS := n
       CONFIG_WLAN_POWER_DEBUGFS := n
endif

ifeq ($(CONFIG_NETWORK_PHY_TIMESTAMPING), y)
	CONFIG_WLAN_SYNC_TSF_PLUS := y
	CONFIG_WLAN_SYNC_TSF_PTP := y
	CONFIG_WLAN_SYNC_TSF_PLUS_EXT_GPIO_IRQ := y
endif

ifeq ($(CONFIG_SLUB_DEBUG_ON), y)
CONFIG_DESC_DUP_DETECT_DEBUG := n
CONFIG_DEBUG_RX_RING_BUFFER := n
CONFIG_WLAN_OBJMGR_DEBUG:= n
CONFIG_FEATURE_UNIT_TEST_SUSPEND := n
CONFIG_LEAK_DETECTION := n
endif

# Genoa features vs Rome PCIe
ifeq ($(CONFIG_ROME_PCIE), y)
CONFIG_CHNL_MATRIX_RESTRICTION := y
CONFIG_WLAN_TX_FLOW_CONTROL_LEGACY := y
else
CONFIG_OL_RX_INDICATION_RECORD := y
CONFIG_TSOSEG_DEBUG := n
CONFIG_FEATURE_TSO_DEBUG := n
CONFIG_FEATURE_TSO := y
CONFIG_WLAN_TX_FLOW_CONTROL_V2 := y
CONFIG_HELIUMPLUS := y
CONFIG_64BIT_PADDR := y
CONFIG_WIFI_3_0_ADRASTEA := y
CONFIG_ADRASTEA_RRI_ON_DDR := y
CONFIG_ATH_PROCFS_DIAG_SUPPORT := y
CONFIG_ADRASTEA_SHADOW_REGISTERS := y
CONFIG_HTT_PADDR64 := y
CONFIG_RX_OL := y

CONFIG_QCN7605_SUPPORT := y
CONFIG_HIF_REG_WINDOW_SUPPORT := y

ifneq ($(CONFIG_X86), y)
ifeq ($(CONFIG_INET_LRO), y)
CONFIG_WLAN_LRO := y
else
CONFIG_WLAN_LRO := n
endif
endif

ifneq ($(CONFIG_FORCE_ALLOC_FROM_DMA_ZONE), y)
CONFIG_ENABLE_DEBUG_ADDRESS_MARKING := y
endif

endif # CONFIG_ROME_PCIE

ifeq ($(CONFIG_CNSS), y)
ifeq ($(CONFIG_HIF_PCI), y)
CONFIG_PLD_PCIE_CNSS_FLAG := y
endif
endif

ifeq ($(CONFIG_CNSS2), y)
ifeq ($(CONFIG_HIF_PCI), y)
CONFIG_PLD_PCIE_CNSS_FLAG := y
CONFIG_PLD_PCIE_INIT_FLAG := y
endif
endif

ifeq ($(CONFIG_CNSS2), m)
ifeq ($(CONFIG_HIF_PCI), y)
CONFIG_PLD_PCIE_CNSS_FLAG := y
CONFIG_PLD_PCIE_INIT_FLAG := y
endif
endif

CONFIG_QCA_WIFI_FTM := n
QCA_WIFI_FTM_NL80211 := n
CONFIG_LINUX_QCMBR := n

###################################
CONFIG_ENABLE_SIZE_OPTIMIZE := y

# configure log buffer size
CONFIG_CFG_NUM_DP_TRACE_RECORD := 1000
CONFIG_CFG_NUM_HTC_CREDIT_HISTORY := 16
CONFIG_CFG_NUM_WMI_EVENT_HISTORY := 16
CONFIG_CFG_NUM_WMI_MGMT_EVENT_HISTORY := 16
CONFIG_CFG_NUM_TX_RX_HISTOGRAM := 16
CONFIG_CFG_NUM_RX_IND_RECORD := 1024

ifeq ($(CONFIG_FEATURE_ROAM_DEBUG), y)
CONFIG_CFG_NUM_ROAM_DEBUG_RECORD := 64
endif
###################################
```

## drivers/staging/qcacld-3.0/configs/genoa.sdio.debug_defconfig
```kconfig
include $(WLAN_ROOT)/configs/genoa.common

# Interface specific features
CONFIG_CLD_HL_SDIO_CORE := y
CONFIG_QCA_WIFI_SDIO := y
CONFIG_ROME_IF = sdio
CONFIG_HIF_SDIO := y
CONFIG_LINUX_QCMBR := y
CONFIG_SDIO_TRANSFER = adma
CONFIG_PLD_SDIO_CNSS2 := y

# Data Path specific features
CONFIG_ATH_11AC_TXCOMPACT := n
CONFIG_QCA_HL_NETDEV_FLOW_CONTROL := y
CONFIG_TX_RESOURCE_HIGH_TH_IN_PER := 8
CONFIG_TX_RESOURCE_LOW_TH_IN_PER := 2
CONFIG_FEATURE_HL_GROUP_CREDIT_FLOW_CONTROL := y
CONFIG_FEATURE_HL_DBS_GROUP_CREDIT_SHARING := y
CONFIG_CREDIT_REP_THROUGH_CREDIT_UPDATE := y
CONFIG_HL_DP_SUPPORT := y

# Debug specific features
CONFIG_MPC_UT_FRAMEWORK := y
CONFIG_FEATURE_EPPING := y
CONFIG_WLAN_FEATURE_P2P_DEBUG := y
CONFIG_WLAN_LOG_ENTER := y
CONFIG_WLAN_LOG_EXIT := y

ifeq ($(CONFIG_DEBUG_FS), y)
       CONFIG_WLAN_DEBUGFS := y
       CONFIG_WLAN_POWER_DEBUGFS := y
endif

# Features gets enabled on slub debug
CONFIG_FEATURE_PKTLOG := y
CONFIG_WLAN_DEBUG_CRASH_INJECT := y
CONFIG_FEATURE_MEMDUMP_ENABLE := y

ifeq ($(CONFIG_SLUB_DEBUG_ON), y)
CONFIG_WLAN_OBJMGR_DEBUG:= y
CONFIG_FEATURE_UNIT_TEST_SUSPEND := y
CONFIG_LEAK_DETECTION := y
endif

# Genoa features vs Rome
CONFIG_HTT_PADDR64 := y

CONFIG_QCA_WIFI_FTM := y
ifeq ($(CONFIG_NL80211_TESTMODE), y)
	QCA_WIFI_FTM_NL80211 :=y
else
	QCA_WIFI_FTM_NL80211 :=n
endif
CONFIG_LINUX_QCMBR :=y
CONFIG_TGT_NUM_MSDU_DESC := 0
CONFIG_QCN7605_SUPPORT := y
CONFIG_QCA_TX_PADDING_CREDIT_SUPPORT := y
CONFIG_CFG_TGT_AST_SKID_LIMIT := 16
###################################
```
