## drivers/net/wireless/bcmdhd/Kconfig
```kconfig
config BCMDHD
	tristate "Broadcom FullMAC wireless cards support"
	---help---
	  This module adds support for wireless adapters based on
	  Broadcom FullMAC chipset.

	  If you choose to build a module, it'll be called dhd. Say M if
	  unsure.

config BCM4330
	tristate "Broadcom 4330 wireless cards support"
	depends on WLAN
	---help---
	  This module adds support for wireless adapters based on
	  Broadcom 4330 chipset.

config BCM4334
	tristate "Broadcom 4334 wireless cards support"
	depends on WLAN
	---help---
	  This module adds support for wireless adapters based on
	  Broadcom 4334 chipset.

config BCM4335
	tristate "Broadcom 4335 wireless cards support"
	depends on WLAN
	---help---
	  This module adds support for wireless adapters based on
	  Broadcom 4335 chipset.

config BCM4339
	tristate "Broadcom 4339 wireless cards support"
	depends on WLAN
	---help---
	  This module adds support for wireless adapters based on
	  Broadcom 4339 chipset.

config BCM4354
	tristate "Broadcom 4354 wireless cards support"
	depends on WLAN
	---help---
	  This module adds support for wireless adapters based on
	  Broadcom 4354 chipset.

config BCM4343
	tristate "Broadcom 4343 wireless cards support"
	depends on WLAN
	---help---
	  This module adds support for wireless adapters based on
	  Broadcom 4343 chipset.
	  
config BCMDHD_SDIO
	bool "SDIO bus interface support"
	depends on BCMDHD && MMC
	default y

config BCMDHD_PCIE
	bool "PCIe bus interface support"
	depends on BCMDHD && PCI && !BCMDHD_SDIO


config BCMDHD_FW_PATH
	depends on BCMDHD
	string "Firmware path"
	default "/system/vendor/bcm/fw/bcm43430_mfg.bin"
	---help---
	  Path to the firmware file.

config BCMDHD_NVRAM_PATH
	depends on BCMDHD
	string "NVRAM path"
	default "/system/vendor/bcm/nvram/bcm4343s.txt"
	---help---
	  Path to the calibration file.

config BCMDHD_WEXT
	bool "Enable WEXT support"
	depends on BCMDHD && CFG80211 = n
	select WIRELESS_EXT
	select WEXT_PRIV
	help
	  Enables WEXT support

config DHD_USE_STATIC_BUF
	bool "Enable memory preallocation"
	depends on BCMDHD
	default n
	---help---
	  Use memory preallocated in platform

config DHD_USE_SCHED_SCAN
	bool "Use CFG80211 sched scan"
	depends on BCMDHD && CFG80211
	default n
	---help---
	  Use CFG80211 sched scan
	  
config BROADCOM_WIFI_RESERVED_MEM
	bool "Use static memory"
	depends on BCMDHD 
	default y
	---help---
	  Use static memory for bcmdhd
```

## drivers/nfc/T6NE6/Kconfig
```kconfig
#
# T6NE6 driver Support
#

menu "Toshiba NFC Chip Driver Support"
config NFC_T6NE6
    bool "T6NE6 Driver"
    default n
endmenu
```

## drivers/nfc/samsung/Kconfig
```kconfig
#
# Near Field Communication (NFC) devices
#

menu "Near Field Communication (NFC) devices"
        depends on NFC

config SEC_NFC
        tristate "Samsung NFC driver"
        default m
        help
          SAMSUNG NFC Driver.
          This driver provides support for SAMSUNG NFC products.
          You should select your NFC product and interface.

          Say Y here to compile support for SAMSUNG NFC driver into the
          kernel.

choice
        prompt "SEC NFC Products"
        depends on SEC_NFC
                default SEC_NFC_PRODUCT_N5
config SEC_NFC_PRODUCT_N3
                bool "RN3"
config SEC_NFC_PRODUCT_N5
                bool "RN5/RNx"
endchoice
choice
        prompt "SEC NFC Interface"
        depends on SEC_NFC
                default SEC_NFC_IF_I2C
config SEC_NFC_IF_UART
                bool "UART"
config SEC_NFC_IF_I2C
                bool "I2C"
config SEC_NFC_IF_I2C_GPIO
                bool "I2C-GPIO (S/W-I2C)"
                select I2C_CHARDEV
                select I2C_MUX
                select I2C_MUX_GPIO
                select I2C_ARB_GPIO_CHALLENGE
                select I2C_ALGOBIT
                select I2C_GPIO
endchoice
config SEC_NFC_GPIO_CLK
                bool "SEC NFC GPIO CLK"
                default n
                help
                  SAMSUNG NFC CLR REQ feature.
                  This feature provides support for SAMSUNG NFC products.
                  You should select this feature if your NFC product uses AP CLK.

                  Say Y here to compile support for SAMSUNG NFC CLK REQ feature into the
                  kernel.
config SEC_NFC_DEDICATED_CLK
                tristate "SEC NFC DEDICATED CLK"
                        default m
config SEC_NFC_LDO_EN
                tristate "SEC NFC LDO"
                        default m
config SEC_NFC_PMIC_LDO
                tristate "SEC NFC PMIC LDO"
                        default m
config SEC_ESE_COLDRESET
                tristate "eSE Cold reset"
                        default m
endmenu
```

## drivers/power/charger/Kconfig
```kconfig
config SMB_346_CHARGER
        bool "Support for Maxim 8934 charger"

config DUMMY_CHARGER
        bool "Support for dummy charger"

config PM_8921_CHARGER
        bool "Support for PM 8921 charger"

config PM_8941_CHARGER
        bool "Support for PM 8941 charger"

config IDTP9023_CHARGER
        bool "Support for IDTP 9023 charger"

config PM_8226_CHARGER
        bool "Support for PM 8226 charger"
		default y
```

## drivers/power/fsm/Kconfig
```kconfig
config CHARGER_ASUS_FSM
        bool "asus charging state machine"
	default y
        ---help---
          Say Y here to enable support for asus charging FSM
```

## drivers/power/service/Kconfig
```kconfig
config BATTERY_ASUS_SERVICE
        bool "asus battery service"
	default y
        ---help---
          Say Y here to enable support for asus battery service
```

## drivers/power/util/Kconfig
```kconfig
config ASUS_POWER_UTIL
        bool "asus utility for power module"
        default y
```

## drivers/regulator/wl2868c/Kconfig
```kconfig
config REGULATOR_WL2868C
	tristate "Maxim wl2868c voltage regulator"
	depends on I2C
	help
	  This driver controls a Maxim  voltage output
	  regulator via I2C bus.
```

## drivers/rpmsg/Kconfig
```kconfig
menu "Rpmsg drivers"

# RPMSG always gets selected by whoever wants it
config RPMSG
	tristate
	select VIRTIO
	select VIRTUALIZATION

config RPMSG_IPC
	tristate "Build rpmsg ipc driver"
	depends on RPMSG
	help
	  Build an rpmsg ipc driver, which demonstrates how IA
	  communicates with remote processor through IPC rpmsg
	  over the rpmsg bus. It register a rpmsg driver matched
	  with the rpmsg device created in remoteproc framework.

endmenu
```

## drivers/scsi/ufs/Kconfig
```kconfig
#
# Kernel configuration file for the UFS Host Controller
#
# This code is based on drivers/scsi/ufs/Kconfig
# Copyright (C) 2011-2013 Samsung India Software Operations
#
# Authors:
#	Santosh Yaraganavi <santosh.sy@samsung.com>
#	Vinayak Holikatti <h.vinayak@samsung.com>
#
# This program is free software; you can redistribute it and/or
# modify it under the terms of the GNU General Public License
# as published by the Free Software Foundation; either version 2
# of the License, or (at your option) any later version.
# See the COPYING file in the top-level directory or visit
# <http://www.gnu.org/licenses/gpl-2.0.html>
#
# This program is distributed in the hope that it will be useful,
# but WITHOUT ANY WARRANTY; without even the implied warranty of
# MERCHANTABILITY or FITNESS FOR A PARTICULAR PURPOSE.  See the
# GNU General Public License for more details.
#
# This program is provided "AS IS" and "WITH ALL FAULTS" and
# without warranty of any kind. You are solely responsible for
# determining the appropriateness of using and distributing
# the program and assume all risks associated with your exercise
# of rights with respect to the program, including but not limited
# to infringement of third party rights, the risks and costs of
# program errors, damage to or loss of data, programs or equipment,
# and unavailability or interruption of operations. Under no
# circumstances will the contributor of this Program be liable for
# any damages of any kind arising from your use or distribution of
# this program.

config SCSI_UFSHCD
	tristate "Universal Flash Storage Controller Driver Core"
	depends on SCSI && SCSI_DMA
	select PM_DEVFREQ
	select DEVFREQ_GOV_SIMPLE_ONDEMAND
	select NLS
	---help---
	This selects the support for UFS devices in Linux, say Y and make
	  sure that you know the name of your UFS host adapter (the card
	  inside your computer that "speaks" the UFS protocol, also
	  called UFS Host Controller), because you will be asked for it.
	  The module will be called ufshcd.

	  To compile this driver as a module, choose M here and read
	  <file:Documentation/scsi/ufs.txt>.
	  However, do not compile this as a module if your root file system
	  (the one containing the directory /) is located on a UFS device.

config SCSI_UFSHCD_PCI
	tristate "PCI bus based UFS Controller support"
	depends on SCSI_UFSHCD && PCI
	---help---
	This selects the PCI UFS Host Controller Interface. Select this if
	you have UFS Host Controller with PCI Interface.

	  If you have a controller with this interface, say Y or M here.

	  If unsure, say N.

config SCSI_UFS_DWC_TC_PCI
	tristate "DesignWare pci support using a G210 Test Chip"
	depends on SCSI_UFSHCD_PCI
	---help---
	  Synopsys Test Chip is a PHY for prototyping purposes.

	  If unsure, say N.

config SCSI_UFSHCD_PLATFORM
	tristate "Platform bus based UFS Controller support"
	depends on SCSI_UFSHCD
	---help---
	This selects the UFS host controller support. Select this if
	you have an UFS controller on Platform bus.

	If you have a controller with this interface, say Y or M here.

	  If unsure, say N.

config SCSI_UFS_DWC_TC_PLATFORM
	tristate "DesignWare platform support using a G210 Test Chip"
	depends on SCSI_UFSHCD_PLATFORM
	---help---
	  Synopsys Test Chip is a PHY for prototyping purposes.

	  If unsure, say N.

config SCSI_UFS_QCOM
	tristate "QCOM specific hooks to UFS controller platform driver"
	depends on SCSI_UFSHCD_PLATFORM && ARCH_QCOM
	select PHY_QCOM_UFS
	help
	  This selects the QCOM specific additions to UFSHCD platform driver.
	  UFS host on QCOM needs some vendor specific configuration before
	  accessing the hardware which includes PHY configuration and vendor
	  specific registers.

	  Select this if you have UFS controller on QCOM chipset.
	  If unsure, say N.

config SCSI_UFS_TEST
	tristate "Universal Flash Storage host controller driver unit-tests"
	depends on SCSI_UFSHCD && IOSCHED_TEST
	default m
	help
	  This adds UFS Host controller unit-test framework.
	  The UFS unit-tests register as a block device test utility to
	  the test-iosched and will be initiated when the test-iosched will
	  be chosen to be the active I/O scheduler.

config SCSI_UFSHCD_CMD_LOGGING
	bool "Universal Flash Storage host controller driver layer command logging support"
	depends on SCSI_UFSHCD
	help
	  This selects the UFS host controller driver layer command logging.
	  UFS host controller driver layer command logging records all the
	  command information sent from UFS host controller for debugging
	  purpose.

	  Select this if you want above mentioned debug information captured.
	  If unsure, say N.

config SCSI_UFS_HISI
	tristate "Hisilicon specific hooks to UFS controller platform driver"
	depends on (ARCH_HISI || COMPILE_TEST) && SCSI_UFSHCD_PLATFORM
	---help---
	  This selects the Hisilicon specific additions to UFSHCD platform driver.

	  Select this if you have UFS controller on Hisilicon chipset.
	  If unsure, say N.

config SCSI_UFS_CRYPTO
	bool "UFS Crypto Engine Support"
	depends on SCSI_UFSHCD && BLK_INLINE_ENCRYPTION
	help
	  Enable Crypto Engine Support in UFS.
	  Enabling this makes it possible for the kernel to use the crypto
	  capabilities of the UFS device (if present) to perform crypto
	  operations on data being transferred to/from the device.

config SCSI_UFS_CRYPTO_QTI
	tristate "Vendor specific UFS Crypto Engine Support"
	depends on SCSI_UFS_CRYPTO
	help
	 Enable Vendor Crypto Engine Support in UFS
	 Enabling this allows kernel to use UFS crypto operations defined
	 and implemented by QTI.

config UFSHPB_TOSHIBA
	bool "Activate TOSHIBA HPB Host-aware Performance Booster"
	depends on SCSI_UFSHCD
	default n
	help
	  Activate or deactive TOSHIBA UFSHPB v1.3.5 driver

config UFSFEATURE_31
	bool "UFS feature activate"
	depends on SCSI_UFSHCD
	---help---
	UFS feature activate such as hpb, tw and etc.

config UFSHPB_31
	bool "UFS Host Performance Booster support"
	depends on SCSI_UFSHCD && UFSFEATURE_31
	---help---
	UFS HPB Feature Enable

config UFSTW_IGNORE_GUARANTEE_BIT_31
       bool "Ignore UFS Turbo Write Life Time Guarantee bit for POC"
       default n
       depends on SCSI_UFSHCD && UFSFEATURE_31 && UFSTW_31
       ---help---
       ignore the guarantee bit[31] of dTurboWriteBufferLifeTimeEst for PoC

config UFSTW_BOOT_ENABLED
        bool "Turbo Write enabled at boot time"
       default y
       depends on SCSI_UFSHCD && UFSFEATURE_31 && UFSTW_31
       ---help---
       fTurboWriteEn and fTurboWriteBufferFlushDuringHibnerEnter flags
       are enabled at boot time.


config HPB_RELEASE_CHECK
	bool "HPB Release Check for Mass Test"
	depends on SCSI_UFSHCD && UFSFEATURE_31 && UFSHPB_31
	default n
	---help---
	The kernel panic occurs when hpb feature disabled by abnormal behavior.


config UFSTW_31
	bool "UFS Turbo Write support"
	depends on SCSI_UFSHCD && UFSFEATURE_31
	---help---
	UFS TW Feature Enable

config UFSHID
	bool "UFS Host Initiated Defrag support"
	depends on SCSI_UFSHCD && UFSFEATURE_31
	---help---
	UFS HID Feature Enable

config UFSHID_POC
	bool "UFSHID_POC test"
	depends on SCSI_UFSHCD && UFSFEATURE_31 && UFSHID
	---help---
	UFS HID POC test
	1. block to enter suspend state
	2. auto_hibern8 enable/disable (HCI)
	3. set flag bDefragOperation
	4. debug msg enable (default : disable)

config UFSRINGBUF
	bool "UFS RingBuffer support"
	depends on SCSI_UFSHCD && UFSFEATURE_31
	---help---
	UFS RingBuffer Feature Enable

config UFSRINGBUF_POC
	bool "UFS RingBuffer POC test"
	depends on SCSI_UFSHCD && UFSFEATURE && UFSRINGBUF
	---help---
	UFS RingBuffer POC test
	1. set default vendor_signature & vendor_parameter for test
	2. Set custom vender_parameter

config UFSFEATURE
	bool "UFS feature activate"
	depends on SCSI_UFSHCD
	---help---
	UFS feature activate such as hpb, tw and etc.

config UFSHPB
	bool "UFSHPB"
	depends on SCSI_UFSHCD && UFSFEATURE
	---help---
	UFS HPB Feature Enable

config UFSTW
	bool "UFSTW"
	depends on SCSI_UFSHCD && UFSFEATURE
	---help---
	UFS TW Feature Enable

config UFSTW_IGNORE_GUARANTEE_BIT
	bool "UFSTW_IGNORE_GUARANTEE_BIT"
	default n
	depends on SCSI_UFSHCD && UFSFEATURE && UFSTW
	---help---
	ignore the guarantee bit[31] of dTurboWriteBufferLifeTimeEst for PoC

config UFSTW_ENABLE_BY_DEFAULT
	bool "UFSTW_ENABLE_BY_DEFAULT"
	default n
	depends on SCSI_UFSHCD && UFSFEATURE && UFSTW
	---help---
	Activate UFS Turbo Write right after powering up

config UFSTW_LPM_DISABLED_ON_HIBERN8_FLUSH
	bool "Prevent LPM mode on flusing turbo write buffer during hibern8 state"
	default y
	depends on SCSI_UFSHCD && UFSFEATURE && UFSTW
	---help---
	If fTurboWriteBufferFlushDuringHibnerEnter flag is set
	and the value of bAvailbleTurboWriteBufferSize is less than
	UFSTW_AVAIL_BUF_SIZE_DISABLE_LPM(defined in ufstw.h),
	LPM mode will be disabled on runtime suspend.
	In addtion, if not runtime suspend(shutdown and system suspend),
	fTurboWriteBufferFlushDuringHibnerEnter flag will be disabled in
	suspend routines.
```
