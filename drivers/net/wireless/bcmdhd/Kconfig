## drivers/sensorhub/stm/Kconfig
```kconfig
#
# sensor drivers configuration
#
config SENSORS_SYSFS
	tristate "Sensors sysfs"
	help
	  Support sysfs for sensors.
          If you say yes here you get sysfs support for
	  sensor factory test.
	  To compile this driver as a module, choose M here: the
	  module will be called sensors_core.

config SENSORS_SSP
	tristate "Sensors ssp"
	default n
	depends on SPI
	help
	  ssp driver for sensor hub.
          If you say yes here you get ssp support for
	  sensor hub.
	  To compile this driver as a module, choose M here: the
	  module will be called ssp.

config SENSORS_SSP_STM
	tristate "Sensors ssp stm"
	default n
	depends on SPI
	help
	  ssp driver for sensor hub.
          If you say yes here you get ssp support for
	  sensor hub.
	  To compile this driver as a module, choose M here: the
	  module will be called ssp.

config SENSORS_SSP_MPU6500
	tristate "Sensors ssp mpu6500"
	default n
	depends on SPI
	help
	  mpu6500 file for factory test in ssp driver.
          If you say yes here you get mpu6500 support for
	  factory test.
	  To compile this driver as a module, choose M here: the
	  module will be called ssp.

config SENSORS_SSP_AK8963C
	tristate "Sensors ssp AK8963C"
	default n
	depends on SPI
	help
	  ak8963c file for factory test in ssp driver.
          If you say yes here you get ak8963c support for
	  factory test.
	  To compile this driver as a module, choose M here: the
	  module will be called ssp.

config SENSORS_SSP_ADPD142
	tristate "Sensors ssp adpd142"
	default n
	depends on SPI
	help
	  adpd142 file for factory test in ssp driver.
          If you say yes here you get adpd142 support for
	  factory test.
	  To compile this driver as a module, choose M here: the
	  module will be called ssp.


config SENSORS_SSP_STM32F401
	tristate "Sensors ssp stm32f401"
	default n
	depends on SPI
	help
	  stm32f401 file for factory test in ssp driver.
          If you say yes here you get stm32f401 support for
	  factory test.
	  To compile this driver as a module, choose M here: the
	  module will be called ssp.

config SENSORS_SSP_SENSORHUB
	tristate "Sensors ssp sensorhub"
	default n
	depends on SPI
	help
	  ssp sensor hub driver for sensor hub.
          If you say yes here you get ssp support for
	  sensor hub.
	  To compile this driver as a module, choose M here: the
	  module will be called ssp.
```

## drivers/sensors/Kconfig
```kconfig
config SENSORS
	bool "Sensors Class Support"
	help
	  This option enables the sensor sysfs class in /sys/class/sensors.
	  You'll need this to do anything useful with sensorss. If unsure, say N.

config SENSORS_SSC
	bool "Enable Sensors Driver Support for SSC"
	help
	  Add support for sensors SSC driver.
	  This driver is used for exercising sensors use case,
	  time syncing with ADSP clock.

config SENSORS_BMD101
	bool "BMD101 sensor support"
	default n
	help
	  ECG BMD101 sensor support

config SENSORS_LIS3DSH
    tristate "ST LIS3DSH acceleration sensor support"
    depends on I2C=y
    help
		If you say yes here you get support for STMicroelectronics's
		acceleration sensors LIS3DSH.

source "drivers/sensors/pni/Kconfig"
```

## drivers/sensors/pni/Kconfig
```kconfig
config SENSORS_EM718X
	tristate "EM718x Sensor Hub"
	default n
	help
	  Say Y here if you have a EM Microelectronic 718x Sensor module, and
	  your board-specific initialization code includes that in its
	  table of devices.

	  If unsure, say N (but it's safe to say "Y").

	  To compile this driver as a module, choose M here: the
	  module will be called em718x.

config SENSORS_SENTRAL_IIO
	tristate "SENtral Sensor Hub (IIO)"
	default n
	help
	  This driver supports the SENtral Sensor Hub using IIO
	  This driver can be built as a module.
```

## drivers/soc/qcom/lge/Kconfig
```kconfig
config MACH_LGE
	bool

menu "LGE Board Selection"

config MACH_MSM8992_BULLHEAD
	bool "MSM8992 BULLHEAD"
	depends on ARCH_MSM8992
	select MACH_LGE
	help
	  Support for the LGE MSM8992 BULLHEAD.

endmenu

menu "LGE Specific Patches"

config LGE_HANDLE_PANIC
	tristate "Support LGE Crash Handler"
	default n
	depends on MACH_LGE
	help
	  LGE Crash Handler
endmenu
```

## drivers/soc/qcom/sharp/Kconfig
```kconfig
# drivers/sharp/shlog/Kconfig

menu "SHARP SHLOG driver"

comment "SHARP SHLOG driver"

config SHARP_SHLOG
	bool "SHARP SHLOG driver base system."
	default n
	help
	  SHARP SHLOG driver base system.

config SHARP_SHLOG_MODEM
	bool "Enable SHARP SHLOG for modem."
	depends on SHARP_SHLOG
	default n
	help
	  Enable SHARP SHLOG for modem.

config SHARP_SHLOG_RAMOOPS
	bool "Enable SHARP SHLOG for ramoops."
	depends on SHARP_SHLOG
	default n
	help
	  Enable SHARP SHLOG for ramoops.

config SHARP_HANDLE_PANIC
	bool "Enable SHARP handler for panic."
	depends on SHARP_SHLOG
	default n
	help
	  Enable SHARP handler for panic.

config SHARP_PANIC_ON_SUBSYS
	bool "Enable SHARP handler to call panic when subsystem crashed."
	depends on SHARP_SHLOG
	default n
	help
	  enable SHARP handler to call panic when subsystem crashed.

endmenu
```

## drivers/staging/android/Kconfig
```kconfig
menu "Android"

config ANDROID
	bool "Android Drivers"
	default N
	---help---
	  Enable support for various drivers needed on the Android platform

if ANDROID

config ANDROID_BINDER_IPC
	bool "Android Binder IPC Driver"
	default n
	---help---
	  Binder is used in Android for both communication between processes,
	  and remote method invocation.

	  This means one Android process can call a method/routine in another
	  Android process, using Binder to identify, invoke and pass arguments
	  between said processes.

config ANDROID_BINDER_IPC_32BIT
	bool "Use old 32-bit binder api"
	default y if !64BIT
	---help---
	  Enable to support an old 32-bit Android user-space. Breaks the new
	  Android user-space.

config ASHMEM
	bool "Enable the Anonymous Shared Memory Subsystem"
	default n
	depends on SHMEM
	---help---
	  The ashmem subsystem is a new shared memory allocator, similar to
	  POSIX SHM but with different behavior and sporting a simpler
	  file-based API.

	  It is, in theory, a good memory allocator for low-memory devices,
	  because it can discard shared memory units when under memory pressure.

config ANDROID_LOGGER
	tristate "Android log driver"
	default n
	---help---
	  This adds support for system-wide logging using four log buffers.

	  These are:

	      1: main
	      2: events
	      3: radio
	      4: system

	  Log reading and writing is performed via normal Linux reads and
	  optimized writes. This optimization avoids logging having too
	  much overhead in the system.

config LOGCAT_SIZE
	int "Adjust android log buffer sizes"
	default 256
	depends on ANDROID_LOGGER
	help
	  Set logger buffer size. Enter a number greater than zero.
	  Any value less than 256 is recommended. Reduce value to save kernel static memory size.

config ANDROID_TIMED_OUTPUT
	bool "Timed output class driver"
	default y

config ANDROID_TIMED_GPIO
	tristate "Android timed gpio driver"
	depends on GPIOLIB && ANDROID_TIMED_OUTPUT
	default n

config ANDROID_LOW_MEMORY_KILLER
	bool "Android Low Memory Killer"
	default N
	---help---
	  Registers processes to be killed when memory is low

config ANDROID_LOW_MEMORY_KILLER_AUTODETECT_OOM_ADJ_VALUES
	bool "Android Low Memory Killer: detect oom_adj values"
	depends on ANDROID_LOW_MEMORY_KILLER
	default y
	---help---
	  Detect oom_adj values written to
	  /sys/module/lowmemorykiller/parameters/adj and convert them
	  to oom_score_adj values.

config ANDROID_INTF_ALARM_DEV
	bool "Android alarm driver"
	depends on RTC_CLASS
	default n
	---help---
	  Provides non-wakeup and rtc backed wakeup alarms based on rtc or
	  elapsed realtime, and a non-wakeup alarm on the monotonic clock.
	  Also exports the alarm interface to user-space.

config SYNC
	bool "Synchronization framework"
	default n
	select ANON_INODES
	help
	  This option enables the framework for synchronization between multiple
	  drivers.  Sync implementations can take advantage of hardware
	  synchronization built into devices like GPUs.

config SW_SYNC
	bool "Software synchronization objects"
	default n
	depends on SYNC
	help
	  A sync object driver that uses a 32bit counter to coordinate
	  syncrhronization.  Useful when there is no hardware primitive backing
	  the synchronization.

config SW_SYNC_USER
	bool "Userspace API for SW_SYNC"
	default n
	depends on SW_SYNC
	help
	  Provides a user space API to the sw sync object.
	  *WARNING* improper use of this can result in deadlocking kernel
	  drivers from userspace.

source "drivers/staging/android/ion/Kconfig"

config ANDROID_DEBUG_FD_LEAK
	bool "Android file descriptor leak debugger"
	default n
	---help---
	  This Android extension helps debugging file descriptor
	  leak bugs by dumping the backtrace of the culprit thread which
	  is either creating a big file descriptor or injecting
	  a big file descriptor into another process. A file descriptor
	  is big when it is no less than CONFIG_ANDROID_BIG_FD.

config ANDROID_BIG_FD
	int "Minimum value of a big file descriptor"
	depends on ANDROID_DEBUG_FD_LEAK
	default 512
	---help---
	  Set this value to one that is unlikely reached by well-behaved
	  processes which have no file descriptor leak bugs, but likely
	  reached by the processes which do leak file descriptors. The
	  value can be read or changed at runtime through
	  "/sys/kernel/debug/fdleak_dbg_bigfd"

	  If this value is undefined but CONFIG_ANDROID_DEBUG_FD_LEAK is
	  enabled, the value (__FD_SETSIZE / 2) will be assumed.

endif # if ANDROID

endmenu
```

## drivers/staging/nanohub/Kconfig
```kconfig
config NANOHUB
	tristate "Nanohub"
	default N
	help
	  Enable support for the nanohub sensorhub driver.

	  This driver supports the android nanohub sensorhub.

	  If in doubt, say N here.

if NANOHUB

config NANOHUB_SPI
	bool "Nanohub SPI"
	default Y
	help
	  Enable nanohub SPI support.

	  Either this or NANOHUB_I2C should be selected.

	  If in doubt, say Y here.

config NANOHUB_I2C
	bool "Nanohub I2C"
	default N
	help
	  Enable nanohub I2C support.

	  Either this or NANOHUB_SPI should be selected.

	  If in doubt, say N here.

endif # NANOHUB
```

## drivers/staging/prima/Kconfig
```kconfig
comment "Qualcomm Atheros Prima WLAN module"

config PRIMA_WLAN

	tristate "Qualcomm Atheros Prima WLAN module"
	default n
	help
	Add support for the Qualcomm Atheros Prima WLAN module

config PRONTO_WLAN

	tristate "Qualcomm Atheros Pronto WLAN module"
	default n
	help
	Add support for the Qualcomm Atheros Pronto WLAN module


#	depends on WLAN
#	depends on CFG80211
#        depends on WCNSS_CORE

if PRIMA_WLAN != n || PRONTO_WLAN != n

config PRIMA_WLAN_BTAMP
	bool "Enable the Prima WLAN BT-AMP feature"
	default n

config PRIMA_WLAN_LFR
	bool "Enable the Prima WLAN Legacy Fast Roaming feature"
	default y

config QCOM_TDLS
	bool "Enable the Prima QCOM TDLS feature"
	default y

config PRIMA_WLAN_OKC
	bool "Enable the Prima WLAN Opportunistic Key Caching feature"
	default y

config PRIMA_WLAN_11AC_HIGH_TP
	bool "Enable the Prima WLAN 802.11ac High Throughput option (depends upon kernel support)"
	default y

config WLAN_FEATURE_11W
	bool "Enable the WLAN 802.11w Protected Management Frames feature"
	default y

config QCOM_VOWIFI_11R
	bool "Enable Fast Transition (11r) feature"
	default y

config ENABLE_LINUX_REG
	bool "Enable linux regulatory feature"
	default y

endif # PRIMA_WLAN || PRONTO_WLAN
```

## drivers/staging/qcacld-2.0/Kconfig
```kconfig
comment "Qualcomm Atheros CLD WLAN module"

config QCA_CLD_WLAN

	tristate "Qualcomm Atheros CLD WLAN module"
	default n
	help
	Add support for the Qualcomm Atheros CLD WLAN module

if QCA_CLD_WLAN != n

config QCACLD_WLAN_LFR3
	bool "Enable the WLAN Legacy Fast Roaming feature Version 3"
	default n

config PRIMA_WLAN_OKC
	bool "Enable the Prima WLAN Opportunistic Key Caching feature"
	default n

config PRIMA_WLAN_11AC_HIGH_TP
	bool "Enable the Prima WLAN 802.11ac High Throughput option (depends upon kernel support)"
	default n

config WLAN_FEATURE_11W
	bool "Enable the WLAN 802.11w Protected Management Frames feature"
	default n

config WLAN_FEATURE_LPSS
	bool "Enable the WLAN LPSS feature"
	default n

config QCOM_VOWIFI_11R
	bool "Enable Fast Transition (11r) feature"
	default n

config WLAN_FEATURE_NAN
	bool "Enable NAN feature"
	default n

config QCOM_TDLS
	bool "Enable TDLS feature"
	default n

config QCOM_LTE_COEX
	bool "Enable QCOM LTE Coex feature"
	default n

config WLAN_SYNC_TSF
	bool "Enable QCOM sync multi devices tsf feature"
	default n

config WLAN_FEATURE_MEMDUMP
	bool "Enable MEMDUMP feature"
	default n

config WLAN_OFFLOAD_PACKETS
	bool "Enable offload packets feature"
	default n

config QCA_WIFI_AUTOMOTIVE_CONC
	bool "Enable 3 port concurrency feature"
	default n

config WLAN_UDP_RESPONSE_OFFLOAD
	bool "Enable UDP response offload feature"
	default n

config WLAN_FEATURE_RX_WAKELOCK
	bool "Enable RX wake lock feature"
	default n

config WLAN_WOW_PULSE
	bool "Enable WOW Pulse feature"
	default n

endif # QCA_CLD_WLAN
```
