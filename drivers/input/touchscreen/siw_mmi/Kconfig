## drivers/input/touchscreen/siw_mmi/Kconfig
```kconfig
menu "SiW Touch Support in MMI Revision"

config TOUCHSCREEN_SIW_MMI
	tristate "Silicon Works Touch Driver Core in MMI Revision"
	depends on SPI_MASTER || I2C
	default n
	help
	  Say Y here if you have a touchscreen interface using
	  the Silicon Works touch device.

config TOUCHSCREEN_SIW_MMI_SW49106
	bool "Silicon Works Touch Driver for SW49106"
	depends on TOUCHSCREEN_SIW_MMI
	default n
	help
	  If your device is SW49106, say Y

source "drivers/input/touchscreen/siw_mmi/mon/Kconfig"

endmenu
```

## drivers/input/touchscreen/siw_mmi/mon/Kconfig
```kconfig
menu "SiW Touch Monitor in MMI Revision"
	depends on TOUCHSCREEN_SIW_MMI

config TOUCHSCREEN_SIW_MMI_MON
	tristate "Silicon Works Touch Driver Monitor in MMI Revision"
	depends on TOUCHSCREEN_SIW_MMI
	default y
	help
	  If you select this option,
	  a component which captures the SiW operation traffic such as bus, input
	  will be build.

endmenu
```

## drivers/input/touchscreen/synaptics_mmi/Kconfig
```kconfig
#
# Synaptics DSX touchscreen driver configuration
#
menuconfig TOUCHSCREEN_SYNAPTICS_DSX_MMI
	tristate "Synaptics DSX touchscreen in MMI revision"
	default n
	help
	  Say Y here if you have a Synaptics DSX touchscreen connected
	  to your system. This revision supports MMI features.

	  If unsure, say N.

if TOUCHSCREEN_SYNAPTICS_DSX_MMI

choice
	default TOUCHSCREEN_SYNAPTICS_DSX_I2C_MMI
	prompt "Synaptics DSX bus interface"

config TOUCHSCREEN_SYNAPTICS_DSX_I2C_MMI
	tristate "RMI over I2C"
	depends on I2C
	help
	  Say Y here if you have a Synaptics DSX touchscreen interfaced
	  to the host processor over I2C

	  If unsure, say N.

	  To compile this driver as a module, choose M here: the
	  module will be called synaptics_dsx_i2c.
endchoice

config TOUCHSCREEN_SYNAPTICS_DSX_RMI_DEV_MMI
	tristate "Synaptics DSX touchscreen RMI device module"
	depends on TOUCHSCREEN_SYNAPTICS_DSX_I2C_MMI
	help
	  Say Y here to enable support for direct RMI register access.

	  If unsure, say N.

	  To compile this driver as a module, choose M here: the
	  module will be called synaptics_dsx_rmi_dev.

config TOUCHSCREEN_SYNAPTICS_DSX_FW_UPDATE_MMI
	tristate "Synaptics DSX touchscreen firmware update module"
	depends on TOUCHSCREEN_SYNAPTICS_DSX_I2C_MMI
	help
	  Say Y here to enable support for carrying out firmware update.

	  If unsure, say N.

	  To compile this driver as a module, choose M here: the
	  module will be called synaptics_dsx_fw_update.

config TOUCHSCREEN_SYNAPTICS_DSX_TEST_REPORTING_MMI
	tristate "Synaptics DSX test reporting module"
	depends on TOUCHSCREEN_SYNAPTICS_DSX_I2C_MMI
	help
	  Say Y here to enable support for retrieving production test reports.

	  If unsure, say N.

	  To compile this driver as a module, choose M here: the
	  module will be called synaptics_dsx_test_reporting.

config TOUCHSCREEN_SYNAPTICS_DSX_CTRL_ACCESS_BLK_MMI
	tristate "Synaptics I2C touchscreen control access block"
	depends on TOUCHSCREEN_SYNAPTICS_DSX_I2C_MMI
	help
	  This enables export of Synaptics DSX I2C touchscreen control access
          block.

	  Say Y here if you intend to export Synaptics DSX I2C touchscreen
	  control access block.

	  If unsure, say N.

	  To compile this driver as a module, choose M here: the
	  module will be called synaptics_dsx_control_access_block.

config TOUCHSCREEN_SYNAPTICS_DSX_FW_UPDATE_EXTRA_SYSFS_MMI
	bool "Synaptics DSX firmware update extra sysfs attributes (MMI)"
	depends on TOUCHSCREEN_SYNAPTICS_DSX_FW_UPDATE_MMI
	help
	  Say Y here to enable support for extra sysfs attributes
	  supporting firmware update in a development environment.
	  This does not affect the core or other subsystem attributes.

	  If unsure, say N.


endif
```

## drivers/media/platform/msm/Kconfig
```kconfig
#
# MSM camera configuration
#

comment "Qualcomm Technologies, Inc. MSM Camera And Video"

menuconfig SPECTRA_CAMERA
    bool "Qualcomm Technologies, Inc. Spectra camera and video capture support"
    depends on ARCH_QCOM && VIDEO_V4L2 && I2C
    ---help---
      Say Y here to enable selecting the video adapters for
      Qualcomm Technologies, Inc. Spectra camera and video capture.
      Enabling this adds support for the camera driver stack including sensor,
      IFE and postprocessing drivers.

menuconfig OIS_BM24218
    bool "Motorola, Inc. For Rohm BM24218 OIS driver"
    depends on SPECTRA_CAMERA
    default n
    ---help---
      Say Y here to enable selecting the ROHM BM24218 OIS driver.

source "drivers/media/platform/msm/vidc/Kconfig"
source "drivers/media/platform/msm/sde/Kconfig"
source "drivers/media/platform/msm/npu/Kconfig"
source "drivers/media/platform/msm/dvb/Kconfig"
source "drivers/media/platform/msm/broadcast/Kconfig"
```

## drivers/media/platform/msm/camera_v2/Kconfig
```kconfig
config MSM_CAMERA_SENSOR
	    bool "Qualcomm MSM camera sensor support"
	    depends on MSMB_CAMERA
        ---help---
          This flag enables support for Camera Sensor.
          The sensor driver is capable of providing real time
          data for camera support. The driver support V4L2
          subdev APIs.

config MSM_ACTUATOR
        bool "Qualcomm MSM actuator support"
        depends on MSMB_CAMERA


config MSM_CPP
        bool "Qualcomm MSM Camera Post Processing Engine support"
        depends on MSMB_CAMERA
        ---help---
          Enable support for Camera Post-processing Engine
          The Post processing engine is capable of scaling
          and cropping image. The driver support V4L2 subdev
          APIs.

config MSM_CCI
        bool "Qualcomm MSM Camera Control Interface support"
        depends on MSMB_CAMERA
        ---help---
          Enable support for Camera Control Interface driver only
          for those platforms that have hardware support. This driver
          is responsible for handling I2C read and write on the I2C
          bus. It is also responsible for synchronization with
          GPIO and data frames.

config MSM_CSI20_HEADER
        bool "Qualcomm MSM CSI 2.0 Header"
        depends on MSMB_CAMERA
        ---help---
          Enable support for CSI drivers to include 2.0
          header. This header has register macros and its
          values and bit mask for register configuration bits
          This config macro is required targets based on 8960,
          8930 and 8064 platforms.

config MSM_CSI30_HEADER
        bool "Qualcomm MSM CSI 3.0 Header"
        depends on MSMB_CAMERA
        ---help---
          Enable support for CSI drivers to include 3.0
          header. This header has register macros and its
          values and bit mask for register configuration bits
          This config macro is required for targets based on
          8064 platforms.

config MSM_CSIPHY
        bool "Qualcomm MSM Camera Serial Interface Physical receiver support"
        depends on MSMB_CAMERA
        ---help---
          Enable support for Camera Serial Interface
          Physical receiver. It deserializes packets and
          supports detection of packet start and stop
          signalling.

config MSM_CSID
        bool "Qualcomm MSM Camera Serial Interface decoder support"
        depends on MSMB_CAMERA
        ---help---
          Enable support for Camera Serial Interface decoder.
          It supports lane merging and decoding of packets
          based on cid which is mapped to a virtual channel
          and datatype.

config MSM_EEPROM
        bool "Qualcomm MSM Camera ROM Interface for Calibration support"
        depends on MSMB_CAMERA
        ---help---
          Enable support for ROM Interface for Calibration
          Provides interface for reading the Claibration data.
          and also provides support for writing data in case of FLASH ROM.
	  Currently supports I2C, CCI and SPI protocol

config MSM_ISPIF
        bool "Qualcomm MSM Image Signal Processing interface support"
        depends on MSMB_CAMERA
        ---help---
          Enable support for Image Signal Processing interface module.
          This module acts as a crossbar between CSID and VFE. Output
          of any CID of CSID can be routed to of of pixel or raw
          data interface in VFE.

config S5K3L1YX
	bool "Sensor S5K3L1YX (BAYER 12M)"
	depends on MSMB_CAMERA
	---help---
		Samsung 12 MP Bayer Sensor with auto focus, uses
		4 mipi lanes, preview config = 1984 * 1508 at 30 fps,
		snapshot config = 4000 * 3000 at 20 fps,
		hfr video at 60, 90 and 120 fps.

config IMX111
	bool "Sensor IMX111 (Sony 8MP)"
	depends on MSMB_CAMERA
        select SEKONIX_LENS_ACT
	---help---
	  Sensorony 8M Bayer Sensor modules with Autofocus

config IMX111_ACT
       bool "Actuator imx111 (BAYER 8M)"
       depends on MSMB_CAMERA
       select MSM_ACTUATOR
       default n
       ---help---
         Actuator for SONY 8 MP Bayer Sensor

config SEKONIX_LENS_ACT
       bool "Actuator SEKONIX LENS"
       depends on MSMB_CAMERA
       select MSM_ACTUATOR
       default n
       ---help---
         Actuator for Sekonix Lens

config IMX119
	bool "Sensor IMX119"
	depends on MSMB_CAMERA
	---help---
	  Bayer Sensor modules with Autofocus.

config OV5693
       bool "Sensor ov5693 (Bayer 5M)"
       depends on MSMB_CAMERA

config MI1040
       bool "Sensor mi1040 (VGA YUV)"
       depends on MSMB_CAMERA
       ---help---
          Aptina 1.2M YUV Sensor

config MSM_V4L2_VIDEO_OVERLAY_DEVICE
	tristate "Qualcomm MSM V4l2 video overlay device"
	---help---
	  Enables support for the MSM V4L2 video
	  overlay driver. This allows video rendering
	  apps to render overlaid video using Video4Linux2
	  APIs, by using /dev/videoX device


config MSM_GEMINI
	tristate "Qualcomm MSM Gemini JPEG engine support"
	depends on MSMB_CAMERA && (ARCH_MSM7X30 || ARCH_MSM8X60 || ARCH_MSM8960)
	---help---
	  Enables support for the Gemini JPEG encoder engine for 8x60.
```

## drivers/media/shtunerdrv/Kconfig
```kconfig
# drivers/media/shtunerdrv/Kconfig

menu "SHARP DTV Tuner Configuration"

config SHARP_DTV_TUNERDEV
	bool "set SHARP DTV tuner dev."
	default n


endmenu
```

## drivers/misc/capsense/Kconfig
```kconfig
#
# Cypress CapSense(TM) devices
#

config CYPRESS_CAPSENSE
    tristate "Cypress CapSense Driver"
    depends on I2C
    depends on OF
    help
      CapSense devices is the analog system contains the capacitive sensing
      hardware. Several hardware algorithms are supported. This hardware
      performs capacitive sensing and scanning without requiring external
      components.

config CYPRESS_CAPSENSE_CY8C20237_24LKXI
    tristate "Cypress CapSense"
    depends on CYPRESS_CAPSENSE
    help
      This option enables device driver support for the Cypress Capsense IC -
      CY8C20237_24LKXI.  This is one of PSoC CapSense family.
      This device congiguration contains 10 sensing inputs, 8k flash memory and
      1k SRAM.
```

## drivers/misc/capsense_prog/Kconfig
```kconfig
#
# Cypress CapSense(TM) devices
#

config CYPRESS_CAPSENSE_PROGRAMMING
    tristate "Cypress CapSense Programming Driver"
    depends on I2C
    depends on OF
    help
      CapSense devices is the analog system contains the capacitive sensing
      hardware. Several hardware algorithms are supported. This hardware
      performs capacitive sensing and scanning without requiring external
      components. It contains internal flash memory, which have to be programmed
      with firmware. This option enables firmware programming driver and allows
      automatically identify device and matching firmware. See file
      Documentation/misc-devices/capsense_prog.txt for details.
```

## drivers/misc/cypress/Kconfig
```kconfig
#
# Cypress CapSense(TM) devices
#

config CAPSENSE_CYPRESS
    tristate "Cypress CapSense HSSP Programming Driver"
    help
      CapSense devices is the analog system contains the capacitive sensing
      hardware. Several hardware algorithms are supported. This hardware
      performs capacitive sensing and scanning without requiring external
      components. It contains internal flash memory, which have to be programmed
      with firmware using HSSP interface. Host Sourced Serial Programming (HSSP)
      refers to the programming of the target device on the board by using a host
      microcontroller. The PSoC 4 target is programmed through the SWD interface -
      ARM Serial Ware Debug. This option enables firmware programming driver and
      allows automatically identify device and matching firmware. See file
      Documentation/devicetree/bindings/misc/capsense_hssp.txt for details.
```

## drivers/misc/fusb302/Kconfig
```kconfig
config FUSB302
	bool "Fairchild FUSB302 Type C Controller support"
	depends on I2C=y
	default y
        help
          Say y here to enable support for FUSB302 type C Controller.
		FUSB302 is a programmable USB Type-C Controller with
		support for USB Power Delivery.
```

## drivers/misc/fusb302_legacy/Kconfig
```kconfig
config FUSB302_LEGACY
	bool "Legacy FUSB302 Type C Controller support"
	depends on I2C
	default n
        help
          Say y here to enable support for legacy FUSB302 type C Controller.
		FUSB302 is a programmable USB Type-C Controller and does not
		fully support USB Power Delivery.
```

## drivers/misc/huawei_reset_detect/Kconfig
```kconfig
config HUAWEI_RESET_DETECT
	tristate "detect abnormal reset"
	default n
	help
	  Say Y here to report reboots/resets
```

## drivers/misc/ir2e71y/Kconfig
```kconfig
#
# IR2E71Y Configuration
#

menu "SHARP IR2E71Y devices"

config IR2E71Y
	bool "uses SHARP_IR2E71Y"
	default n

endmenu
```
