## drivers/misc/mods/Kconfig
```kconfig
#
# Misc strange devices
#

menu "mods devices"

config USB3813
	tristate "Microchip USB3813 Hub Controller"
	default n
	help
	  This option enables a device driver for the USB3813 which is a
	  3-Port Hub Controller.

config MODS_USB_EXT_BRIDGE
	bool "Enable interface to support MODS USB"
	default n
	help
	  This enables an interface that integrates the MODS usb greybus
	  module with the kernel USB drivers. If you are using the MODS
	  kernel modules, you should select yes, if not no.

config MODS_MODBUS_SWITCH
	bool "Enable control of the mods muxing swtich(different with mods_modbus_ext)"
	default n
	help
	  This enables ability to mux the i2s, mphy, and usb paths through the
	  set of ts3usb3031 switches depending on the requested configuration.
	  If you are using the MODS kernel modules, you should select yes, if
	  not no. This file is defferent with the file of mods_modbus_ext. This
	  is a common file which could be applied in lots of defferent hw design.

config MODS_CODEC_BUS
	tristate "mods codec bus interface support"
	default n
	help
	  This enables bus interface for mods shim sound codec to talk to
	  greybus sound codec module.

config MOD_DISPLAY
	tristate "Mod Display Support"
	default n
	---help---
	  Say yes here if you wish to include the Mod Display support drivers.

config MOD_DP_BRIDGE
	tristate "Mod dp bridge Display Support"
	depends on MOD_DISPLAY
	default n
	---help---
	  Say yes here if you wish to include the Mod Display support drivers.

config MODS_2ND_GEN
	bool "MODS_2ND_GEN Support"
	default n
	help
	  This option enables the mods 2nd generation hw designation.

config ICE40
	bool "MODS_2ND_GEN Support"
	default n
	help
	  This option enables the mods 2nd generation hw designation.

config APBA_SPI_SWITCH
	bool "use apba spi switch"
	default n
	help
	  This option indicates the using of apba spi switch.

config MODS_NEW_SW_ARCH
	bool "use new sw arch"
	default n
	help
	  For transport mods relative changes more convinient, we
	  re-redevelop a new mods architecture from android-p.

config SERIAL_MAX310X_CORE
    tristate "MAX310X support"
    depends on (SPI && !I2C) || I2C
	help
	  This selects support for an advanced UART from Maxim (Dallas).
	  Supported ICs are MAX3107, MAX3108, MAX3109, MAX14830.
	  Each IC contains 128 words each of receive and transmit FIFO
	  that can be controlled through I2C or high-speed SPI.
	  Select SPI or I2C bus using options below.

config SERIAL_MAX310X_SPI
    bool "MAX310x for spi interface"
    depends on SERIAL_MAX310X_CORE
    depends on SPI
    select REGMAP_SPI if SPI
    default n
    help
	  Enable MAX310x driver on SPI bus,
	  If required say y, and say n to spi if not required,
	  Enabled by default to support oldconfig.
	  You must select at least one bus for the driver to be built.

config SERIAL_MAX310X_I2C
    bool "MAX310x for I2C interface"
    depends on SERIAL_MAX310X_CORE
    depends on I2C
    select REGMAP_I2C if I2C
    help
	  Enable MAX310x driver on I2C bus,
	  If required say y, and say n to i2c if not required,
	  This is additional support to existing driver.
	  You must select at least one bus for the driver to be built.

	  Say Y here if you want to support this ICs.

endmenu
```

## drivers/misc/moto-sensorhub/Kconfig
```kconfig
config SENSORS_MOTOSH
        tristate "MOTOSH Sensor Processor"
        default n
        depends on I2C
        help
          Say yes here if you wish to include the Motorola
          "MOTOSH" Sensorhub processor driver. The driver
          handles registration for physical sensors
          connected to this external processor.

config MMI_HALL_NOTIFICATIONS
        bool "Enable hall effect sensor notifier"
        default n
        depends on SENSORS_MOTOSH
        help
          Support for hall effect sensor notifications.

config SENSORS_MOTOSH_HEADSET
        bool "Enable sensor hub headset detection"
        default n
        depends on SENSORS_MOTOSH
        help
          Support for sensor hub based headset detection.

config SENSORS_MOTOSH_MOTODISP
        bool "Enable sensor hub Moto display"
        default n
        depends on SENSORS_MOTOSH
        help
          Support for sensor hub based notification display.
```

## drivers/misc/sec/Kconfig
```kconfig
#
# Sec configuration
#

menu "Motorola secuirty driver"

config SEC_DRIVER
	tristate "Motorola security driver"

endmenu
```

## drivers/misc/sh_wlan_fac/Kconfig
```kconfig
menu "SHARP WLAN factory support"

config SHARP_WLAN_FACTORY
	bool "Sharp WLAN factory support"
	default n

endmenu
```

## drivers/misc/shsensor_hub/ml630q790/Kconfig
```kconfig
#
# SensorHub drivers configuration
#

menu "SHARP ML630Q790 devices"

config SHUB_ML630Q790
	bool "LAPIS Semicomductor ML610Q793 SensorHub Micom"
#	depends on SHUB
	default n
	help
	 --- help ---
	 If you say yes here you get support for SHUB_ML630Q790.

endmenu
```

## drivers/misc/slimport_anx7808/Kconfig
```kconfig
config SLIMPORT_ANX7808
	tristate "Analogix Slimport transmitter ANX7808 support"
	help
	  Slimport Transmitter is a HD video transmitter chip
	  over micro-USB connector for smartphone device.
```

## drivers/misc/stm401/Kconfig
```kconfig
config SENSORS_STM401
        tristate "STM401 Sensor Processor"
        default n
        depends on I2C
        help
          Say yes here if you wish to include the STM
          STM401 Sensor processor driver.

config MMI_HALL_NOTIFICATIONS
        bool "Enable hall effect sensor notifier"
        default n
        depends on SENSORS_STM401
        help
          Support for hall effect sensor notifications.
```

## drivers/misc/stml0xx/Kconfig
```kconfig
config SENSORHUB_DEBUG_LOGGING
	bool "sensorhub debug logging"
	default n
	help
	  Say yes here if you wish to enable debug
	  logging from the sensorhub.

config SENSORS_STML0XX
	tristate "STML0XX Sensor Processor"
	default n
	depends on SPI
	help
	  Say yes here if you wish to include the STM
	  STML0XX Sensor processor driver.

config MMI_HALL_NOTIFICATIONS
	bool "Enable hall effect sensor notifier"
	default n
	depends on SENSORS_STML0XX
	help
	  Support for hall effect sensor notifications.

config SENSORS_SH_AK09912
	bool "Enable sensor processor connected ak09912"
	default n
	depends on SENSORS_STML0XX
	help
	  Support for a sensor processor connected ak09912 magnetometer.
```

## drivers/misc/sx933x/Kconfig
```kconfig
#
# CapSense(TM) devices
#

config SENSORS_SX933X
    tristate "sx933x Programming Driver"
    help
      CapSense devices is the analog system contains the capacitive sensing
      hardware. Several hardware algorithms are supported. This hardware
      performs capacitive sensing and scanning without requiring external
      components. It contains internal flash memory, which have to be programmed
      with firmware using HSSP interface. Host Sourced Serial Programming (HSSP)
      refers to the programming of the target device on the board by using a host
      microcontroller. The PSoC 4 target is programmed through the SWD interface -
      ARM Serial Ware Debug. This option enables firmware programming driver and
      allows automatically identify device and matching firmware. See file
      Documentation/devicetree/bindings/misc/capsense_hssp.txt for details.

config CAPSENSE_USB_CAL
	bool "Enable cap-sensor usb calibration"
	depends on SENSORS_SX933X
	help
	  Enable Cap-sensor calibration when usb plug.

	  To use CAPSENSE_USB_CAL open the feature that it can enable cap-sensor calibration
	  when usb plug.
```

## drivers/misc/vd628x/KConfig
```kconfig
config VD628x
	tristate " STMicroelectronics VD6283 flicker detection"
	depends on SPI_MASTER

	help
	  If your system has a slave-capable SPI controller, you can enable slave protocol handlers.
```

## drivers/motor/Kconfig
```kconfig
#
# vibrator controlled by PMIC regualtor configuration
#

config REGULATOR_VIBRATOR
	tristate "REGULATOR_VIBRATOR"
	default n
	help
	Say Y to enable REGULATOR_VIBRATOR support.
```

## drivers/net/can/spi/Kconfig
```kconfig
# SPDX-License-Identifier: GPL-2.0-only
menu "CAN SPI interfaces"
	depends on SPI

config CAN_HI311X
	tristate "Holt HI311x SPI CAN controllers"
	help
	  Driver for the Holt HI311x SPI CAN controllers.

config CAN_MCP251X
	tristate "Microchip MCP251x and MCP25625 SPI CAN controllers"
	help
	  Driver for the Microchip MCP251x and MCP25625 SPI CAN
	  controllers.

source "drivers/net/can/spi/mcp251xfd/Kconfig"

config CAN_MCP25XXFD
    tristate "Microchip MCP25xxFD SPI CAN controllers"
    depends on HAS_DMA
    help
      The driver for the Microchip MCP25XXFD SPI FD-CAN
      controller family.
      Say yes here to build support for SPI to CAN devices
      mcp25xxfd. To compilethis driver as a module, choose
      M here: the module will be called mcp25xxfd.

config QTI_CAN
	tristate "Unified driver for QTI CAN controllers"
	depends on SPI
	help
	  This adds unified driver for QTI CAN controllers on auto
	  Platform. This driver can support a few SPI controllers
	  being used on automotive paltform. This Driver is based
	  on Calypso MPC5746 MCU ans uses SPI bus for data access.
	  It support most CAN operations including version lookup,
	  firmware upgrade, CAN message filter, etc.
endmenu
```
