## Kconfig.msm
```kconfig
# SPDX-License-Identifier: GPL-2.0

menu "Qualcomm SoC Repostiory Configuration"

source "$(KCONFIG_EXT_PREFIX)arch/arm64/gunyah/Kconfig"

source "$(KCONFIG_EXT_PREFIX)arch/arm64/Kconfig.platforms"

source "$(KCONFIG_EXT_PREFIX)drivers/base/regmap/Kconfig"

source "$(KCONFIG_EXT_PREFIX)drivers/bus/mhi/Kconfig"

source "$(KCONFIG_EXT_PREFIX)drivers/char/Kconfig"

source "$(KCONFIG_EXT_PREFIX)drivers/clk/qcom/Kconfig"

source "$(KCONFIG_EXT_PREFIX)drivers/cpufreq/Kconfig.arm"

source "$(KCONFIG_EXT_PREFIX)drivers/cpuidle/Kconfig"

source "$(KCONFIG_EXT_PREFIX)drivers/devfreq/Kconfig"

source "$(KCONFIG_EXT_PREFIX)drivers/dma-buf/heaps/Kconfig"

source "$(KCONFIG_EXT_PREFIX)drivers/dma/qcom/Kconfig"

source "$(KCONFIG_EXT_PREFIX)drivers/edac/Kconfig"

source "$(KCONFIG_EXT_PREFIX)drivers/firmware/Kconfig"

source "$(KCONFIG_EXT_PREFIX)drivers/gpu/drm/bridge/Kconfig"

source "$(KCONFIG_EXT_PREFIX)drivers/gpu/drm/msm/Kconfig"

source "$(KCONFIG_EXT_PREFIX)drivers/hwmon/Kconfig"

source "$(KCONFIG_EXT_PREFIX)drivers/hwtracing/coresight/Kconfig"

source "$(KCONFIG_EXT_PREFIX)drivers/hwtracing/stm/Kconfig"

source "$(KCONFIG_EXT_PREFIX)drivers/i2c/busses/Kconfig"

source "$(KCONFIG_EXT_PREFIX)drivers/i3c/master/Kconfig"

source "$(KCONFIG_EXT_PREFIX)drivers/iio/adc/Kconfig"

source "$(KCONFIG_EXT_PREFIX)drivers/input/misc/Kconfig"

source "$(KCONFIG_EXT_PREFIX)drivers/interconnect/Kconfig"

source "$(KCONFIG_EXT_PREFIX)drivers/iommu/Kconfig"

source "$(KCONFIG_EXT_PREFIX)drivers/irqchip/Kconfig"

source "$(KCONFIG_EXT_PREFIX)drivers/leds/Kconfig"

source "$(KCONFIG_EXT_PREFIX)drivers/mailbox/Kconfig"

source "$(KCONFIG_EXT_PREFIX)drivers/mfd/Kconfig"

source "$(KCONFIG_EXT_PREFIX)drivers/eom/Kconfig"

source "$(KCONFIG_EXT_PREFIX)drivers/eom/pcie/Kconfig"

source "$(KCONFIG_EXT_PREFIX)drivers/misc/Kconfig"

source "$(KCONFIG_EXT_PREFIX)drivers/mmc/host/Kconfig"

source "$(KCONFIG_EXT_PREFIX)drivers/net/Kconfig"

source "$(KCONFIG_EXT_PREFIX)drivers/pci/controller/Kconfig"

source "$(KCONFIG_EXT_PREFIX)drivers/perf/Kconfig"

source "$(KCONFIG_EXT_PREFIX)drivers/phy/Kconfig"

source "$(KCONFIG_EXT_PREFIX)drivers/phy/qualcomm/Kconfig"

source "$(KCONFIG_EXT_PREFIX)drivers/pinctrl/qcom/Kconfig"

source "$(KCONFIG_EXT_PREFIX)drivers/power/reset/Kconfig"

source "$(KCONFIG_EXT_PREFIX)drivers/power/supply/Kconfig"

source "$(KCONFIG_EXT_PREFIX)drivers/powercap/qcom/Kconfig"

source "$(KCONFIG_EXT_PREFIX)drivers/ptp/Kconfig"

source "$(KCONFIG_EXT_PREFIX)drivers/regulator/Kconfig"

source "$(KCONFIG_EXT_PREFIX)drivers/remoteproc/Kconfig"

source "$(KCONFIG_EXT_PREFIX)drivers/rpmsg/Kconfig"

source "$(KCONFIG_EXT_PREFIX)drivers/soc/qcom/dcvs/Kconfig"

source "$(KCONFIG_EXT_PREFIX)drivers/soc/qcom/Kconfig"

source "$(KCONFIG_EXT_PREFIX)drivers/soc/qcom/mem_buf/Kconfig"

source "$(KCONFIG_EXT_PREFIX)drivers/soc/qcom/memshare/Kconfig"

source "$(KCONFIG_EXT_PREFIX)drivers/spi/Kconfig"

source "$(KCONFIG_EXT_PREFIX)drivers/spmi/Kconfig"

source "$(KCONFIG_EXT_PREFIX)drivers/thermal/qcom/Kconfig"

source "$(KCONFIG_EXT_PREFIX)drivers/tty/hvc/Kconfig"

source "$(KCONFIG_EXT_PREFIX)drivers/tty/serial/Kconfig"

source "$(KCONFIG_EXT_PREFIX)drivers/ufs/host/Kconfig"

source "$(KCONFIG_EXT_PREFIX)drivers/uio/Kconfig"

source "$(KCONFIG_EXT_PREFIX)drivers/usb/dwc3/Kconfig"

source "$(KCONFIG_EXT_PREFIX)drivers/usb/gadget/Kconfig"

source "$(KCONFIG_EXT_PREFIX)drivers/usb/Kconfig"

source "$(KCONFIG_EXT_PREFIX)drivers/video/Kconfig"

source "$(KCONFIG_EXT_PREFIX)drivers/virt/Kconfig"

source "$(KCONFIG_EXT_PREFIX)drivers/virtio/Kconfig"

source "$(KCONFIG_EXT_PREFIX)init/Kconfig"

source "$(KCONFIG_EXT_PREFIX)kernel/sched/walt/Kconfig"

source "$(KCONFIG_EXT_PREFIX)kernel/trace/Kconfig"

source "$(KCONFIG_EXT_PREFIX)net/Kconfig"

source "$(KCONFIG_EXT_PREFIX)sound/usb/Kconfig"

source "$(KCONFIG_EXT_PREFIX)drivers/block/Kconfig"

source "$(KCONFIG_EXT_PREFIX)Kconfig.qtvm"

source "$(KCONFIG_EXT_PREFIX)drivers/block/zram/Kconfig"

source "$(KCONFIG_EXT_PREFIX)kernel/power/Kconfig"

endmenu

source "motorola/kernel/modules/Kconfig.moto"
```

## drivers/input/misc/Kconfig
```kconfig
# SPDX-License-Identifier: GPL-2.0-only
#
# Input misc drivers configuration
#
if INPUT_MISC

config INPUT_PM8941_PWRKEY
	tristate "Qualcomm PM8941 power key support"
	depends on MFD_SPMI_PMIC
	help
	  Say Y here if you want support for the power key usually found
	  on boards using a Qualcomm PM8941 compatible PMIC.

	  If unsure, say Y.

	  To compile this driver as a module, choose M here: the module
	  will be called pm8941-pwrkey.

config INPUT_PM8XXX_VIBRATOR
	tristate "Qualcomm PM8XXX vibrator support"
	depends on MFD_PM8XXX || MFD_SPMI_PMIC
	select INPUT_FF_MEMLESS
	help
	  This option enables device driver support for the vibrator
	  on Qualcomm PM8xxx chip. This driver supports ff-memless interface
	  from input framework.

	  To compile this driver as module, choose M here: the
	  module will be called pm8xxx-vibrator.

config INPUT_QCOM_HV_HAPTICS
	tristate "QTI High Voltage Haptics support"
	depends on MFD_SPMI_PMIC
	help
	  This option enables device driver support for the high voltage haptics
	  peripheral found on Qualcomm Technologies, Inc. PMICs.  The high voltage
	  haptics peripheral is capable of driving either LRA or ERM vibrators with
	  drive voltage up to 10 V, and its 5 integrated pattern sources can be used
	  for playing different vibration effects. To compile this driver as a module,
	  choose M here: the module will be called qcom-hv-haptics.

config RICHTAP_FOR_PMIC_ENABLE
	bool "Decide whether need enable AAC moto driver"
	depends on INPUT_QCOM_HV_HAPTICS
	help
	  Say Y here if your device support AAC RichTap moto device.

endif
```

## drivers/ufs/host/HID_UFS31/Kconfig
```kconfig
config UFS31_FEATURE
	bool "UFS feature activate"
	depends on SCSI_UFSHCD
	help
	  UFS feature activate such as hid, tw and etc.

config UFS31_HID
	bool "UFS Host Initiated Defrag support"
	depends on SCSI_UFSHCD && UFS31_FEATURE
	help
	  UFS HID Feature Enable

config UFS31_HID_POC
	bool "UFSHID_POC test"
	depends on SCSI_UFSHCD && UFS31_FEATURE && UFS31_HID
	help
	  UFS HID POC test
	  1. block to enter suspend state
	  2. auto_hibern8 enable/disable (HCI)
	  3. set flag bDefragOperation
	  4. debug msg enable (default : disable)
```

## kernel/power/Kconfig
```kconfig
# SPDX-License-Identifier: GPL-2.0-only
config SUSPEND_DEBUG
	tristate "Enable snapshot of regulator and tlmm when suspend"
	depends on SUSPEND
	default n
	help
	  This allows you to dump the regulator state and tlmm configuration
	  before suspend. It doesn't work only if you have read the system
	  file node /sys/privae/tlmm_before_sleep and vreg_before_sleep

config GPIO_VALID_ARRAY
	bool "Check if a gpio is valid in an array"
	depends on SUSPEND_DEBUG
	default n
	help
	  This allows you to use an array maintained manually to indicate
          if a GPIO can be accessed by APPS. It's only needed when the GPIO
          is still unaccessible although gpiochip_line_is_valid() returns
          true.
```

## kernel/sched/walt/Kconfig
```kconfig
# SPDX-License-Identifier: GPL-2.0-only
#
# QTI WALT based scheduler
#
menu "QTI WALT based scheduler features"

config SCHED_WALT
	tristate "Support window based load tracking"
	depends on SMP
	help
	This feature will allow the scheduler to maintain a tunable window
	based set of metrics for tasks and runqueues. These metrics can be
	used to guide task placement as well as task frequency requirements
	for cpufreq governors.

config SCHED_WALT_DEBUG
	tristate "WALT debug module"
	depends on SCHED_WALT
	select TRACE_PREEMPT_TOGGLE
	select TRACE_IRQFLAGS
	help
	  This module provides the means of debugging long preempt and
	  irq disable code. This helps in identifying the scheduling
	  latencies. The module rely on preemptirq trace hooks and
	  print the stacktrace to the ftrace upon long preempt and irq
	  events. Sysctl knobs are available for the user to configure
	  the thresholds.

	  This module also used to crash the system to catch issues
	  in scenarios like RT throttling and sleeping while in atomic
	  context etc.

config SCHED_WALT_STATS
	tristate "WALT stats"
	depends on SCHED_WALT
	help
	  This feature will statistic the number of idle/active load
	  balances, the reasons for CPU frequency selection, the time
	  the CPU spends at minimum/maximum frequency (excluding idle
	  time), and the time the CPU spends at each frequency point.

config SCHED_CONSERVATIVE_BOOST_LPM_BIAS
	bool "Enable LPM bias if conservative boost is enabled"
	default n
	help
	  This feature will allow the scheduler to disable low power
	  modes on a cpu if conservative boost is active. The cpu
	  will not enter low power mode for a hysteresis time period,
	  which can be configured from userspace.

config SCHED_WALT_NR_CPUS
	int "Maximum number of CPUs managed by WALT"
	range 2 32
	default 8
	help
	  This feature allows the configuration of the number of CPUs
	  in the system that need to be managed by WALT.

config SCHED_WALT_MIDPOINT
	tristate "sched walt midpoint"
	depends on SCHED_WALT
	help
	  This feature will have a midpoint frequency voted qos request
	  in fmin and fmax.

config SCHED_MOTO_UNFAIR
	tristate "Enable moto unfair scheduler"
	depends on SCHED_WALT
	default n
	help
	  This feature will allow the scheduler to maintain more detailed
	  mvp scheduling.


endmenu
```
